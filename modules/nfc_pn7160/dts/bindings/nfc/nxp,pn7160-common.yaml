## src/nfc/protocols/ultralight/Kconfig
```kconfig
# MIFARE Ultralight / NTAG protocol — cookbook §5.2.

config NFC_PROTOCOL_ULTRALIGHT
	bool "MIFARE Ultralight / NTAG protocol model"
	default n
	depends on NFC_STACK
	select NFC_PROTOCOL_NDEF
	help
	  Ultralight page data model, poller (reader), and T4 NDEF adapter
	  listener. Emulate path uses ndef_listener (no native T2).

if NFC_PROTOCOL_ULTRALIGHT

config NFC_ULTRALIGHT_MAX_PAGES
	int "Maximum Ultralight pages in data model"
	default 256
	range 16 256
	help
	  Largest supported tag (NTAG216 = 231 pages). Must fit Tier B
	  fixtures and poller page loop.

endif
```

## src/nfc/reader/Kconfig
```kconfig
config NFC_READER
	bool "NFC reader engine"
	default n
	depends on NFC_STACK && NFC_ROLE_READER
	select NFC_PROTOCOL_NDEF if NFC_STORE
	help
	  Reader discovery engine, NDEF clone, and shell commands.

if NFC_READER

config NFC_READER_SHELL
	bool "NFC reader shell commands"
	default y
	depends on SHELL
	help
	  Register nfc reader scan and clone shell commands.

config NFC_READER_SCAN_TIMEOUT_MS
	int "Default reader scan timeout (milliseconds)"
	default 10000
	range 1000 60000
	help
	  Maximum time to wait for a tag during nfc reader scan.

endif
```

## src/nfc/router/Kconfig
```kconfig
# NFC AID router — Gate 3 listen dispatch.

config NFC_ROUTER
	bool "NFC AID router"
	default n
	depends on NFC_STACK && NFC_ROLE_LISTEN
	help
	  ISO-DEP SELECT-by-AID dispatch to registered service vtables.

if NFC_ROUTER

config NFC_ROUTER_MAX_AIDS
	int "Maximum registered AIDs"
	default 8
	range 1 32

endif
```

## src/nfc/run/Kconfig
```kconfig
# NFC stack shared work queue.

config NFC_STACK_WORKQ_STACK_SIZE
	int "NFC stack work queue stack size"
	default 2048
	depends on NFC_STACK
	help
	  Stack for nfc_stack_wq — HAL poll blocking, listen recv loop, reader scan.

config NFC_STACK_WORKQ_PRIORITY
	int "NFC stack work queue priority"
	default 5
	depends on NFC_STACK
	help
	  Priority of the nfc_stack_wq thread.
```

## src/nfc/store/Kconfig
```kconfig
# NFC card store — Gate 2 minimal envelope.

config NFC_STORE
	bool "NFC card store (minimal envelope)"
	default n
	depends on NFC_STACK
	help
	  Versioned TLV + CRC .card blob save/load. Gate 2 subset without NVS.

if NFC_STORE

config NFC_STORE_BLOB_SIZE
	int "Staging buffer size for serialized blobs (bytes)"
	default 4096
	range 512 16384

config NFC_STORE_MAX_TAG_LEN
	int "Maximum tag name length including NUL"
	default 16
	range 8 32

config NFC_STORE_RAM
	bool "In-RAM multi-slot store backend"
	default n
	help
	  Register save/load callbacks backed by a fixed RAM slot table.
	  Enables nfc read → nfc emulate without hex import.

if NFC_STORE_RAM

config NFC_STORE_RAM_SLOT_COUNT
	int "Number of RAM store slots"
	default 4
	range 1 16

config NFC_STORE_RAM_SHELL
	bool "RAM store shell commands (list, dump)"
	default y
	depends on SHELL

endif

endif
```

## tests/unit/nfc_aliro/Kconfig
```kconfig
# SPDX-License-Identifier: Apache-2.0
mainmenu "Aliro protocol unit tests"
source "Kconfig.zephyr"
config NFC_ALIRO_TEST_TIER_POLLER
	bool "Build Aliro poller tier tests"
	default n
config NFC_ALIRO_TEST_TIER_LISTENER
	bool "Build Aliro listener tier tests"
	default n
```

## tests/unit/nfc_aliro/testcase.yaml
```yaml
tests:
  sample.nfc.unit.nfc_aliro.model:
    tags: [ci_unit, nfc, writable_ndef.nfc.aliro]
    platform_allow: [qemu_cortex_m3, native_sim, native_sim/native]
    integration_platforms: [qemu_cortex_m3]
    extra_args: CONF_FILE=prj_model.conf
  sample.nfc.unit.nfc_aliro.poller:
    tags: [ci_unit, nfc, writable_ndef.nfc.aliro]
    platform_allow: [qemu_cortex_m3, native_sim, native_sim/native]
    integration_platforms: [qemu_cortex_m3]
    extra_args: CONF_FILE=prj_poller.conf
  sample.nfc.unit.nfc_aliro.listener:
    tags: [ci_unit, nfc, writable_ndef.nfc.aliro]
    platform_allow: [qemu_cortex_m3, native_sim, native_sim/native]
    integration_platforms: [qemu_cortex_m3]
    extra_args: CONF_FILE=prj_listener.conf
```

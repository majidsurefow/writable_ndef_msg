## modules/nfc_pn7160/dts/bindings/nfc/nxp,pn7160-common.yaml
```yaml
# Copyright (c) 2026
# SPDX-License-Identifier: Apache-2.0

description: |
  NXP PN7160 NFC controller (NCI 2.0 over TML).

  The PN7160 connects to the host over I2C or SPI (mutually exclusive per
  instance — place the node under exactly one bus controller). GPIO lines
  HOST_IRQ, VEN, and optional DWL_REQ are identical for both transports.

  Reference: NXP-NCI2.0 host examples (source/TML/tml.c).

compatible: "nxp,pn7160"

properties:
  irq-gpios:
    type: phandle-array
    required: true
    description: |
      HOST_IRQ — input, active high while NCI payload is available on the bus.
      Same semantics for I2C and SPI.

  ven-gpios:
    type: phandle-array
    required: true
    description: |
      VEN (enable / hard reset) — output, active high powers the controller.

  dwl-gpios:
    type: phandle-array
    description: |
      DWL_REQ — output, active high selects firmware download mode (optional).
```

## modules/nfc_pn7160/dts/bindings/nfc/nxp,pn7160-i2c.yaml
```yaml
# Copyright (c) 2026
# SPDX-License-Identifier: Apache-2.0

description: |
  NXP PN7160 NFC controller on I2C bus (primary / default transport).

  Example — nRF54L15 DK + PN7160 eval shield (adjust bus and pins):

      &i2c21 {
          status = "okay";
          clock-frequency = <100000>;
          pn7160: pn7160@28 {
              compatible = "nxp,pn7160";
              reg = <0x28>;
              irq-gpios = <&gpio1 10 GPIO_ACTIVE_HIGH>;
              ven-gpios = <&gpio1 11 GPIO_ACTIVE_HIGH>;
          };
      };

compatible: "nxp,pn7160"

include: ["i2c-device.yaml", "nxp,pn7160-common.yaml"]
```

## modules/nfc_pn7160/dts/bindings/nfc/nxp,pn7160-spi.yaml
```yaml
# Copyright (c) 2026
# SPDX-License-Identifier: Apache-2.0

description: |
  NXP PN7160 NFC controller on SPI bus.

  SPI framing (NXP source/TML/tml.c, BOARD_NXPNCI_INTERFACE_SPI):
  - Mode 0 (CPOL=0, CPHA=0), 8-bit, MSB first
  - CS active-low, held for the full transfer (single spi_transceive per segment)
  - Write: one byte 0x7F followed by the NCI/TML payload
  - Read: full-duplex with leading 0xFF dummy; discard first received byte
  - Optional 10 us delay after read segments (NXP reference)

  Default `spi-max-frequency` matches NXP examples (500 kHz); increase only after
  HIL validation.

  Example — SPI on spi21 (adjust bus, CS, and pins for your board):

      &spi21 {
          status = "okay";
          pn7160: pn7160@0 {
              compatible = "nxp,pn7160";
              reg = <0>;
              spi-max-frequency = <500000>;
              irq-gpios = <&gpio1 10 GPIO_ACTIVE_HIGH>;
              ven-gpios = <&gpio1 11 GPIO_ACTIVE_HIGH>;
          };
      };

compatible: "nxp,pn7160"

include: ["spi-device.yaml", "nxp,pn7160-common.yaml"]
```

## modules/nfc_pn7160/tests/unit/pn7160_tml/testcase.yaml
```yaml
tests:
  modules.nfc_pn7160.unit.pn7160_tml:
    tags:
      - ci_unit
      - pn7160
    platform_allow:
      - qemu_cortex_m3
      - native_sim
      - native_sim/native
    integration_platforms:
      - qemu_cortex_m3
```

## modules/nfc_pn7160/zephyr/Kconfig
```kconfig
# NXP PN7160 NFC controller — out-of-tree Zephyr module

DT_COMPAT_NXP_PN7160 := nxp,pn7160

menuconfig PN7160
	bool "NXP PN7160 NFC controller"
	default y
	depends on DT_HAS_NXP_PN7160_ENABLED
	select I2C if $(dt_compat_on_bus,$(DT_COMPAT_NXP_PN7160),i2c)
	select SPI if $(dt_compat_on_bus,$(DT_COMPAT_NXP_PN7160),spi)
	help
	  Enable the PN7160 NFC controller driver, TML framing, and NCI stack.
	  Transport (I2C or SPI) is selected by devicetree — one bus per instance.

if PN7160

config PN7160_TML_I2C
	def_bool $(dt_compat_on_bus,$(DT_COMPAT_NXP_PN7160),i2c)
	help
	  Compile I2C TML backend when any enabled PN7160 instance is on I2C.

config PN7160_TML_SPI
	def_bool $(dt_compat_on_bus,$(DT_COMPAT_NXP_PN7160),spi)
	help
	  Compile SPI TML backend when any enabled PN7160 instance is on SPI.

config PN7160_INIT_PRIORITY
	int "PN7160 driver init priority"
	default 80
	help
	  Device driver initialization priority. Must run after I2C/SPI controller init.

config PN7160_RX_BUF_SIZE
	int "PN7160 RX buffer size"
	default 258
	help
	  Static RX buffer for NCI responses.

config PN7160_WORKQ_STACK_SIZE
	int "PN7160 module work queue stack size"
	default 1024
	help
	  Stack for the module-local work queue that drains HOST_IRQ events.
	  Replaced by nfc_work_q when HAL integration lands (Phase 0.6).

config PN7160_WORKQ_PRIORITY
	int "PN7160 module work queue priority"
	default 5
	help
	  Priority of the module-local PN7160 work queue thread.

config PN7160_SHELL
	bool "PN7160 shell commands"
	default y
	depends on SHELL
	help
	  Register pn7160 shell commands: probe, fwver, init, settings, discovery,
	  reset, xcv (raw NCI transceive), and dwl enter/leave/status.

module = PN7160
module-str = pn7160
source "subsys/logging/Kconfig.template.log_config"

endif # PN7160
```

## src/nfc/Kconfig
```kconfig
# NFC stack — HAL + orchestrators (backend-neutral).

config NFC_STACK
	bool "NFC stack"
	help
	  NFC transport HAL and stack scaffolding. Select a HAL backend
	  (PN7160 reader+listen or NFCT listen-only) in hal/Kconfig.

if NFC_STACK

config NFC_APDU_BUF_SIZE
	int "Inbound APDU net_buf data size (bytes)"
	default 512
	range 64 512
	help
	  Data bytes per FIXED net_buf in the HAL listen path.

config NFC_APDU_POOL_COUNT
	int "Inbound APDU net_buf pool count"
	default 4
	range 1 16
	help
	  Number of FIXED net_bufs for ISR-to-WQ APDU assembly.

rsource "run/Kconfig"
rsource "hal/Kconfig"

# Product profile — bundles roles, orchestrators, store, applets, and protocols
# via `imply` so overlays need only one profile line. Individual symbols stay
# overridable (imply, not select) for size-constrained SKUs. Defaults follow the
# HAL backend: PN7160 reader-only -> READER, NFCT -> CARD_EMULATION, else LAB.
choice NFC_PROFILE
	prompt "NFC product profile"
	default NFC_PROFILE_READER if NFC_HAL_BACKEND_PN7160 && !NFC_ROLE_LISTEN
	default NFC_PROFILE_CARD_EMULATION if NFC_HAL_BACKEND_NRFX
	default NFC_PROFILE_LAB
	help
	  Choose the product role this firmware ships. The profile implies the
	  matching orchestrators, store backend, applets, and protocol set so
	  overlays do not toggle each symbol by hand.

config NFC_PROFILE_READER
	bool "Reader (read / clone / verify)"
	imply NFC_READER
	imply NFC_STORE
	imply NFC_STORE_RAM
	imply NFC_APPLETS
	imply NFC_PROTOCOL_NDEF
	imply NFC_PROTOCOL_ULTRALIGHT
	imply NFC_PROTOCOL_CLASSIC
	imply NFC_PROTOCOL_FELICA
	imply NFC_PROTOCOL_ISO15693_3
	imply NFC_PROTOCOL_SLIX
	imply NFC_PROTOCOL_DESFIRE
	imply NFC_PROTOCOL_EMV
	imply NFC_PROTOCOL_ALIRO
	help
	  PN7160 poller product. Implies the reader engine, RAM store, applets,
	  and every poller protocol. Does NOT imply the listen stack — keep
	  reader-only builds free of NET_BUF + APDU pools by leaving
	  NFC_ROLE_LISTEN=n in the overlay.

config NFC_PROFILE_CARD_EMULATION
	bool "Card emulation (listen + emulate)"
	imply NFC_LISTEN_STACK
	imply NFC_STORE
	imply NFC_STORE_RAM
	imply NFC_PROTOCOL_NDEF
	imply NFC_PROTOCOL_ULTRALIGHT
	imply NFC_PROTOCOL_DESFIRE
	imply NFC_PROTOCOL_EMV
	imply NFC_PROTOCOL_ALIRO
	help
	  Listen + emulate product (PN7160 CE or NFCT). Implies the listen stack
	  (framing + router + NDEF), RAM store, and the emulatable listener
	  protocol subset.

config NFC_PROFILE_LAB
	bool "HAL lab scaffold (HAL + roles only)"
	help
	  HAL bring-up only: backend transport plus role compile paths, no
	  reader engine, store, applets, or protocols. Matches the historical
	  overlay-pn7160-hal.conf contract (reader role on, reader engine off).

endchoice

rsource "protocols/ndef/Kconfig"
rsource "protocols/ultralight/Kconfig"
rsource "protocols/classic/Kconfig"
rsource "protocols/felica/Kconfig"
rsource "protocols/slix/Kconfig"
rsource "protocols/iso15693_3/Kconfig"
rsource "protocols/desfire/Kconfig"
rsource "protocols/emv/Kconfig"
rsource "protocols/aliro/Kconfig"
rsource "store/Kconfig"
rsource "framing/Kconfig"
rsource "router/Kconfig"
rsource "nfc_stack/Kconfig"
rsource "reader/Kconfig"
rsource "applets/Kconfig"

endif
```

## src/nfc/applets/Kconfig
```kconfig
# NFC product applets — Gate 4 scan/read/emulate/verify/loop.

config NFC_APPLETS
	bool "NFC product applets"
	default y
	depends on NFC_READER && NFC_STORE
	help
	  End-user applets composing reader + store + listen stack.
	  See docs/nfc/NFC_APPLETS_AND_TESTING.md.

if NFC_APPLETS

config NFC_APPLETS_SHELL
	bool "NFC applet shell commands"
	default y
	depends on SHELL
	help
	  Register top-level nfc scan (start/stop) / read / emulate / loop /
	  check command adapters (Layer-2). The headless applet service
	  (NFC_APPLETS) carries no shell symbols.

endif
```

## src/nfc/framing/Kconfig
```kconfig
# NFC framing — APDU parse/dispatch shim.

config NFC_FRAMING
	bool "NFC APDU framing layer"
	default n
	depends on NFC_STACK && NFC_ROLE_LISTEN
	help
	  Parse inbound C-APDUs and dispatch to aid_router.

if NFC_FRAMING

config NFC_APDU_EXTENDED_SUPPORT
	bool "Accept extended-length C-APDUs"
	default n

endif
```

## src/nfc/hal/Kconfig
```kconfig
# NFC HAL backend selection.
#
# Overlay matrix (repo root — pair with board/HW overlays as needed):
#   overlay-pn7160-stack.conf   — CONFIG_NFC_HAL_BACKEND_PN7160, reader-only
#   overlay-pn7160-listen.conf   — adds CONFIG_NFC_ROLE_LISTEN + NFC_LISTEN_STACK
#   overlay-nfct-stack.conf     — CONFIG_NFC_HAL_BACKEND_NRFX, listen-only
# Compile-time caps: src/nfc/nfc_config.h (NFC_HAL_IS_*, NFC_HAS_*).

config NFC_HAL_BACKEND_HAS_READER
	bool
	help
	  Hidden: set by reader-capable HAL backends (PN7160).

choice NFC_HAL_BACKEND
	prompt "NFC HAL backend"
	default NFC_HAL_BACKEND_PN7160 if PN7160
	default NFC_HAL_BACKEND_NRFX if NFC_T4T_NRFXLIB
	depends on NFC_STACK

config NFC_HAL_BACKEND_PN7160
	bool "PN7160 NCI (SMART tier)"
	depends on PN7160
	select NFC_HAL_BACKEND_HAS_READER
	help
	  Use the out-of-tree PN7160 Zephyr driver and NCI API.

config NFC_HAL_BACKEND_NRFX
	bool "NFCT T4T (nrfxlib listen-only)"
	depends on NFC_T4T_NRFXLIB
	help
	  On-die NFCT card emulation via nrfxlib nfc_t4t_lib (raw PICC / ISO-DEP).
	  Poll APIs return -ENOTSUP.

endchoice

config NFC_ROLE_READER
	bool "Reader role"
	default y
	depends on NFC_STACK && NFC_HAL_BACKEND_HAS_READER
	help
	  Enable reader-mode discovery and tag transceive APIs.

config NFC_ROLE_LISTEN
	bool "Listen (card emulation) role"
	default y
	depends on NFC_STACK
	select NET_BUF
	help
	  Enable listen sub-API (start/stop/send_response). Gate 1 skeleton on PN7160.

config NFC_HAL_SHELL
	bool "NFC transport HAL shell commands"
	default y
	depends on NFC_STACK && SHELL
	help
	  Register nfc_transport config|stats|state shell subcommands.
```

## src/nfc/nfc_stack/Kconfig
```kconfig
# NFC listen orchestrator.

config NFC_LISTEN_STACK
	bool "NFC listen stack orchestrator"
	default n
	depends on NFC_STACK && NFC_ROLE_LISTEN
	select NFC_FRAMING
	select NFC_ROUTER
	select NFC_PROTOCOL_NDEF
	help
	  Gate 3 listen path: framing, router, NDEF listener registration.

if NFC_LISTEN_STACK

config NFC_STACK_DEFAULT_PROFILE
	int "Default listen profile (nfc_profile_t)"
	default 1
	help
	  1 = NFC_PROFILE_NDEF.

endif
```

## src/nfc/protocols/aliro/Kconfig
```kconfig
# Aliro credential protocol — cookbook §5.6 (F3, PSA deferred listen).

config NFC_PROTOCOL_ALIRO
	bool "Aliro credential protocol"
	default n
	depends on NFC_STACK
	help
	  Aliro expedited AUTH poller/listener with deferred crypto work.

if NFC_PROTOCOL_ALIRO

config NFC_ALIRO_PROTOCOL_VERIFIED
	bool "Aliro wire format verified against spec 0.9.4"
	default n
	help
	  When enabled, listener crypto uses PSA ECDH/HKDF/ECDSA/AES-GCM against
	  Aliro 0.9.4 field order (requires provisioned credential key).
	  When disabled (default), production CI and QEMU builds use deterministic
	  wire vectors from aliro_vectors.h — same code path as
	  tests/common/nfc_aliro_crypto_shim.c.

config NFC_ALIRO_MAX_TRANSCRIPT
	int "Maximum public AUTH transcript bytes"
	default 512
	range 128 1024

endif
```

## src/nfc/protocols/classic/Kconfig
```kconfig
# MIFARE Classic protocol — cookbook §5.3 (F2, clone-only).

config NFC_PROTOCOL_CLASSIC
	bool "MIFARE Classic protocol model"
	default n
	depends on NFC_STACK
	help
	  Classic block data model, TAG-CMD poller, and virtual listener
	  for QEMU loopback. NFCT product emulate remains clone-only.

if NFC_PROTOCOL_CLASSIC

config NFC_CLASSIC_BLOCK_COUNT
	int "Maximum Classic blocks in data model"
	default 256
	range 64 256
	help
	  Largest supported tag (Classic 4K = 256 blocks).

config NFC_CLASSIC_TEST_DETERMINISTIC_NR
	bool "Use fixed NR bytes in poller unit tests"
	default n
	help
	  Deterministic Crypto1 auth for Tier B session-mock fixtures.

endif
```

## src/nfc/protocols/desfire/Kconfig
```kconfig
# MIFARE DESFire protocol — cookbook §5.4 (F3, partial emulatable).

config NFC_PROTOCOL_DESFIRE
	bool "MIFARE DESFire protocol"
	default n
	depends on NFC_STACK
	help
	  DESFire EV1/EV2 model, poller (partial clone), and ISO-DEP listener.

if NFC_PROTOCOL_DESFIRE

config NFC_DESFIRE_MAX_APPS
	int "Maximum applications in card model"
	default 4
	range 1 4

config NFC_DESFIRE_MAX_FILES_PER_APP
	int "Maximum files per application"
	default 8
	range 1 8

config NFC_DESFIRE_MAX_FILE_SIZE
	int "Maximum file payload bytes"
	default 256
	range 16 256

config NFC_DESFIRE_FREE_MEMORY
	int "GetFreeMemory response (bytes)"
	default 7520
	range 0 65535

endif
```

## src/nfc/protocols/emv/Kconfig
```kconfig
# EMV contactless protocol — cookbook §5.5 (F3, partial emulatable).

config NFC_PROTOCOL_EMV
	bool "EMV contactless protocol"
	default n
	depends on NFC_STACK
	help
	  EMV PPSE/GPO/READ RECORD model, poller, and ISO-DEP listener.

if NFC_PROTOCOL_EMV

config NFC_EMV_MAX_RECORDS
	int "Maximum READ RECORD blobs"
	default 2
	range 1 4

config NFC_EMV_RECORD_SIZE
	int "Maximum tag-70 record size"
	default 64
	range 32 128

endif
```

## src/nfc/protocols/felica/Kconfig
```kconfig
# FeliCa protocol — cookbook §5.7 (F4, clone-only).

config NFC_PROTOCOL_FELICA
	bool "FeliCa protocol model"
	default n
	depends on NFC_STACK
	help
	  FeliCa Lite block dump model, poller, and virtual listener for tests.
	  Product RF emulate remains clone-only (ENOTSUP).

if NFC_PROTOCOL_FELICA

config FELICA_BLOCKS_MAX
	int "Maximum FeliCa blocks in data model"
	default 64
	range 16 64

endif
```

## src/nfc/protocols/iso15693_3/Kconfig
```kconfig
# ISO15693-3 protocol — cookbook §5.8 (parent of SLIX).

config NFC_PROTOCOL_ISO15693_3
	bool "ISO15693-3 protocol model"
	default n
	depends on NFC_STACK
	help
	  ISO15693 inventory + block read model (reader only).

if NFC_PROTOCOL_ISO15693_3

config ISO15693_BLOCKS_MAX
	int "Maximum ISO15693 blocks in data model"
	default 256
	range 16 256

config ISO15693_BLOCK_SIZE_MAX
	int "Maximum ISO15693 block size (bytes)"
	default 32
	range 4 32

endif
```

## src/nfc/protocols/ndef/Kconfig
```kconfig
# NDEF protocol — Gate 2 model (cookbook §5.1).

config NFC_PROTOCOL_NDEF
	bool "NDEF Type-4 protocol model"
	default n
	help
	  NDEF data model and serialize/deserialize. Poller/listener are
	  separate Kconfig roles (Gate 2/3).

if NFC_PROTOCOL_NDEF

config NFC_NDEF_MAX_SIZE
	int "Maximum NDEF message payload (bytes)"
	default 500
	range 1 4096
	help
	  Max NLEN value accepted by ndef_deserialize. Matches NXP
	  RW_MAX_NDEF_FILE_SIZE default; product may raise up to 4096.

endif
```

## src/nfc/protocols/slix/Kconfig
```kconfig
# NXP SLIX protocol — cookbook §5.9 (child of ISO15693-3).

config NFC_PROTOCOL_SLIX
	bool "NXP SLIX protocol model"
	default n
	depends on NFC_STACK
	select NFC_PROTOCOL_ISO15693_3
	help
	  SLIX extensions atop ISO15693-3 parent (reader only, clone-only).
```

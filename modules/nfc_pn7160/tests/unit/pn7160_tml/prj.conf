## CMakeLists.txt
```
# Copyright (c) 2026
# SPDX-License-Identifier: Apache-2.0

cmake_minimum_required(VERSION 3.20.0)

list(APPEND ZEPHYR_EXTRA_MODULES
  ${CMAKE_CURRENT_SOURCE_DIR}/../../..
)

set(EXTRA_DTC_OVERLAY_FILE
  ${CMAKE_CURRENT_SOURCE_DIR}/../../../../../boards/overlays/pn7160_unit_test.overlay
  CACHE STRING "" FORCE)

find_package(Zephyr REQUIRED HINTS $ENV{ZEPHYR_BASE})
project(pn7160_tml_unit)

target_sources(app PRIVATE src/main.c)
```

## prj.conf
```kconfig
CONFIG_ZTEST=y
CONFIG_GPIO=y
CONFIG_I2C=y
CONFIG_EMUL=y
CONFIG_PN7160=y
```

## src/main.c
```c
/*
 * Copyright (c) 2026
 * SPDX-License-Identifier: Apache-2.0
 *
 * PN7160 TML framing unit tests (pure helpers, no bus I/O).
 */

#include <nfc/pn7160_tml.h>
#include <nfc/pn7160.h>

#include <zephyr/ztest.h>

ZTEST(pn7160_tml, test_valid_header_frame_len)
{
	const uint8_t hdr[] = { 0x40, 0x00, 0x03 };
	size_t frame_len;

	zassert_equal(pn7160_tml_payload_len_get(hdr), 3U);
	frame_len = pn7160_tml_frame_len_get(hdr);
	zassert_equal(frame_len, 6U);
	zassert_ok(pn7160_tml_frame_len_validate(hdr, 6U));
	zassert_ok(pn7160_tml_frame_len_validate(hdr, 258U));
}

ZTEST(pn7160_tml, test_oversize_reject)
{
	const uint8_t hdr[] = { 0x60, 0x00, 0xFF };

	zassert_equal(pn7160_tml_frame_len_get(hdr), 258U);
	zassert_equal(pn7160_tml_frame_len_validate(hdr, 257U), -EINVAL);
	zassert_equal(pn7160_tml_frame_len_validate(hdr, 100U), -EINVAL);
}

ZTEST(pn7160_tml, test_empty_reject)
{
	const uint8_t hdr[] = { 0x20, 0x00, 0x01 };

	zassert_equal(pn7160_tml_frame_len_validate(hdr, 0U), -EINVAL);
	zassert_equal(pn7160_tml_frame_len_validate(hdr, 2U), -EINVAL);
}

ZTEST(pn7160_tml, test_spi_xfer_lengths)
{
	zassert_equal(PN7160_TML_SPI_WRITE_PREFIX, 0x7FU);
	zassert_equal(PN7160_TML_SPI_READ_DUMMY, 0xFFU);
	zassert_equal(pn7160_tml_spi_write_xfer_len(4U), 5U);
	zassert_equal(pn7160_tml_spi_read_xfer_len(PN7160_TML_NCI_HDR_LEN), 4U);
	zassert_equal(pn7160_tml_spi_read_xfer_len(PN7160_TML_MAX_PAYLOAD_LEN),
		      PN7160_TML_MAX_PAYLOAD_LEN + 1U);
}

ZTEST(pn7160_tml, test_core_reset_ntf_fw_version)
{
	/* Minimal CORE_RESET_NTF layout: indices 9-11 hold FW version. */
	const uint8_t ntf[] = {
		0x60, 0x00, 0x04, 0x00, 0x00, 0x20, 0x00, 0x00, 0x00,
		0x01, 0x02, 0x03,
	};
	uint8_t fw[3];

	zassert_ok(pn7160_nci_core_reset_ntf_fw_version(ntf, sizeof(ntf), fw));
	zassert_equal(fw[0], 0x01U);
	zassert_equal(fw[1], 0x02U);
	zassert_equal(fw[2], 0x03U);
	zassert_equal(pn7160_nci_core_reset_ntf_fw_version(ntf, 11U, fw), -EINVAL);
}

ZTEST(pn7160_tml, test_core_reset_ntf_invalid_oid)
{
	const uint8_t ntf[] = { 0x40, 0x00, 0x04, 0x00, 0x00, 0x20, 0x00, 0x00, 0x00,
				0x01, 0x02, 0x03 };
	uint8_t fw[3];

	zassert_equal(pn7160_nci_core_reset_ntf_fw_version(ntf, sizeof(ntf), fw), -EINVAL);
}

ZTEST(pn7160_tml, test_dwl_framing_helpers)
{
	const uint8_t hdr[] = { 0xA5, 0x04 };
	size_t frame_len;

	zassert_equal(pn7160_tml_header_sz_get(true), PN7160_TML_DWL_HEADER_SZ);
	zassert_equal(pn7160_tml_header_sz_get(false), PN7160_TML_HEADER_SZ);
	zassert_equal(pn7160_tml_footer_sz_get(true), PN7160_TML_DWL_FOOTER_SZ);
	zassert_equal(pn7160_tml_footer_sz_get(false), 0U);
	zassert_equal(pn7160_tml_hdr_read_len_get(true), PN7160_TML_DWL_HDR_LEN);
	zassert_equal(pn7160_tml_hdr_read_len_get(false), PN7160_TML_NCI_HDR_LEN);
	zassert_equal(pn7160_tml_payload_len_get_mode(hdr, true), 0x04U);
	frame_len = pn7160_tml_frame_len_get_mode(hdr, true);
	zassert_equal(frame_len, 6U);
	zassert_ok(pn7160_tml_frame_len_validate_mode(hdr, 6U, true));
	zassert_equal(pn7160_tml_frame_len_validate_mode(hdr, 5U, true), -EINVAL);
}

ZTEST(pn7160_tml, test_dwl_zero_payload)
{
	const uint8_t hdr[] = { 0xA5, 0x00 };

	zassert_equal(pn7160_tml_frame_len_get_mode(hdr, true), PN7160_TML_DWL_HDR_LEN);
	zassert_ok(pn7160_tml_frame_len_validate_mode(hdr, PN7160_TML_DWL_HDR_LEN, true));
}

ZTEST(pn7160_tml, test_core_reset_rsp_validate)
{
	const uint8_t rsp_ok[] = { 0x40, 0x00, 0x03, 0x00 };
	const uint8_t rsp_bad_status[] = { 0x40, 0x00, 0x03, 0x01 };
	const uint8_t rsp_wrong_oid[] = { 0x40, 0x01, 0x03, 0x00 };

	zassert_ok(pn7160_nci_core_reset_rsp_validate(rsp_ok, sizeof(rsp_ok)));
	zassert_equal(pn7160_nci_core_reset_rsp_validate(rsp_ok, 3U), -EINVAL);
	zassert_equal(pn7160_nci_core_reset_rsp_validate(rsp_bad_status, sizeof(rsp_bad_status)),
		      -EIO);
	zassert_equal(pn7160_nci_core_reset_rsp_validate(rsp_wrong_oid, sizeof(rsp_wrong_oid)),
		      -EINVAL);
}

ZTEST_SUITE(pn7160_tml, NULL, NULL, NULL, NULL, NULL);
```

/* Tier B nfc_session_mock RX script — one STEP per transceive */
/* STEP 0: iso select desfire aid */
/* iso select desfire aid */
0x90U, 0x00U,
/* STEP 1: get key version */
/* get key version */
0x00U, 0x91U, 0x00U,
/* STEP 2: get version frame 0 */
/* get version frame 0 */
0x04U, 0x01U, 0x01U, 0x00U, 0x18U, 0x05U, 0x01U, 0x91U,
0xAFU,
/* STEP 3: get version frame 1 */
/* get version frame 1 */
0x04U, 0x01U, 0x01U, 0x00U, 0x18U, 0x05U, 0x01U, 0x91U,
0xAFU,
/* STEP 4: get version frame 2 */
/* get version frame 2 */
0x04U, 0x01U, 0x02U, 0x03U, 0x04U, 0x05U, 0x06U, 0x00U,
0x00U, 0x00U, 0x00U, 0x00U, 0x01U, 0x24U, 0x91U, 0x00U,
/* STEP 5: get free memory */
/* get free memory */
0x60U, 0x1DU, 0x00U, 0x00U, 0x91U, 0x00U,
/* STEP 6: get picc key settings */
/* get picc key settings */
0x0DU, 0x01U, 0x91U, 0x00U,
/* STEP 7: get application ids */
/* get application ids */
0x01U, 0x02U, 0x03U, 0x91U, 0x00U,
/* STEP 8: select app 010203 */
/* select app 010203 */
0x91U, 0x00U,
/* STEP 9: app 010203 key settings */
/* app 010203 key settings */
0x0DU, 0x00U, 0x91U, 0x00U,
/* STEP 10: app 010203 file ids */
/* app 010203 file ids */
0x01U, 0x91U, 0x00U,
/* STEP 11: file 1 settings */
/* file 1 settings */
0x00U, 0x00U, 0x0EU, 0x0EU, 0x0FU, 0x00U, 0x00U, 0x91U,
0x00U,
/* STEP 12: file 1 read data */
/* file 1 read data */
0x48U, 0x45U, 0x4CU, 0x4CU, 0x4FU, 0x20U, 0x44U, 0x45U,
0x53U, 0x46U, 0x49U, 0x52U, 0x45U, 0x21U, 0x21U, 0x91U,
0x00U,

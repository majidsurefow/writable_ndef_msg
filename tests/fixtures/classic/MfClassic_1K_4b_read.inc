/* Tier B nfc_session_mock RX script — one STEP per transceive */
/* STEP 0: classic detect 4k probe fail */
/* classic detect 4k probe fail */
/* STEP 1: classic detect 1k probe nt */
/* classic detect 1k probe nt */
0x20U, 0x00U, 0x00U, 0x3EU,
/* STEP 2: classic AUTH NT sector 0 */
/* classic AUTH NT sector 0 */
0x10U, 0x00U, 0x00U, 0x00U,
/* STEP 3: classic AUTH AT sector 0 */
/* classic AUTH AT sector 0 */
0xFFU, 0xF9U, 0xF4U, 0x82U,
/* STEP 4: classic READ block 0 */
/* classic READ block 0 */
0xD9U, 0x7FU, 0xF1U, 0x68U, 0xF5U, 0x83U, 0xA3U, 0x81U,
0x01U, 0xABU, 0x96U, 0x14U, 0x27U, 0x76U, 0xEDU, 0x74U,
0x63U, 0x40U,
/* STEP 5: classic READ block 1 */
/* classic READ block 1 */
0x46U, 0x39U, 0x89U, 0xEBU, 0xF9U, 0xA9U, 0xBCU, 0x85U,
0x5BU, 0x95U, 0x94U, 0xCFU, 0x88U, 0xACU, 0xD2U, 0x51U,
0x92U, 0xD3U,
/* STEP 6: classic READ block 2 */
/* classic READ block 2 */
0x98U, 0x78U, 0xCEU, 0x52U, 0x1EU, 0xE2U, 0xF2U, 0xB2U,
0x76U, 0x5EU, 0xD0U, 0xE1U, 0x4DU, 0x3CU, 0x7FU, 0x3BU,
0x2BU, 0x3AU,
/* STEP 7: classic READ block 3 */
/* classic READ block 3 */
0x83U, 0x95U, 0xDBU, 0x22U, 0x88U, 0xD3U, 0x04U, 0x24U,
0x20U, 0x42U, 0x24U, 0xABU, 0xE7U, 0x3AU, 0xEBU, 0x9DU,
0xE4U, 0xBEU,
/* STEP 8: classic AUTH NT sector 1 */
/* classic AUTH NT sector 1 */
0x10U, 0x00U, 0x00U, 0x01U,
/* STEP 9: classic AUTH AT sector 1 */
/* classic AUTH AT sector 1 */
0x64U, 0xA4U, 0xC9U, 0x8FU,
/* STEP 10: classic READ block 4 */
/* classic READ block 4 */
0x50U, 0xCEU, 0x0AU, 0x58U, 0x3BU, 0xADU, 0x9AU, 0xEBU,
0xEAU, 0x7EU, 0x32U, 0xA2U, 0xC6U, 0x44U, 0x5BU, 0x7CU,
0x5AU, 0x1BU,
/* STEP 11: classic READ block 5 */
/* classic READ block 5 */
0x03U, 0x15U, 0xACU, 0x55U, 0x3FU, 0xFCU, 0x18U, 0xB7U,
0x07U, 0x67U, 0x4DU, 0x89U, 0x07U, 0x5FU, 0xB1U, 0x5FU,
0x0EU, 0x18U,
/* STEP 12: classic READ block 6 */
/* classic READ block 6 */
0x4FU, 0x5FU, 0x77U, 0x0CU, 0xD7U, 0x76U, 0xEFU, 0xDEU,
0xAFU, 0x79U, 0x8FU, 0xCBU, 0xE5U, 0xF9U, 0x44U, 0x60U,
0x4EU, 0x8AU,
/* STEP 13: classic READ block 7 */
/* classic READ block 7 */
0x02U, 0x7BU, 0xBEU, 0x99U, 0x05U, 0xDCU, 0x7AU, 0x6DU,
0x57U, 0x29U, 0x29U, 0xE9U, 0x9DU, 0xB1U, 0x57U, 0xFFU,
0xB9U, 0x9CU,
/* STEP 14: classic AUTH NT sector 2 */
/* classic AUTH NT sector 2 */
0x10U, 0x00U, 0x00U, 0x02U,
/* STEP 15: classic AUTH AT sector 2 */
/* classic AUTH AT sector 2 */
0x60U, 0xD3U, 0x4EU, 0x57U,
/* STEP 16: classic READ block 8 */
/* classic READ block 8 */
0x61U, 0x84U, 0x57U, 0xFEU, 0x6DU, 0x80U, 0x5AU, 0x52U,
0x21U, 0xBDU, 0x7BU, 0x38U, 0x15U, 0x87U, 0xD8U, 0x2DU,
0x4EU, 0x09U,
/* STEP 17: classic READ block 9 */
/* classic READ block 9 */
0x32U, 0x0EU, 0xE9U, 0x4AU, 0x0DU, 0x83U, 0x92U, 0x4BU,
0xFAU, 0x3FU, 0x7BU, 0x53U, 0xDAU, 0xFFU, 0x31U, 0x07U,
0xA2U, 0x13U,
/* STEP 18: classic READ block 10 */
/* classic READ block 10 */
0xBDU, 0x2DU, 0x5DU, 0xE8U, 0xA4U, 0x3AU, 0xF4U, 0x31U,
0x80U, 0x57U, 0x75U, 0xD8U, 0xF6U, 0x5CU, 0x45U, 0x54U,
0xA4U, 0x93U,
/* STEP 19: classic READ block 11 */
/* classic READ block 11 */
0x02U, 0xFDU, 0xB6U, 0xBAU, 0x86U, 0xF2U, 0xC2U, 0xC4U,
0x5DU, 0xF3U, 0x8EU, 0x37U, 0x49U, 0x4BU, 0xAFU, 0x59U,
0xFCU, 0xC2U,
/* STEP 20: classic AUTH NT sector 3 */
/* classic AUTH NT sector 3 */
0x10U, 0x00U, 0x00U, 0x03U,
/* STEP 21: classic AUTH AT sector 3 */
/* classic AUTH AT sector 3 */
0xB8U, 0x66U, 0x0DU, 0xFBU,
/* STEP 22: classic READ block 12 */
/* classic READ block 12 */
0x0EU, 0x18U, 0x63U, 0x24U, 0x1FU, 0x43U, 0xA5U, 0x11U,
0x98U, 0xD8U, 0x47U, 0x20U, 0x99U, 0x5FU, 0x64U, 0xF0U,
0x85U, 0x58U,
/* STEP 23: classic READ block 13 */
/* classic READ block 13 */
0x82U, 0xCAU, 0xACU, 0x9DU, 0x7BU, 0xB8U, 0x81U, 0x10U,
0x6CU, 0x15U, 0xA1U, 0xA1U, 0x84U, 0x66U, 0x12U, 0x84U,
0xFBU, 0x1AU,
/* STEP 24: classic READ block 14 */
/* classic READ block 14 */
0xABU, 0x24U, 0xA3U, 0xAEU, 0x50U, 0x33U, 0xDBU, 0xF1U,
0xF2U, 0xCDU, 0x13U, 0xCDU, 0x85U, 0x75U, 0xF2U, 0x12U,
0x80U, 0x74U,
/* STEP 25: classic READ block 15 */
/* classic READ block 15 */
0x3CU, 0x37U, 0x37U, 0x94U, 0x9FU, 0x93U, 0xA8U, 0x15U,
0xD8U, 0x0DU, 0xA9U, 0x01U, 0x48U, 0x3DU, 0x67U, 0x28U,
0xD9U, 0x02U,
/* STEP 26: classic AUTH NT sector 4 */
/* classic AUTH NT sector 4 */
0x10U, 0x00U, 0x00U, 0x04U,
/* STEP 27: classic AUTH AT sector 4 */
/* classic AUTH AT sector 4 */
0xCCU, 0x6EU, 0xD3U, 0x6BU,
/* STEP 28: classic READ block 16 */
/* classic READ block 16 */
0x50U, 0xDCU, 0xBAU, 0xFDU, 0xD0U, 0x91U, 0x16U, 0x1CU,
0x08U, 0x47U, 0x2CU, 0x49U, 0xD7U, 0x31U, 0x6CU, 0xF1U,
0xE3U, 0xFFU,
/* STEP 29: classic READ block 17 */
/* classic READ block 17 */
0x00U, 0xBAU, 0x8AU, 0x94U, 0xD8U, 0x65U, 0x69U, 0x45U,
0x5BU, 0xB8U, 0x0BU, 0x8AU, 0xFCU, 0xCAU, 0xC7U, 0x6CU,
0xA1U, 0x72U,
/* STEP 30: classic READ block 18 */
/* classic READ block 18 */
0xA5U, 0xE0U, 0xB5U, 0xE9U, 0xB3U, 0x27U, 0xECU, 0x20U,
0x21U, 0x2DU, 0x0AU, 0xD7U, 0x1CU, 0x2AU, 0x0CU, 0x88U,
0x6EU, 0x95U,
/* STEP 31: classic READ block 19 */
/* classic READ block 19 */
0xE9U, 0x89U, 0xA3U, 0x61U, 0x8DU, 0xD8U, 0x03U, 0x42U,
0x58U, 0x46U, 0xFFU, 0x46U, 0x57U, 0xFFU, 0x13U, 0xD0U,
0xFAU, 0x4AU,
/* STEP 32: classic AUTH NT sector 5 */
/* classic AUTH NT sector 5 */
0x10U, 0x00U, 0x00U, 0x05U,
/* STEP 33: classic AUTH AT sector 5 */
/* classic AUTH AT sector 5 */
0x46U, 0x26U, 0x1BU, 0xCAU,
/* STEP 34: classic READ block 20 */
/* classic READ block 20 */
0x5FU, 0xD3U, 0xF5U, 0xCCU, 0x99U, 0xB0U, 0x08U, 0x39U,
0x78U, 0x2CU, 0xBFU, 0xCEU, 0x6FU, 0xACU, 0x1CU, 0x34U,
0xADU, 0x5BU,
/* STEP 35: classic READ block 21 */
/* classic READ block 21 */
0x57U, 0x96U, 0x9EU, 0x3BU, 0x78U, 0x8DU, 0x32U, 0x45U,
0xDCU, 0xFFU, 0xA1U, 0xADU, 0xFCU, 0xFBU, 0xE0U, 0x46U,
0xD3U, 0x53U,
/* STEP 36: classic READ block 22 */
/* classic READ block 22 */
0xABU, 0xC4U, 0x16U, 0xFBU, 0x97U, 0x56U, 0xB7U, 0xAFU,
0x1CU, 0x10U, 0x75U, 0xE7U, 0x59U, 0x94U, 0x9AU, 0x69U,
0x81U, 0xD3U,
/* STEP 37: classic READ block 23 */
/* classic READ block 23 */
0x16U, 0xB9U, 0xD2U, 0xB4U, 0x9CU, 0xD5U, 0x8AU, 0xCFU,
0x8AU, 0x5AU, 0x1CU, 0x0AU, 0x7CU, 0x00U, 0x28U, 0xF6U,
0xEBU, 0x87U,
/* STEP 38: classic AUTH NT sector 6 */
/* classic AUTH NT sector 6 */
0x10U, 0x00U, 0x00U, 0x06U,
/* STEP 39: classic AUTH AT sector 6 */
/* classic AUTH AT sector 6 */
0xCAU, 0xD4U, 0xB3U, 0xE1U,
/* STEP 40: classic READ block 24 */
/* classic READ block 24 */
0xEEU, 0x92U, 0xD7U, 0x16U, 0xB5U, 0x94U, 0x3DU, 0x8DU,
0xDCU, 0x69U, 0xCDU, 0x95U, 0x65U, 0xEDU, 0x81U, 0xE2U,
0x07U, 0xDFU,
/* STEP 41: classic READ block 25 */
/* classic READ block 25 */
0x84U, 0x65U, 0xA1U, 0x4CU, 0x6FU, 0x50U, 0xA0U, 0x4BU,
0x68U, 0xC8U, 0x7CU, 0x61U, 0xA4U, 0x18U, 0x9EU, 0x2FU,
0x04U, 0x4EU,
/* STEP 42: classic READ block 26 */
/* classic READ block 26 */
0x4CU, 0x04U, 0xA4U, 0x8EU, 0x1DU, 0xA1U, 0x84U, 0x4AU,
0x2BU, 0x8CU, 0x03U, 0xFFU, 0x2EU, 0x23U, 0xBFU, 0xE1U,
0x30U, 0xD2U,
/* STEP 43: classic READ block 27 */
/* classic READ block 27 */
0x4CU, 0x67U, 0xA5U, 0xE7U, 0xD7U, 0x2BU, 0x96U, 0xC5U,
0x22U, 0x9BU, 0x78U, 0x61U, 0x30U, 0x8EU, 0x22U, 0xB2U,
0xCCU, 0x68U,
/* STEP 44: classic AUTH NT sector 7 */
/* classic AUTH NT sector 7 */
0x10U, 0x00U, 0x00U, 0x07U,
/* STEP 45: classic AUTH AT sector 7 */
/* classic AUTH AT sector 7 */
0xB6U, 0x7AU, 0x19U, 0x01U,
/* STEP 46: classic READ block 28 */
/* classic READ block 28 */
0xD1U, 0xBEU, 0x81U, 0xB4U, 0x22U, 0x52U, 0x79U, 0x32U,
0x06U, 0x1CU, 0x8EU, 0x30U, 0x8DU, 0x43U, 0xE5U, 0xCAU,
0x42U, 0x75U,
/* STEP 47: classic READ block 29 */
/* classic READ block 29 */
0xA4U, 0x1FU, 0x8EU, 0xBAU, 0x30U, 0x0EU, 0x32U, 0x21U,
0xCCU, 0x50U, 0xE9U, 0x19U, 0xFBU, 0xACU, 0xA1U, 0x9FU,
0x23U, 0x1FU,
/* STEP 48: classic READ block 30 */
/* classic READ block 30 */
0xC8U, 0x26U, 0xBBU, 0x48U, 0x8DU, 0x2CU, 0x75U, 0xD9U,
0xACU, 0xE5U, 0x81U, 0x93U, 0x81U, 0x33U, 0x4BU, 0x89U,
0x28U, 0xE3U,
/* STEP 49: classic READ block 31 */
/* classic READ block 31 */
0xECU, 0x95U, 0xF0U, 0xFAU, 0x50U, 0x16U, 0x75U, 0x01U,
0xD9U, 0x4FU, 0x10U, 0xF8U, 0xBEU, 0xDEU, 0xEFU, 0x3AU,
0x0FU, 0xFFU,
/* STEP 50: classic AUTH NT sector 8 */
/* classic AUTH NT sector 8 */
0x10U, 0x00U, 0x00U, 0x08U,
/* STEP 51: classic AUTH AT sector 8 */
/* classic AUTH AT sector 8 */
0x11U, 0xF3U, 0x8CU, 0xD3U,
/* STEP 52: classic READ block 32 */
/* classic READ block 32 */
0x55U, 0x34U, 0x4EU, 0x1CU, 0x26U, 0x7DU, 0x8BU, 0x6CU,
0x83U, 0xD3U, 0xE1U, 0xFDU, 0x28U, 0xBDU, 0xD1U, 0xB7U,
0x8CU, 0xEFU,
/* STEP 53: classic READ block 33 */
/* classic READ block 33 */
0x1FU, 0x70U, 0x63U, 0x7BU, 0xD0U, 0x6AU, 0x6FU, 0x89U,
0x04U, 0xB1U, 0x15U, 0xE2U, 0x3EU, 0x98U, 0xF0U, 0x67U,
0x46U, 0xDBU,
/* STEP 54: classic READ block 34 */
/* classic READ block 34 */
0x78U, 0x39U, 0x7DU, 0xA2U, 0xDDU, 0xF8U, 0x24U, 0x4FU,
0xC9U, 0x80U, 0x6DU, 0xA5U, 0x7FU, 0x22U, 0xE7U, 0xFEU,
0x92U, 0x2FU,
/* STEP 55: classic READ block 35 */
/* classic READ block 35 */
0x7CU, 0x89U, 0x93U, 0x10U, 0xD9U, 0x94U, 0xC8U, 0x45U,
0x53U, 0xB8U, 0x9AU, 0xFCU, 0xEAU, 0x5BU, 0x7AU, 0x5CU,
0xE3U, 0x4EU,
/* STEP 56: classic AUTH NT sector 9 */
/* classic AUTH NT sector 9 */
0x10U, 0x00U, 0x00U, 0x09U,
/* STEP 57: classic AUTH AT sector 9 */
/* classic AUTH AT sector 9 */
0x71U, 0x0FU, 0xC3U, 0x2FU,
/* STEP 58: classic READ block 36 */
/* classic READ block 36 */
0x18U, 0xA3U, 0xB8U, 0x91U, 0xCBU, 0xA2U, 0x97U, 0xAAU,
0x8AU, 0x05U, 0xDBU, 0xD1U, 0x35U, 0x50U, 0xF2U, 0xA4U,
0xE5U, 0xDEU,
/* STEP 59: classic READ block 37 */
/* classic READ block 37 */
0x0CU, 0x1AU, 0xF9U, 0x8CU, 0x5FU, 0x3AU, 0x47U, 0xC7U,
0x7BU, 0x68U, 0xDEU, 0x93U, 0x9BU, 0x70U, 0x10U, 0xA8U,
0xAAU, 0x13U,
/* STEP 60: classic READ block 38 */
/* classic READ block 38 */
0x7DU, 0xBFU, 0x8CU, 0x67U, 0xCFU, 0x6AU, 0x7BU, 0x36U,
0x3AU, 0x12U, 0xA6U, 0xA6U, 0x33U, 0xE4U, 0x98U, 0x00U,
0xDFU, 0xA1U,
/* STEP 61: classic READ block 39 */
/* classic READ block 39 */
0x0BU, 0xB5U, 0x69U, 0xDAU, 0x96U, 0x50U, 0x10U, 0xCEU,
0x5FU, 0xABU, 0xB9U, 0xB8U, 0x8CU, 0xCDU, 0x47U, 0x51U,
0xEFU, 0x19U,
/* STEP 62: classic AUTH NT sector 10 */
/* classic AUTH NT sector 10 */
0x10U, 0x00U, 0x00U, 0x0AU,
/* STEP 63: classic AUTH AT sector 10 */
/* classic AUTH AT sector 10 */
0xD4U, 0x19U, 0xCBU, 0x5EU,
/* STEP 64: classic READ block 40 */
/* classic READ block 40 */
0x34U, 0xA3U, 0x9FU, 0x97U, 0xAFU, 0x09U, 0xB9U, 0x4BU,
0x05U, 0x59U, 0x99U, 0xEBU, 0x18U, 0x4DU, 0x58U, 0x92U,
0x44U, 0x2CU,
/* STEP 65: classic READ block 41 */
/* classic READ block 41 */
0xF2U, 0x01U, 0xACU, 0x35U, 0x62U, 0xB9U, 0x2CU, 0xC0U,
0x74U, 0x14U, 0xA5U, 0xD0U, 0xC4U, 0xBBU, 0xC4U, 0xCDU,
0xC9U, 0x87U,
/* STEP 66: classic READ block 42 */
/* classic READ block 42 */
0xD9U, 0x3CU, 0xCBU, 0x97U, 0xF5U, 0xADU, 0x2EU, 0x99U,
0xFAU, 0xF3U, 0xF1U, 0x26U, 0x71U, 0xB2U, 0xDEU, 0xA5U,
0xE8U, 0x37U,
/* STEP 67: classic READ block 43 */
/* classic READ block 43 */
0x5AU, 0xD0U, 0xC6U, 0x42U, 0x8AU, 0x52U, 0x79U, 0xEEU,
0x00U, 0x7CU, 0x8FU, 0x9AU, 0x00U, 0x7FU, 0x53U, 0xDEU,
0x59U, 0xDAU,
/* STEP 68: classic AUTH NT sector 11 */
/* classic AUTH NT sector 11 */
0x10U, 0x00U, 0x00U, 0x0BU,
/* STEP 69: classic AUTH AT sector 11 */
/* classic AUTH AT sector 11 */
0x5EU, 0x73U, 0xF9U, 0x36U,
/* STEP 70: classic READ block 44 */
/* classic READ block 44 */
0xECU, 0x13U, 0xCCU, 0x6EU, 0xD7U, 0xA1U, 0x40U, 0x2DU,
0xBDU, 0x34U, 0xE6U, 0xD9U, 0x69U, 0xB0U, 0x4BU, 0x71U,
0x8DU, 0x18U,
/* STEP 71: classic READ block 45 */
/* classic READ block 45 */
0xCAU, 0x4BU, 0x4BU, 0x0DU, 0xA2U, 0x2BU, 0x3EU, 0x32U,
0x24U, 0x8EU, 0x24U, 0xB5U, 0x41U, 0xFEU, 0xADU, 0x44U,
0x9FU, 0x67U,
/* STEP 72: classic READ block 46 */
/* classic READ block 46 */
0x8EU, 0xD8U, 0xF5U, 0x08U, 0xAFU, 0x9DU, 0x11U, 0x1FU,
0xBDU, 0x8EU, 0x2AU, 0x98U, 0x83U, 0x50U, 0xA6U, 0x71U,
0xD2U, 0xD9U,
/* STEP 73: classic READ block 47 */
/* classic READ block 47 */
0xDDU, 0x78U, 0xB2U, 0x42U, 0x84U, 0x2CU, 0x39U, 0x54U,
0x70U, 0x92U, 0xC5U, 0x61U, 0x00U, 0x5CU, 0xDEU, 0x69U,
0xA8U, 0xD7U,
/* STEP 74: classic AUTH NT sector 12 */
/* classic AUTH NT sector 12 */
0x10U, 0x00U, 0x00U, 0x0CU,
/* STEP 75: classic AUTH AT sector 12 */
/* classic AUTH AT sector 12 */
0xA8U, 0xF9U, 0xE2U, 0x6BU,
/* STEP 76: classic READ block 48 */
/* classic READ block 48 */
0xB8U, 0xA9U, 0xE8U, 0xBFU, 0x7CU, 0x66U, 0x79U, 0x7CU,
0x54U, 0x1FU, 0x99U, 0x90U, 0x75U, 0x73U, 0x80U, 0x1BU,
0x37U, 0x13U,
/* STEP 77: classic READ block 49 */
/* classic READ block 49 */
0x1BU, 0xEBU, 0xECU, 0x51U, 0x6CU, 0xFAU, 0xA0U, 0x84U,
0x27U, 0xAAU, 0x85U, 0x8FU, 0xD9U, 0xC3U, 0xB6U, 0x6BU,
0xD0U, 0x19U,
/* STEP 78: classic READ block 50 */
/* classic READ block 50 */
0x91U, 0xF9U, 0x4AU, 0xF6U, 0x70U, 0x37U, 0xC8U, 0xA5U,
0xDBU, 0x63U, 0x45U, 0x20U, 0xA1U, 0xEFU, 0xABU, 0x29U,
0xF3U, 0x50U,
/* STEP 79: classic READ block 51 */
/* classic READ block 51 */
0x7CU, 0xF9U, 0x19U, 0x18U, 0xCAU, 0x98U, 0x10U, 0x2EU,
0xD0U, 0x5EU, 0xBAU, 0x48U, 0x07U, 0x06U, 0xA7U, 0x07U,
0x93U, 0x3EU,
/* STEP 80: classic AUTH NT sector 13 */
/* classic AUTH NT sector 13 */
0x10U, 0x00U, 0x00U, 0x0DU,
/* STEP 81: classic AUTH AT sector 13 */
/* classic AUTH AT sector 13 */
0xE0U, 0x11U, 0x98U, 0x5EU,
/* STEP 82: classic READ block 52 */
/* classic READ block 52 */
0x9CU, 0xEBU, 0xCEU, 0x5EU, 0x16U, 0x97U, 0x55U, 0x95U,
0xFEU, 0x8FU, 0x85U, 0x16U, 0xA3U, 0x6DU, 0xE1U, 0xB5U,
0x0CU, 0x42U,
/* STEP 83: classic READ block 53 */
/* classic READ block 53 */
0x49U, 0xE0U, 0xDAU, 0xFCU, 0x5AU, 0x25U, 0x05U, 0x4DU,
0xABU, 0x2FU, 0xCDU, 0x2AU, 0x51U, 0x9FU, 0x14U, 0xB2U,
0x58U, 0x06U,
/* STEP 84: classic READ block 54 */
/* classic READ block 54 */
0x77U, 0xD4U, 0xEBU, 0xAFU, 0x0FU, 0x5CU, 0x09U, 0x07U,
0x6FU, 0x71U, 0x43U, 0xD9U, 0x3CU, 0xD2U, 0xE9U, 0x5EU,
0x93U, 0x07U,
/* STEP 85: classic READ block 55 */
/* classic READ block 55 */
0x25U, 0x2AU, 0xDDU, 0x07U, 0xB6U, 0x54U, 0x0BU, 0xBCU,
0x30U, 0x2AU, 0xA1U, 0x81U, 0x68U, 0xA5U, 0xBDU, 0xC0U,
0xBDU, 0xACU,
/* STEP 86: classic AUTH NT sector 14 */
/* classic AUTH NT sector 14 */
0x10U, 0x00U, 0x00U, 0x0EU,
/* STEP 87: classic AUTH AT sector 14 */
/* classic AUTH AT sector 14 */
0x47U, 0xC3U, 0x05U, 0xF3U,
/* STEP 88: classic READ block 56 */
/* classic READ block 56 */
0xA2U, 0x41U, 0x22U, 0x2FU, 0x1AU, 0xC5U, 0x47U, 0x13U,
0xE5U, 0x08U, 0x5AU, 0x4CU, 0x85U, 0xD7U, 0x5EU, 0x0BU,
0xEEU, 0xDAU,
/* STEP 89: classic READ block 57 */
/* classic READ block 57 */
0x84U, 0xA7U, 0x76U, 0x47U, 0xC6U, 0x1DU, 0x0DU, 0xACU,
0x51U, 0x50U, 0xF0U, 0x44U, 0x3AU, 0xE6U, 0xECU, 0x14U,
0x2BU, 0x5FU,
/* STEP 90: classic READ block 58 */
/* classic READ block 58 */
0xE5U, 0xE5U, 0x83U, 0x26U, 0x34U, 0xA5U, 0x70U, 0x36U,
0x3FU, 0x1DU, 0x31U, 0x77U, 0x8AU, 0xA1U, 0x4AU, 0x1EU,
0x17U, 0xB9U,
/* STEP 91: classic READ block 59 */
/* classic READ block 59 */
0x1FU, 0x75U, 0x2BU, 0xFDU, 0x11U, 0x9AU, 0xF9U, 0xE2U,
0x04U, 0xB6U, 0xB9U, 0x4AU, 0xC8U, 0x0CU, 0x29U, 0x99U,
0xCCU, 0x5EU,
/* STEP 92: classic AUTH NT sector 15 */
/* classic AUTH NT sector 15 */
0x10U, 0x00U, 0x00U, 0x0FU,
/* STEP 93: classic AUTH AT sector 15 */
/* classic AUTH AT sector 15 */
0x29U, 0x4BU, 0x79U, 0xEDU,
/* STEP 94: classic READ block 60 */
/* classic READ block 60 */
0x00U, 0x9FU, 0xA0U, 0x96U, 0x4BU, 0x91U, 0xB7U, 0xC9U,
0xBFU, 0xCFU, 0xB4U, 0xC7U, 0xB8U, 0xFEU, 0x1DU, 0xF7U,
0xA7U, 0xDEU,
/* STEP 95: classic READ block 61 */
/* classic READ block 61 */
0x7BU, 0xECU, 0x5AU, 0x4DU, 0xB8U, 0xBEU, 0xFDU, 0xB9U,
0xBCU, 0x7EU, 0xFEU, 0x3CU, 0x99U, 0xC9U, 0x3FU, 0x43U,
0x66U, 0x62U,
/* STEP 96: classic READ block 62 */
/* classic READ block 62 */
0x56U, 0x9AU, 0x84U, 0x9EU, 0xBAU, 0xCFU, 0xA4U, 0x9CU,
0x45U, 0xEFU, 0x27U, 0xFDU, 0xADU, 0x77U, 0xB6U, 0x40U,
0xE4U, 0xB7U,
/* STEP 97: classic READ block 63 */
/* classic READ block 63 */
0x74U, 0x7AU, 0xFEU, 0x0AU, 0x17U, 0x97U, 0xC4U, 0x5BU,
0x54U, 0x58U, 0x69U, 0x55U, 0x79U, 0x7CU, 0xBDU, 0xE1U,
0xE1U, 0xEEU,

/* Tier B poller TX golden — one STEP per transceive */
/* STEP 0: classic detect 4k probe fail */
/* classic detect 4k probe fail */
0x60U, 0xFEU,
/* STEP 1: classic detect 1k probe fail */
/* classic detect 1k probe fail */
0x60U, 0x3EU,
/* STEP 2: classic AUTH NT sector 0 */
/* classic AUTH NT sector 0 */
0x60U, 0x00U,
/* STEP 3: classic AUTH NR|AR sector 0 */
/* classic AUTH NR|AR sector 0 */
0xD3U, 0x4CU, 0x69U, 0x8CU, 0xD0U, 0xF7U, 0xFEU, 0xF8U,
/* STEP 4: classic READ block 0 */
/* classic READ block 0 */
0x53U, 0xC7U, 0x2CU, 0xFEU,
/* STEP 5: classic READ block 1 */
/* classic READ block 1 */
0x31U, 0x7CU, 0xE7U, 0x5DU,
/* STEP 6: classic READ block 2 */
/* classic READ block 2 */
0x78U, 0x4EU, 0x89U, 0x7CU,
/* STEP 7: classic READ block 3 */
/* classic READ block 3 */
0x56U, 0xBFU, 0x57U, 0xCEU,
/* STEP 8: classic AUTH NT sector 1 */
/* classic AUTH NT sector 1 */
0x60U, 0x04U,
/* STEP 9: classic AUTH NR|AR sector 1 */
/* classic AUTH NR|AR sector 1 */
0x11U, 0x66U, 0x04U, 0x20U, 0x9BU, 0xD9U, 0x63U, 0x0DU,
/* STEP 10: classic READ block 4 */
/* classic READ block 4 */
0x0EU, 0xABU, 0x9FU, 0xB1U,
/* STEP 11: classic READ block 5 */
/* classic READ block 5 */
0x02U, 0xCDU, 0x64U, 0xF3U,
/* STEP 12: classic READ block 6 */
/* classic READ block 6 */
0xF3U, 0x91U, 0x41U, 0xC6U,
/* STEP 13: classic READ block 7 */
/* classic READ block 7 */
0x21U, 0x93U, 0x85U, 0x4AU,
/* STEP 14: classic AUTH NT sector 2 */
/* classic AUTH NT sector 2 */
0x60U, 0x08U,
/* STEP 15: classic AUTH NR|AR sector 2 */
/* classic AUTH NR|AR sector 2 */
0xD1U, 0xF9U, 0x15U, 0x68U, 0x7AU, 0x31U, 0x66U, 0xD8U,
/* STEP 16: classic READ block 8 */
/* classic READ block 8 */
0x0CU, 0x31U, 0x9FU, 0x0AU,
/* STEP 17: classic READ block 9 */
/* classic READ block 9 */
0x6AU, 0x38U, 0xEAU, 0x98U,
/* STEP 18: classic READ block 10 */
/* classic READ block 10 */
0x04U, 0x1DU, 0xA1U, 0x63U,
/* STEP 19: classic READ block 11 */
/* classic READ block 11 */
0xEAU, 0xEEU, 0x93U, 0x61U,
/* STEP 20: classic AUTH NT sector 3 */
/* classic AUTH NT sector 3 */
0x60U, 0x0CU,
/* STEP 21: classic AUTH NR|AR sector 3 */
/* classic AUTH NR|AR sector 3 */
0x93U, 0x51U, 0x4EU, 0x57U, 0x64U, 0xF4U, 0xD5U, 0xEBU,
/* STEP 22: classic READ block 12 */
/* classic READ block 12 */
0x8FU, 0x4FU, 0x30U, 0xC4U,
/* STEP 23: classic READ block 13 */
/* classic READ block 13 */
0xC8U, 0x12U, 0x6EU, 0x58U,
/* STEP 24: classic READ block 14 */
/* classic READ block 14 */
0x42U, 0x74U, 0x04U, 0x86U,
/* STEP 25: classic READ block 15 */
/* classic READ block 15 */
0xC2U, 0x3EU, 0x64U, 0x23U,
/* STEP 26: classic AUTH NT sector 4 */
/* classic AUTH NT sector 4 */
0x60U, 0x10U,
/* STEP 27: classic AUTH NR|AR sector 4 */
/* classic AUTH NR|AR sector 4 */
0xD3U, 0xD3U, 0x39U, 0x6DU, 0x8DU, 0x29U, 0x0BU, 0xBEU,
/* STEP 28: classic READ block 16 */
/* classic READ block 16 */
0xBAU, 0x9DU, 0x4AU, 0x30U,
/* STEP 29: classic READ block 17 */
/* classic READ block 17 */
0xB8U, 0x09U, 0xE0U, 0x2BU,
/* STEP 30: classic READ block 18 */
/* classic READ block 18 */
0x79U, 0xD8U, 0x0CU, 0xE0U,
/* STEP 31: classic READ block 19 */
/* classic READ block 19 */
0x7CU, 0xA0U, 0x79U, 0x82U,

/* Tier B nfc_session_mock RX script — one STEP per transceive */
/* STEP 0: classic detect 4k probe fail */
/* classic detect 4k probe fail */
/* STEP 1: classic detect 1k probe fail */
/* classic detect 1k probe fail */
/* STEP 2: classic AUTH NT sector 0 */
/* classic AUTH NT sector 0 */
0x10U, 0x00U, 0x00U, 0x00U,
/* STEP 3: classic AUTH NR|AR sector 0 */
/* classic AUTH NR|AR sector 0 */
0x9AU, 0xC9U, 0x81U, 0x14U,
/* STEP 4: classic READ block 0 */
/* classic READ block 0 */
0x78U, 0xF7U, 0x3FU, 0xDEU, 0x6AU, 0x1FU, 0xA6U, 0x70U,
0x84U, 0x12U, 0x58U, 0xD0U, 0x5AU, 0x75U, 0x17U, 0xA8U,
0x52U, 0x6CU,
/* STEP 5: classic READ block 1 */
/* classic READ block 1 */
0x6AU, 0x05U, 0xD0U, 0xCFU, 0x21U, 0x9DU, 0x6AU, 0x2AU,
0x38U, 0x26U, 0xAEU, 0xCCU, 0x6AU, 0xABU, 0xB9U, 0x59U,
0xC4U, 0xB2U,
/* STEP 6: classic READ block 2 */
/* classic READ block 2 */
0xD1U, 0x3FU, 0x43U, 0x63U, 0x78U, 0x4CU, 0x73U, 0xE2U,
0x6CU, 0xFAU, 0x09U, 0xC6U, 0x15U, 0x7AU, 0xCCU, 0x85U,
0x7FU, 0x49U,
/* STEP 7: classic READ block 3 */
/* classic READ block 3 */
0xA8U, 0x98U, 0x9BU, 0xF7U, 0x19U, 0x68U, 0xCBU, 0xB3U,
0xF0U, 0x5CU, 0xDEU, 0x77U, 0x49U, 0x54U, 0x7AU, 0x19U,
0x5BU, 0xCBU,
/* STEP 8: classic AUTH NT sector 1 */
/* classic AUTH NT sector 1 */
0x10U, 0x00U, 0x00U, 0x01U,
/* STEP 9: classic AUTH NR|AR sector 1 */
/* classic AUTH NR|AR sector 1 */
0x08U, 0x76U, 0x12U, 0x20U,
/* STEP 10: classic READ block 4 */
/* classic READ block 4 */
0xB0U, 0xC3U, 0x38U, 0xBDU, 0x15U, 0x06U, 0x14U, 0x9BU,
0x24U, 0x80U, 0xFCU, 0x7EU, 0x27U, 0x7EU, 0x62U, 0x5DU,
0x6EU, 0xA6U,
/* STEP 11: classic READ block 5 */
/* classic READ block 5 */
0xD8U, 0x42U, 0xFBU, 0x9AU, 0x83U, 0xD3U, 0xD7U, 0xA5U,
0xBFU, 0x2CU, 0x23U, 0xB7U, 0x96U, 0x3EU, 0x8DU, 0xA4U,
0xB8U, 0x36U,
/* STEP 12: classic READ block 6 */
/* classic READ block 6 */
0x95U, 0x9EU, 0xC6U, 0x97U, 0xF6U, 0x25U, 0x96U, 0xCBU,
0xB3U, 0x46U, 0xC3U, 0x08U, 0x30U, 0x05U, 0xAFU, 0x2CU,
0x36U, 0x76U,
/* STEP 13: classic READ block 7 */
/* classic READ block 7 */
0x1BU, 0x97U, 0x05U, 0xE0U, 0x52U, 0xB4U, 0xC0U, 0xB6U,
0xCBU, 0x84U, 0x5EU, 0xA1U, 0x72U, 0xAFU, 0x32U, 0x0CU,
0x9BU, 0x15U,
/* STEP 14: classic AUTH NT sector 2 */
/* classic AUTH NT sector 2 */
0x10U, 0x00U, 0x00U, 0x02U,
/* STEP 15: classic AUTH NR|AR sector 2 */
/* classic AUTH NR|AR sector 2 */
0x20U, 0x7CU, 0x07U, 0x45U,
/* STEP 16: classic READ block 8 */
/* classic READ block 8 */
0x33U, 0x18U, 0x56U, 0xBFU, 0x90U, 0x80U, 0x20U, 0xE1U,
0x87U, 0x46U, 0x03U, 0xE6U, 0x58U, 0x2DU, 0xCDU, 0x0AU,
0xE9U, 0x8DU,
/* STEP 17: classic READ block 9 */
/* classic READ block 9 */
0x57U, 0xCCU, 0xFAU, 0xA4U, 0x17U, 0xE3U, 0x8FU, 0x49U,
0x1EU, 0x02U, 0x47U, 0x1CU, 0x11U, 0x60U, 0xF8U, 0xF1U,
0x54U, 0x77U,
/* STEP 18: classic READ block 10 */
/* classic READ block 10 */
0x21U, 0x72U, 0x89U, 0xFCU, 0x9BU, 0x9EU, 0xB6U, 0x5CU,
0x96U, 0xE2U, 0xAEU, 0xD2U, 0xA2U, 0x86U, 0x2AU, 0x97U,
0xD2U, 0x37U,
/* STEP 19: classic READ block 11 */
/* classic READ block 11 */
0x94U, 0x45U, 0xB9U, 0x3EU, 0x9BU, 0x61U, 0x70U, 0x11U,
0x5AU, 0xB5U, 0x22U, 0x20U, 0xF8U, 0x3FU, 0xC6U, 0xC9U,
0xE1U, 0xADU,
/* STEP 20: classic AUTH NT sector 3 */
/* classic AUTH NT sector 3 */
0x10U, 0x00U, 0x00U, 0x03U,
/* STEP 21: classic AUTH NR|AR sector 3 */
/* classic AUTH NR|AR sector 3 */
0xC8U, 0xCBU, 0x6CU, 0xFAU,
/* STEP 22: classic READ block 12 */
/* classic READ block 12 */
0x56U, 0x49U, 0x0DU, 0x57U, 0x93U, 0x1EU, 0x4FU, 0x29U,
0xFDU, 0xD1U, 0x60U, 0x48U, 0xD6U, 0x50U, 0xAEU, 0x7FU,
0xA6U, 0xDFU,
/* STEP 23: classic READ block 13 */
/* classic READ block 13 */
0xECU, 0x47U, 0x23U, 0xDDU, 0xEAU, 0x9BU, 0x6BU, 0xFEU,
0x37U, 0x08U, 0x1AU, 0x1DU, 0x00U, 0xCCU, 0x94U, 0x65U,
0x69U, 0x98U,
/* STEP 24: classic READ block 14 */
/* classic READ block 14 */
0xE3U, 0xC9U, 0xBAU, 0xA9U, 0x35U, 0xBAU, 0x9FU, 0x17U,
0xCEU, 0x3EU, 0xCAU, 0xC6U, 0xEFU, 0x05U, 0x6AU, 0x62U,
0xA6U, 0x18U,
/* STEP 25: classic READ block 15 */
/* classic READ block 15 */
0xCDU, 0xD1U, 0x9AU, 0x68U, 0x93U, 0x42U, 0x55U, 0xE2U,
0xD8U, 0x50U, 0xB6U, 0xE0U, 0xFCU, 0x8BU, 0x87U, 0x8AU,
0x1AU, 0xC3U,
/* STEP 26: classic AUTH NT sector 4 */
/* classic AUTH NT sector 4 */
0x10U, 0x00U, 0x00U, 0x04U,
/* STEP 27: classic AUTH NR|AR sector 4 */
/* classic AUTH NR|AR sector 4 */
0x96U, 0x4BU, 0x14U, 0x4BU,
/* STEP 28: classic READ block 16 */
/* classic READ block 16 */
0x93U, 0xFDU, 0x70U, 0xEDU, 0x22U, 0x23U, 0x7AU, 0x61U,
0x1DU, 0x08U, 0x09U, 0xE2U, 0x80U, 0xD8U, 0x72U, 0x03U,
0x48U, 0x38U,
/* STEP 29: classic READ block 17 */
/* classic READ block 17 */
0x85U, 0x8FU, 0x0FU, 0xA4U, 0xBDU, 0xD5U, 0xD5U, 0x9FU,
0x63U, 0x88U, 0x3FU, 0x4FU, 0x66U, 0x3FU, 0x68U, 0x7EU,
0x86U, 0x38U,
/* STEP 30: classic READ block 18 */
/* classic READ block 18 */
0x9DU, 0x6CU, 0xA1U, 0xE0U, 0x8BU, 0x9FU, 0xC9U, 0x55U,
0x54U, 0x19U, 0x32U, 0x71U, 0x56U, 0xFFU, 0x2AU, 0x38U,
0xC7U, 0xABU,
/* STEP 31: classic READ block 19 */
/* classic READ block 19 */
0x3EU, 0xB3U, 0xB0U, 0xDDU, 0x5BU, 0x4BU, 0x6CU, 0xA0U,
0xD9U, 0x91U, 0xECU, 0xB8U, 0xB4U, 0xBBU, 0x41U, 0x7EU,
0x34U, 0xD9U,

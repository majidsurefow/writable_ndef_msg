/* Tier B poller TX golden — one STEP per transceive */
/* STEP 0: classic detect 4k probe fail */
/* classic detect 4k probe fail */
0x60U, 0xFEU,
/* STEP 1: classic detect 1k probe fail */
/* classic detect 1k probe fail */
0x60U, 0x3EU,
/* STEP 2: classic AUTH NT sector 0 */
/* classic AUTH NT sector 0 */
0x60U, 0x00U,
/* STEP 3: classic AUTH NR|AR sector 0 */
/* classic AUTH NR|AR sector 0 */
0x5CU, 0x7BU, 0xBBU, 0x38U, 0x9AU, 0xC9U, 0x81U, 0x14U,
/* STEP 4: classic READ block 0 */
/* classic READ block 0 */
0x0EU, 0x55U, 0x22U, 0xEEU,
/* STEP 5: classic READ block 1 */
/* classic READ block 1 */
0x41U, 0xF4U, 0x72U, 0x9AU,
/* STEP 6: classic READ block 2 */
/* classic READ block 2 */
0x85U, 0xC6U, 0x31U, 0x6EU,
/* STEP 7: classic READ block 3 */
/* classic READ block 3 */
0x92U, 0x46U, 0x47U, 0xF5U,
/* STEP 8: classic AUTH NT sector 1 */
/* classic AUTH NT sector 1 */
0x60U, 0x04U,
/* STEP 9: classic AUTH NR|AR sector 1 */
/* classic AUTH NR|AR sector 1 */
0x15U, 0x95U, 0x7EU, 0x10U, 0xBFU, 0xB4U, 0x4BU, 0x64U,
/* STEP 10: classic READ block 4 */
/* classic READ block 4 */
0x21U, 0xD6U, 0x2BU, 0xD6U,
/* STEP 11: classic READ block 5 */
/* classic READ block 5 */
0xC5U, 0xD8U, 0x00U, 0x80U,
/* STEP 12: classic READ block 6 */
/* classic READ block 6 */
0x16U, 0x82U, 0xBFU, 0x2BU,
/* STEP 13: classic READ block 7 */
/* classic READ block 7 */
0x5CU, 0xDBU, 0xB0U, 0xCEU,
/* STEP 14: classic AUTH NT sector 2 */
/* classic AUTH NT sector 2 */
0x60U, 0x08U,
/* STEP 15: classic AUTH NR|AR sector 2 */
/* classic AUTH NR|AR sector 2 */
0xDCU, 0xCAU, 0xD7U, 0x79U, 0x4EU, 0xF9U, 0xB4U, 0xCDU,
/* STEP 16: classic READ block 8 */
/* classic READ block 8 */
0x1EU, 0x3AU, 0x87U, 0xE9U,
/* STEP 17: classic READ block 9 */
/* classic READ block 9 */
0x75U, 0xCCU, 0xB6U, 0x33U,
/* STEP 18: classic READ block 10 */
/* classic READ block 10 */
0xD0U, 0x11U, 0x92U, 0xC6U,
/* STEP 19: classic READ block 11 */
/* classic READ block 11 */
0x20U, 0xD2U, 0x0EU, 0x03U,
/* STEP 20: classic AUTH NT sector 3 */
/* classic AUTH NT sector 3 */
0x60U, 0x0CU,
/* STEP 21: classic AUTH NR|AR sector 3 */
/* classic AUTH NR|AR sector 3 */
0x34U, 0xC0U, 0xF8U, 0x92U, 0x11U, 0x8CU, 0x86U, 0x36U,
/* STEP 22: classic READ block 12 */
/* classic READ block 12 */
0x2FU, 0xB2U, 0xD6U, 0x15U,
/* STEP 23: classic READ block 13 */
/* classic READ block 13 */
0xB3U, 0xE0U, 0x0DU, 0x13U,
/* STEP 24: classic READ block 14 */
/* classic READ block 14 */
0x6EU, 0x0DU, 0xA1U, 0x87U,
/* STEP 25: classic READ block 15 */
/* classic READ block 15 */
0xB5U, 0xC4U, 0xEFU, 0x3DU,
/* STEP 26: classic AUTH NT sector 4 */
/* classic AUTH NT sector 4 */
0x60U, 0x10U,
/* STEP 27: classic AUTH NR|AR sector 4 */
/* classic AUTH NR|AR sector 4 */
0xDCU, 0xE1U, 0x57U, 0x7AU, 0x4BU, 0x41U, 0x73U, 0x5AU,
/* STEP 28: classic READ block 16 */
/* classic READ block 16 */
0x1CU, 0x7BU, 0x38U, 0x6BU,
/* STEP 29: classic READ block 17 */
/* classic READ block 17 */
0x70U, 0x72U, 0x6BU, 0x66U,
/* STEP 30: classic READ block 18 */
/* classic READ block 18 */
0x49U, 0xA7U, 0x5DU, 0x91U,
/* STEP 31: classic READ block 19 */
/* classic READ block 19 */
0x4AU, 0xFCU, 0xC4U, 0xB2U,

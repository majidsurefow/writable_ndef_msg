/* Tier B nfc_session_mock RX script — one STEP per transceive */
/* STEP 0: classic detect 4k probe fail */
/* classic detect 4k probe fail */
/* STEP 1: classic detect 1k probe nt */
/* classic detect 1k probe nt */
0x20U, 0x00U, 0x00U, 0x3EU,
/* STEP 2: classic AUTH NT sector 0 */
/* classic AUTH NT sector 0 */
0x10U, 0x00U, 0x00U, 0x00U,
/* STEP 3: classic AUTH NR|AR sector 0 */
/* classic AUTH NR|AR sector 0 */
0x62U, 0x6CU, 0x35U, 0x2CU,
/* STEP 4: classic READ block 0 */
/* classic READ block 0 */
0x8FU, 0xB0U, 0x56U, 0x84U, 0xECU, 0xD0U, 0x69U, 0x3EU,
0x38U, 0x19U, 0x40U, 0x43U, 0xC7U, 0xC8U, 0x8DU, 0xA9U,
0x9FU, 0x0EU,
/* STEP 5: classic READ block 1 */
/* classic READ block 1 */
0xCBU, 0x58U, 0x71U, 0x5EU, 0x6BU, 0xABU, 0x97U, 0xE9U,
0x2FU, 0xBEU, 0x97U, 0xD3U, 0x77U, 0xC4U, 0x66U, 0x01U,
0x33U, 0xBAU,
/* STEP 6: classic READ block 2 */
/* classic READ block 2 */
0xC0U, 0xF4U, 0x84U, 0x9EU, 0x35U, 0xD6U, 0x0CU, 0x7CU,
0xF1U, 0x65U, 0x60U, 0x87U, 0xD7U, 0x3CU, 0x1FU, 0x0EU,
0x3AU, 0xF3U,
/* STEP 7: classic READ block 3 */
/* classic READ block 3 */
0x9FU, 0x55U, 0x82U, 0xBBU, 0x04U, 0xCEU, 0xA1U, 0xA3U,
0xA8U, 0x72U, 0xA1U, 0xA1U, 0x05U, 0x4DU, 0x26U, 0xABU,
0x43U, 0x6DU,
/* STEP 8: classic AUTH NT sector 1 */
/* classic AUTH NT sector 1 */
0x10U, 0x00U, 0x00U, 0x01U,
/* STEP 9: classic AUTH NR|AR sector 1 */
/* classic AUTH NR|AR sector 1 */
0xD8U, 0x9FU, 0xA2U, 0x99U,
/* STEP 10: classic READ block 4 */
/* classic READ block 4 */
0xDEU, 0xC0U, 0x4BU, 0xC6U, 0x1DU, 0xFEU, 0x61U, 0x47U,
0xEEU, 0x78U, 0xA6U, 0x20U, 0x4CU, 0x8EU, 0x0EU, 0xC9U,
0x4EU, 0xEFU,
/* STEP 11: classic READ block 5 */
/* classic READ block 5 */
0xEDU, 0xD6U, 0xD7U, 0x56U, 0x17U, 0x6EU, 0x14U, 0x72U,
0x6BU, 0x07U, 0xAAU, 0xA1U, 0x20U, 0x1CU, 0x89U, 0xB3U,
0x5CU, 0x64U,
/* STEP 12: classic READ block 6 */
/* classic READ block 6 */
0x5AU, 0x0CU, 0x1AU, 0x5FU, 0x0EU, 0x67U, 0xE5U, 0xBEU,
0x78U, 0x52U, 0x3CU, 0x7BU, 0x06U, 0xF0U, 0xE8U, 0x04U,
0x86U, 0xB4U,
/* STEP 13: classic READ block 7 */
/* classic READ block 7 */
0x06U, 0x5DU, 0xBAU, 0xB6U, 0xC3U, 0x14U, 0xA9U, 0xE5U,
0xB6U, 0x5DU, 0x73U, 0xC8U, 0x11U, 0xACU, 0x5DU, 0x93U,
0xE5U, 0xD2U,
/* STEP 14: classic AUTH NT sector 2 */
/* classic AUTH NT sector 2 */
0x10U, 0x00U, 0x00U, 0x02U,
/* STEP 15: classic AUTH NR|AR sector 2 */
/* classic AUTH NR|AR sector 2 */
0xE5U, 0x3EU, 0x38U, 0x47U,
/* STEP 16: classic READ block 8 */
/* classic READ block 8 */
0x7AU, 0x8BU, 0x83U, 0x9AU, 0x2FU, 0x45U, 0x83U, 0x3FU,
0x7FU, 0x82U, 0x89U, 0xFCU, 0xD6U, 0x7EU, 0x9DU, 0xDEU,
0x69U, 0x59U,
/* STEP 17: classic READ block 9 */
/* classic READ block 9 */
0x6DU, 0xBBU, 0x00U, 0x35U, 0x83U, 0x0FU, 0x1AU, 0x86U,
0xF3U, 0x2DU, 0x57U, 0x59U, 0x1AU, 0x1FU, 0x2DU, 0x92U,
0x3BU, 0x86U,
/* STEP 18: classic READ block 10 */
/* classic READ block 10 */
0x39U, 0x95U, 0xC7U, 0xFAU, 0x06U, 0xA4U, 0xF0U, 0xB2U,
0x99U, 0xEDU, 0x55U, 0xF8U, 0xB4U, 0x23U, 0xC8U, 0x9DU,
0x8FU, 0xE3U,
/* STEP 19: classic READ block 11 */
/* classic READ block 11 */
0xE1U, 0x6BU, 0x62U, 0xBDU, 0x2DU, 0xC5U, 0xBFU, 0x07U,
0x46U, 0x42U, 0x45U, 0x14U, 0xB0U, 0xDCU, 0xA1U, 0xACU,
0xD4U, 0xA8U,
/* STEP 20: classic AUTH NT sector 3 */
/* classic AUTH NT sector 3 */
0x10U, 0x00U, 0x00U, 0x03U,
/* STEP 21: classic AUTH NR|AR sector 3 */
/* classic AUTH NR|AR sector 3 */
0xD8U, 0x2FU, 0xBEU, 0x04U,
/* STEP 22: classic READ block 12 */
/* classic READ block 12 */
0x08U, 0xF7U, 0x18U, 0x28U, 0x3DU, 0xC0U, 0x03U, 0xE9U,
0x9FU, 0x6EU, 0xD1U, 0xD9U, 0x48U, 0xE9U, 0x9CU, 0x0FU,
0xE7U, 0xC3U,
/* STEP 23: classic READ block 13 */
/* classic READ block 13 */
0x4CU, 0xCEU, 0x93U, 0xA3U, 0x4BU, 0xEEU, 0x32U, 0xB0U,
0x36U, 0xBEU, 0x21U, 0x3EU, 0xBEU, 0x01U, 0x5FU, 0xBBU,
0xA3U, 0x74U,
/* STEP 24: classic READ block 14 */
/* classic READ block 14 */
0x8DU, 0x8EU, 0xB4U, 0xECU, 0x10U, 0x21U, 0x73U, 0xD0U,
0x23U, 0x84U, 0x6EU, 0x59U, 0xA4U, 0xEEU, 0xBBU, 0xDCU,
0x99U, 0x9CU,
/* STEP 25: classic READ block 15 */
/* classic READ block 15 */
0xD6U, 0xC5U, 0x3FU, 0xC2U, 0x3CU, 0xAAU, 0x20U, 0x16U,
0xBEU, 0x96U, 0x2CU, 0x99U, 0x09U, 0x16U, 0x5DU, 0x85U,
0xD0U, 0x91U,
/* STEP 26: classic AUTH NT sector 4 */
/* classic AUTH NT sector 4 */
0x10U, 0x00U, 0x00U, 0x04U,
/* STEP 27: classic AUTH NR|AR sector 4 */
/* classic AUTH NR|AR sector 4 */
0x1DU, 0x06U, 0x8AU, 0xDEU,
/* STEP 28: classic READ block 16 */
/* classic READ block 16 */
0xBFU, 0xD5U, 0xC7U, 0x40U, 0x40U, 0x2DU, 0x4EU, 0x04U,
0x27U, 0xA9U, 0xEBU, 0xC4U, 0x00U, 0x85U, 0x21U, 0x00U,
0xAFU, 0x59U,
/* STEP 29: classic READ block 17 */
/* classic READ block 17 */
0xB6U, 0xA4U, 0x4DU, 0x14U, 0x36U, 0xD5U, 0x5FU, 0x52U,
0x90U, 0xF6U, 0x6BU, 0xE1U, 0x61U, 0x17U, 0xBDU, 0xD1U,
0xD8U, 0x35U,
/* STEP 30: classic READ block 18 */
/* classic READ block 18 */
0xC2U, 0x1DU, 0x11U, 0xE2U, 0x3AU, 0xABU, 0x83U, 0x5BU,
0xD6U, 0xA7U, 0xEFU, 0x47U, 0x6BU, 0xE4U, 0x76U, 0x5DU,
0x0AU, 0xABU,
/* STEP 31: classic READ block 19 */
/* classic READ block 19 */
0x7BU, 0x5BU, 0xC8U, 0x7BU, 0x3CU, 0x02U, 0x66U, 0x8AU,
0x30U, 0x13U, 0x95U, 0xCFU, 0xD4U, 0x61U, 0x47U, 0x45U,
0xEDU, 0x76U,
/* STEP 32: classic AUTH NT sector 5 */
/* classic AUTH NT sector 5 */
0x10U, 0x00U, 0x00U, 0x05U,
/* STEP 33: classic AUTH NR|AR sector 5 */
/* classic AUTH NR|AR sector 5 */
0x9EU, 0x15U, 0xB6U, 0x02U,
/* STEP 34: classic READ block 20 */
/* classic READ block 20 */
0x53U, 0xF1U, 0xB9U, 0xC8U, 0x73U, 0x09U, 0x14U, 0x29U,
0x8EU, 0x99U, 0xD3U, 0x2DU, 0xB9U, 0x41U, 0x74U, 0x75U,
0x66U, 0x1EU,
/* STEP 35: classic READ block 21 */
/* classic READ block 21 */
0x38U, 0x00U, 0xEDU, 0xF5U, 0x0BU, 0x07U, 0x35U, 0x9BU,
0xBAU, 0xBCU, 0x50U, 0x96U, 0x18U, 0x2CU, 0xD1U, 0x84U,
0x93U, 0x5BU,
/* STEP 36: classic READ block 22 */
/* classic READ block 22 */
0x81U, 0xBAU, 0xAFU, 0xB9U, 0x35U, 0xBBU, 0xFEU, 0xCFU,
0x8BU, 0xC2U, 0xF9U, 0x96U, 0xCAU, 0x18U, 0xE2U, 0xDAU,
0x4AU, 0x74U,
/* STEP 37: classic READ block 23 */
/* classic READ block 23 */
0x9AU, 0xA8U, 0x24U, 0x09U, 0x23U, 0x52U, 0x01U, 0x4BU,
0x9FU, 0x94U, 0xBFU, 0xE0U, 0xA9U, 0x8DU, 0xD4U, 0x11U,
0xA7U, 0x86U,
/* STEP 38: classic AUTH NT sector 6 */
/* classic AUTH NT sector 6 */
0x10U, 0x00U, 0x00U, 0x06U,
/* STEP 39: classic AUTH NR|AR sector 6 */
/* classic AUTH NR|AR sector 6 */
0x6EU, 0x67U, 0xC2U, 0x6AU,
/* STEP 40: classic READ block 24 */
/* classic READ block 24 */
0x2CU, 0xB1U, 0x9FU, 0xA5U, 0x23U, 0xBCU, 0xBDU, 0x76U,
0x3FU, 0xB4U, 0x8FU, 0xC9U, 0x01U, 0xAFU, 0x47U, 0x41U,
0x7EU, 0x58U,
/* STEP 41: classic READ block 25 */
/* classic READ block 25 */
0x4CU, 0x17U, 0x1AU, 0x5EU, 0x57U, 0x7FU, 0x48U, 0x1CU,
0x5DU, 0x6FU, 0x05U, 0x99U, 0x61U, 0x5EU, 0x85U, 0xB2U,
0x78U, 0xE6U,
/* STEP 42: classic READ block 26 */
/* classic READ block 26 */
0xCFU, 0xECU, 0x6FU, 0x5DU, 0x39U, 0x29U, 0x76U, 0x33U,
0x2FU, 0x53U, 0xF0U, 0xFCU, 0xD7U, 0xA2U, 0xA1U, 0x5FU,
0x4FU, 0xC4U,
/* STEP 43: classic READ block 27 */
/* classic READ block 27 */
0xA6U, 0xFEU, 0x01U, 0xE1U, 0xFDU, 0xD8U, 0xF1U, 0x79U,
0x0EU, 0x69U, 0xCFU, 0x01U, 0x95U, 0xC0U, 0xBDU, 0x59U,
0xCDU, 0x39U,
/* STEP 44: classic AUTH NT sector 7 */
/* classic AUTH NT sector 7 */
0x10U, 0x00U, 0x00U, 0x07U,
/* STEP 45: classic AUTH NR|AR sector 7 */
/* classic AUTH NR|AR sector 7 */
0xF0U, 0xB0U, 0x81U, 0xCBU,
/* STEP 46: classic READ block 28 */
/* classic READ block 28 */
0xF1U, 0x79U, 0x5DU, 0x37U, 0x04U, 0x16U, 0x6EU, 0xE5U,
0x47U, 0x09U, 0xECU, 0x8FU, 0x9BU, 0x0BU, 0xFDU, 0xD8U,
0xDCU, 0xB1U,
/* STEP 47: classic READ block 29 */
/* classic READ block 29 */
0xACU, 0x5DU, 0x56U, 0x80U, 0xF8U, 0x6AU, 0xF3U, 0xD7U,
0x15U, 0x76U, 0xFEU, 0xD4U, 0xD6U, 0xEEU, 0x79U, 0xFAU,
0x0BU, 0x54U,
/* STEP 48: classic READ block 30 */
/* classic READ block 30 */
0xDFU, 0xBDU, 0xF3U, 0x0BU, 0xD0U, 0x45U, 0x8BU, 0x9CU,
0x87U, 0xA2U, 0x90U, 0xE2U, 0xC8U, 0x11U, 0x77U, 0xD8U,
0x6EU, 0x1DU,
/* STEP 49: classic READ block 31 */
/* classic READ block 31 */
0x57U, 0xB8U, 0x84U, 0x95U, 0x92U, 0x21U, 0xA0U, 0x38U,
0x8CU, 0x3AU, 0xA3U, 0x0BU, 0x59U, 0xEDU, 0x44U, 0x3BU,
0x85U, 0xBDU,
/* STEP 50: classic AUTH NT sector 8 */
/* classic AUTH NT sector 8 */
0x10U, 0x00U, 0x00U, 0x08U,
/* STEP 51: classic AUTH NR|AR sector 8 */
/* classic AUTH NR|AR sector 8 */
0x82U, 0x05U, 0x09U, 0x0FU,
/* STEP 52: classic READ block 32 */
/* classic READ block 32 */
0x5DU, 0x6CU, 0xE7U, 0x0EU, 0xA7U, 0xE2U, 0xE0U, 0x0FU,
0x77U, 0x7DU, 0x19U, 0x4DU, 0xF9U, 0x2FU, 0xD1U, 0x7CU,
0x1DU, 0x29U,
/* STEP 53: classic READ block 33 */
/* classic READ block 33 */
0x43U, 0xC0U, 0x69U, 0x1AU, 0x11U, 0x47U, 0xBEU, 0x5EU,
0x12U, 0xD0U, 0x5BU, 0x74U, 0x56U, 0xEEU, 0x8FU, 0x55U,
0x0CU, 0x36U,
/* STEP 54: classic READ block 34 */
/* classic READ block 34 */
0x8BU, 0x62U, 0x57U, 0xCDU, 0xFAU, 0x16U, 0xD3U, 0xFAU,
0xE1U, 0x17U, 0x45U, 0x79U, 0x79U, 0x4BU, 0x19U, 0x6FU,
0x4CU, 0xA3U,
/* STEP 55: classic READ block 35 */
/* classic READ block 35 */
0xEBU, 0xCFU, 0x32U, 0x71U, 0x19U, 0x30U, 0x28U, 0x15U,
0x27U, 0xFEU, 0xCFU, 0x18U, 0xFAU, 0x4CU, 0x3BU, 0x8AU,
0xF9U, 0xCFU,
/* STEP 56: classic AUTH NT sector 9 */
/* classic AUTH NT sector 9 */
0x10U, 0x00U, 0x00U, 0x09U,
/* STEP 57: classic AUTH NR|AR sector 9 */
/* classic AUTH NR|AR sector 9 */
0xC0U, 0xB1U, 0xBCU, 0x91U,
/* STEP 58: classic READ block 36 */
/* classic READ block 36 */
0x7EU, 0xBFU, 0x14U, 0x26U, 0xBFU, 0xC5U, 0xB0U, 0x27U,
0x0EU, 0x31U, 0x44U, 0x3DU, 0x29U, 0x6DU, 0xD7U, 0x23U,
0x5AU, 0x9AU,
/* STEP 59: classic READ block 37 */
/* classic READ block 37 */
0xF2U, 0x0CU, 0x1DU, 0xA0U, 0x7FU, 0x69U, 0x9DU, 0x3BU,
0xFDU, 0x24U, 0x7EU, 0xACU, 0x5AU, 0x53U, 0xAFU, 0xD8U,
0x29U, 0xE7U,
/* STEP 60: classic READ block 38 */
/* classic READ block 38 */
0xC5U, 0x43U, 0x1BU, 0xF2U, 0x9EU, 0x54U, 0x3AU, 0x51U,
0xB2U, 0x99U, 0xE5U, 0x9EU, 0xBEU, 0x3BU, 0xCCU, 0xECU,
0x4EU, 0x07U,
/* STEP 61: classic READ block 39 */
/* classic READ block 39 */
0x21U, 0xA0U, 0x17U, 0xB0U, 0x2BU, 0xAEU, 0x9BU, 0x15U,
0xB9U, 0x53U, 0x26U, 0x94U, 0xF1U, 0xB7U, 0x91U, 0xF1U,
0x44U, 0xD9U,
/* STEP 62: classic AUTH NT sector 10 */
/* classic AUTH NT sector 10 */
0x10U, 0x00U, 0x00U, 0x0AU,
/* STEP 63: classic AUTH NR|AR sector 10 */
/* classic AUTH NR|AR sector 10 */
0xA2U, 0x68U, 0x7EU, 0x76U,
/* STEP 64: classic READ block 40 */
/* classic READ block 40 */
0x8DU, 0xAFU, 0x7AU, 0xD2U, 0x23U, 0xF4U, 0xE4U, 0x77U,
0xD6U, 0x61U, 0x16U, 0xD5U, 0x49U, 0xA5U, 0xDCU, 0x85U,
0x54U, 0xAFU,
/* STEP 65: classic READ block 41 */
/* classic READ block 41 */
0x88U, 0x0EU, 0xE9U, 0xC1U, 0xAAU, 0x6CU, 0x97U, 0x66U,
0x4CU, 0xACU, 0xB7U, 0x4EU, 0x01U, 0x9AU, 0xECU, 0xA2U,
0xA8U, 0xF1U,
/* STEP 66: classic READ block 42 */
/* classic READ block 42 */
0x5FU, 0x55U, 0x4EU, 0x48U, 0xF1U, 0xB6U, 0x22U, 0x16U,
0xC0U, 0x4BU, 0x0DU, 0x4AU, 0xF3U, 0x54U, 0x4CU, 0x70U,
0x77U, 0x25U,
/* STEP 67: classic READ block 43 */
/* classic READ block 43 */
0x58U, 0xABU, 0xD6U, 0x93U, 0xA9U, 0xD7U, 0xB3U, 0x59U,
0x2EU, 0xE4U, 0x9DU, 0xFFU, 0xFCU, 0xF6U, 0x5FU, 0x58U,
0xF0U, 0x38U,
/* STEP 68: classic AUTH NT sector 11 */
/* classic AUTH NT sector 11 */
0x10U, 0x00U, 0x00U, 0x0BU,
/* STEP 69: classic AUTH NR|AR sector 11 */
/* classic AUTH NR|AR sector 11 */
0x5FU, 0x8BU, 0xE1U, 0xEDU,
/* STEP 70: classic READ block 44 */
/* classic READ block 44 */
0x3EU, 0x30U, 0x38U, 0x0AU, 0x88U, 0xE1U, 0xDFU, 0xAAU,
0xBCU, 0xADU, 0xAAU, 0xD8U, 0xA8U, 0xA5U, 0x85U, 0x0BU,
0xD3U, 0x37U,
/* STEP 71: classic READ block 45 */
/* classic READ block 45 */
0x8AU, 0xD2U, 0x9FU, 0xC1U, 0x1BU, 0xA9U, 0xCFU, 0x9EU,
0xB0U, 0x30U, 0xC7U, 0x99U, 0x7FU, 0x05U, 0x89U, 0x3FU,
0x7AU, 0x2BU,
/* STEP 72: classic READ block 46 */
/* classic READ block 46 */
0xAEU, 0xCEU, 0x79U, 0x03U, 0xFDU, 0x1EU, 0xB7U, 0xB0U,
0x0BU, 0x83U, 0x73U, 0xB9U, 0x6CU, 0x7AU, 0xB0U, 0xFDU,
0x55U, 0x1AU,
/* STEP 73: classic READ block 47 */
/* classic READ block 47 */
0xC9U, 0x40U, 0x0FU, 0x4BU, 0x8CU, 0xC4U, 0x42U, 0xFEU,
0xF5U, 0x76U, 0x6FU, 0xDCU, 0xF1U, 0x8DU, 0xC5U, 0xA4U,
0xFAU, 0xF2U,
/* STEP 74: classic AUTH NT sector 12 */
/* classic AUTH NT sector 12 */
0x10U, 0x00U, 0x00U, 0x0CU,
/* STEP 75: classic AUTH NR|AR sector 12 */
/* classic AUTH NR|AR sector 12 */
0x27U, 0x33U, 0x17U, 0x8EU,
/* STEP 76: classic READ block 48 */
/* classic READ block 48 */
0xECU, 0x21U, 0x37U, 0xA7U, 0x89U, 0xBEU, 0x00U, 0xDCU,
0x68U, 0xC0U, 0x40U, 0x48U, 0xA8U, 0x4DU, 0xFDU, 0x0FU,
0x8EU, 0x86U,
/* STEP 77: classic READ block 49 */
/* classic READ block 49 */
0xEAU, 0xC9U, 0x6FU, 0xE3U, 0xC0U, 0x6EU, 0xECU, 0xD1U,
0x2EU, 0x35U, 0xA5U, 0x3FU, 0x69U, 0x2BU, 0x39U, 0x85U,
0xBCU, 0x72U,
/* STEP 78: classic READ block 50 */
/* classic READ block 50 */
0xC0U, 0xC1U, 0xF1U, 0xD8U, 0x13U, 0xBBU, 0xF6U, 0x53U,
0xB9U, 0x65U, 0x1BU, 0x72U, 0x21U, 0x0CU, 0xAEU, 0x13U,
0x55U, 0x9DU,
/* STEP 79: classic READ block 51 */
/* classic READ block 51 */
0x3AU, 0xC0U, 0x0BU, 0x84U, 0xDEU, 0x79U, 0x46U, 0x19U,
0xFAU, 0x59U, 0x0FU, 0xA6U, 0x63U, 0x0FU, 0x05U, 0x01U,
0x83U, 0x84U,
/* STEP 80: classic AUTH NT sector 13 */
/* classic AUTH NT sector 13 */
0x10U, 0x00U, 0x00U, 0x0DU,
/* STEP 81: classic AUTH NR|AR sector 13 */
/* classic AUTH NR|AR sector 13 */
0x9AU, 0xF6U, 0xFFU, 0xCDU,
/* STEP 82: classic READ block 52 */
/* classic READ block 52 */
0x8AU, 0x05U, 0xCDU, 0xF9U, 0xE1U, 0x84U, 0x36U, 0xF0U,
0x3AU, 0xB6U, 0xFAU, 0xA8U, 0x79U, 0xD9U, 0x19U, 0xB8U,
0xA8U, 0x71U,
/* STEP 83: classic READ block 53 */
/* classic READ block 53 */
0x73U, 0x7FU, 0x7EU, 0xD3U, 0x7EU, 0xFEU, 0xDAU, 0x23U,
0xE5U, 0x18U, 0x66U, 0x7FU, 0x80U, 0x50U, 0x2AU, 0x85U,
0x3DU, 0xEFU,
/* STEP 84: classic READ block 54 */
/* classic READ block 54 */
0x4AU, 0x97U, 0x57U, 0x59U, 0x4FU, 0x2FU, 0x4CU, 0xB7U,
0x8FU, 0xC6U, 0xCAU, 0x9FU, 0x3DU, 0xCAU, 0xA1U, 0x64U,
0xB2U, 0x17U,
/* STEP 85: classic READ block 55 */
/* classic READ block 55 */
0x2BU, 0x64U, 0x28U, 0xBCU, 0x12U, 0xB5U, 0x96U, 0xE5U,
0x09U, 0x15U, 0x6DU, 0x76U, 0xDCU, 0x10U, 0x6EU, 0xC6U,
0xFAU, 0xC6U,
/* STEP 86: classic AUTH NT sector 14 */
/* classic AUTH NT sector 14 */
0x10U, 0x00U, 0x00U, 0x0EU,
/* STEP 87: classic AUTH NR|AR sector 14 */
/* classic AUTH NR|AR sector 14 */
0x90U, 0x30U, 0xCCU, 0x08U,
/* STEP 88: classic READ block 56 */
/* classic READ block 56 */
0xD3U, 0xF9U, 0x3FU, 0x03U, 0x72U, 0x0BU, 0xBDU, 0xF9U,
0x06U, 0x09U, 0x25U, 0xA6U, 0x38U, 0x04U, 0x56U, 0x0BU,
0x83U, 0xFAU,
/* STEP 89: classic READ block 57 */
/* classic READ block 57 */
0x80U, 0x40U, 0x32U, 0x1BU, 0x37U, 0x5EU, 0x76U, 0xC8U,
0x5CU, 0x26U, 0xD0U, 0x59U, 0x2BU, 0x26U, 0xC4U, 0xD1U,
0x3EU, 0xE9U,
/* STEP 90: classic READ block 58 */
/* classic READ block 58 */
0xF7U, 0xE0U, 0x53U, 0xE4U, 0xF2U, 0x78U, 0x86U, 0xE1U,
0x99U, 0xAAU, 0x9EU, 0x31U, 0xF1U, 0xD5U, 0x22U, 0x10U,
0xC8U, 0xCCU,
/* STEP 91: classic READ block 59 */
/* classic READ block 59 */
0xA4U, 0x16U, 0x9AU, 0xC5U, 0xD3U, 0xF1U, 0xD1U, 0x01U,
0x51U, 0x67U, 0x5CU, 0xEDU, 0x9AU, 0x6CU, 0x18U, 0xF7U,
0x76U, 0xA0U,
/* STEP 92: classic AUTH NT sector 15 */
/* classic AUTH NT sector 15 */
0x10U, 0x00U, 0x00U, 0x0FU,
/* STEP 93: classic AUTH NR|AR sector 15 */
/* classic AUTH NR|AR sector 15 */
0xADU, 0xB5U, 0xFAU, 0x6BU,
/* STEP 94: classic READ block 60 */
/* classic READ block 60 */
0xB7U, 0x5EU, 0xF0U, 0x3BU, 0x7DU, 0x6EU, 0xEEU, 0x92U,
0x1FU, 0x79U, 0x6CU, 0xAEU, 0xD5U, 0xEDU, 0x59U, 0x03U,
0xB6U, 0x2DU,
/* STEP 95: classic READ block 61 */
/* classic READ block 61 */
0x51U, 0x7CU, 0x9CU, 0xC4U, 0x2DU, 0xE0U, 0x59U, 0x82U,
0x2CU, 0x29U, 0x87U, 0x54U, 0xB0U, 0x8EU, 0xF0U, 0x4EU,
0x99U, 0xF0U,
/* STEP 96: classic READ block 62 */
/* classic READ block 62 */
0x16U, 0xD5U, 0x7DU, 0x98U, 0x71U, 0xFDU, 0x59U, 0xF1U,
0x09U, 0xD9U, 0xFDU, 0x9BU, 0xE2U, 0x70U, 0x9BU, 0x5EU,
0xEEU, 0x3CU,
/* STEP 97: classic READ block 63 */
/* classic READ block 63 */
0x9DU, 0x49U, 0x02U, 0x0EU, 0xB8U, 0x80U, 0x4EU, 0x19U,
0x39U, 0x50U, 0xD3U, 0x35U, 0x24U, 0x33U, 0xD2U, 0xA4U,
0x82U, 0xC8U,

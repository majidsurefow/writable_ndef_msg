/* Tier B nfc_session_mock RX script — one STEP per transceive */
/* STEP 0: ultralight GET_VERSION fail */
/* ultralight GET_VERSION fail */
/* STEP 1: ultralight AUTH test */
/* ultralight AUTH test */
0xAFU, 0x3BU, 0x96U, 0x7DU, 0x9CU, 0xCCU, 0x84U, 0x42U,
0x93U,
/* STEP 2: ultralight AUTH start */
/* ultralight AUTH start */
0xAFU, 0x3BU, 0x96U, 0x7DU, 0x9CU, 0xCCU, 0x84U, 0x42U,
0x93U,
/* STEP 3: ultralight AUTH cont */
/* ultralight AUTH cont */
0x00U, 0xB7U, 0x86U, 0x17U, 0x55U, 0xAAU, 0x23U, 0x7FU,
0xE1U,
/* STEP 4: ultralight READ page 0 */
/* ultralight READ page 0 */
0x04U, 0xBAU, 0xFFU, 0xC9U, 0xCAU, 0x4DU, 0x5DU, 0x80U,
0x5AU, 0x48U, 0x00U, 0x00U, 0xE1U, 0x10U, 0x12U, 0x00U,
/* STEP 5: ultralight READ page 4 */
/* ultralight READ page 4 */
0x01U, 0x03U, 0xA0U, 0x0CU, 0x34U, 0x03U, 0x00U, 0xFEU,
0x00U, 0x00U, 0x00U, 0x00U, 0x00U, 0x00U, 0x00U, 0x00U,
/* STEP 6: ultralight READ page 8 */
/* ultralight READ page 8 */
0x00U, 0x00U, 0x00U, 0x00U, 0x00U, 0x00U, 0x00U, 0x00U,
0x00U, 0x00U, 0xBEU, 0xAFU, 0x00U, 0x00U, 0x00U, 0x00U,
/* STEP 7: ultralight READ page 12 */
/* ultralight READ page 12 */
0x00U, 0x00U, 0x00U, 0x00U, 0x00U, 0x00U, 0x00U, 0x00U,
0x00U, 0x00U, 0x00U, 0x00U, 0x00U, 0x00U, 0x00U, 0x00U,
/* STEP 8: ultralight READ page 16 */
/* ultralight READ page 16 */
0x00U, 0x00U, 0x00U, 0x00U, 0x00U, 0x00U, 0x00U, 0x00U,
0x00U, 0x00U, 0x00U, 0x00U, 0x00U, 0x00U, 0x00U, 0x00U,
/* STEP 9: ultralight READ page 20 */
/* ultralight READ page 20 */
0x00U, 0x00U, 0x00U, 0x00U, 0x00U, 0x00U, 0x00U, 0x00U,
0x00U, 0x00U, 0x00U, 0x00U, 0x00U, 0x00U, 0x00U, 0x00U,
/* STEP 10: ultralight READ page 24 */
/* ultralight READ page 24 */
0x00U, 0x00U, 0x00U, 0x00U, 0x00U, 0x00U, 0x00U, 0x00U,
0x00U, 0x00U, 0x00U, 0x00U, 0x00U, 0x00U, 0x00U, 0x00U,
/* STEP 11: ultralight READ page 28 */
/* ultralight READ page 28 */
0x00U, 0x00U, 0x00U, 0x00U, 0x00U, 0x00U, 0x00U, 0x00U,
0x00U, 0x00U, 0x00U, 0x00U, 0x00U, 0x00U, 0x00U, 0x00U,
/* STEP 12: ultralight READ page 32 */
/* ultralight READ page 32 */
0x00U, 0x00U, 0x00U, 0x00U, 0x00U, 0x00U, 0x00U, 0x00U,
0x00U, 0x00U, 0x00U, 0x00U, 0x00U, 0x00U, 0x00U, 0x00U,
/* STEP 13: ultralight READ page 36 */
/* ultralight READ page 36 */
0x00U, 0x00U, 0x00U, 0x00U, 0x00U, 0x00U, 0x00U, 0x00U,
0x00U, 0x00U, 0x00U, 0x00U, 0x00U, 0x00U, 0x00U, 0x00U,
/* STEP 14: ultralight READ page 40 */
/* ultralight READ page 40 */
0x00U, 0x00U, 0x00U, 0x00U, 0x00U, 0x00U, 0x00U, 0x00U,
0x05U, 0x00U, 0x00U, 0x00U, 0x00U, 0x00U, 0x00U, 0x00U,
/* STEP 15: ultralight READ page 44 */
/* ultralight READ page 44 */
0x00U, 0x00U, 0x00U, 0x00U, 0x00U, 0x00U, 0x00U, 0x00U,
0x00U, 0x00U, 0x00U, 0x00U, 0x00U, 0x00U, 0x00U, 0x00U,

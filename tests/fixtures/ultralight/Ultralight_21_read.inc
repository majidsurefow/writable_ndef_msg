/* Tier B nfc_session_mock RX script — one STEP per transceive */
/* STEP 0: ultralight GET_VERSION */
/* ultralight GET_VERSION */
0x00U, 0x34U, 0x21U, 0x01U, 0x01U, 0x00U, 0x0EU, 0x03U,
/* STEP 1: ultralight READ page 0 */
/* ultralight READ page 0 */
0x34U, 0xBFU, 0xABU, 0xA8U, 0xB1U, 0xAEU, 0x73U, 0xD6U,
0xBAU, 0x00U, 0x70U, 0x08U, 0xFFU, 0xFFU, 0xFFU, 0xFCU,
/* STEP 2: ultralight READ page 4 */
/* ultralight READ page 4 */
0x45U, 0xD9U, 0xBBU, 0xA0U, 0x5DU, 0x9DU, 0xFAU, 0x00U,
0x80U, 0x70U, 0x38U, 0x40U, 0x12U, 0x30U, 0x02U, 0x00U,
/* STEP 3: ultralight READ page 8 */
/* ultralight READ page 8 */
0x00U, 0x00U, 0x00U, 0x00U, 0x00U, 0x00U, 0x00U, 0x00U,
0xACU, 0xA1U, 0x0DU, 0xE4U, 0x80U, 0x70U, 0x38U, 0x40U,
/* STEP 4: ultralight READ page 12 */
/* ultralight READ page 12 */
0x00U, 0x57U, 0xA0U, 0x01U, 0x00U, 0x08U, 0xC1U, 0x40U,
0x00U, 0x00U, 0x00U, 0x00U, 0xACU, 0xA1U, 0x0DU, 0xE4U,
/* STEP 5: ultralight READ page 16 */
/* ultralight READ page 16 */
0x00U, 0x00U, 0x00U, 0x00U, 0x00U, 0x00U, 0x00U, 0x00U,
0x00U, 0x00U, 0x00U, 0x00U, 0x00U, 0x00U, 0x00U, 0x00U,
/* STEP 6: ultralight READ page 20 */
/* ultralight READ page 20 */
0x00U, 0x00U, 0x00U, 0x00U, 0x00U, 0x00U, 0x00U, 0x00U,
0x00U, 0x00U, 0x00U, 0x00U, 0x00U, 0x00U, 0x00U, 0x00U,
/* STEP 7: ultralight READ page 24 */
/* ultralight READ page 24 */
0x00U, 0x00U, 0x00U, 0x00U, 0x00U, 0x00U, 0x00U, 0x00U,
0x00U, 0x00U, 0x00U, 0x00U, 0x00U, 0x00U, 0x00U, 0x00U,
/* STEP 8: ultralight READ page 28 */
/* ultralight READ page 28 */
0x00U, 0x00U, 0x00U, 0x00U, 0x00U, 0x00U, 0x00U, 0x00U,
0x00U, 0x00U, 0x00U, 0x00U, 0x00U, 0x00U, 0x00U, 0x00U,
/* STEP 9: ultralight READ page 32 */
/* ultralight READ page 32 */
0x00U, 0x00U, 0x00U, 0x00U, 0x00U, 0x00U, 0x00U, 0x00U,
0x00U, 0x00U, 0x00U, 0x00U, 0x00U, 0x00U, 0x00U, 0x00U,
/* STEP 10: ultralight READ page 36 */
/* ultralight READ page 36 */
0x00U, 0x00U, 0x00U, 0xBDU, 0x00U, 0x00U, 0x00U, 0xFFU,
0x00U, 0x05U, 0x00U, 0x00U, 0xFFU, 0xFFU, 0xFFU, 0xFFU,
/* STEP 11: ultralight READ page 40 */
/* ultralight READ page 40 */
0x00U, 0x00U, 0x00U, 0x00U, 0x00U, 0x00U, 0x00U, 0x00U,
0x00U, 0x00U, 0x00U, 0x00U, 0x00U, 0x00U, 0x00U, 0x00U,
/* STEP 12: ultralight READ_SIG */
/* ultralight READ_SIG */
0x00U, 0x00U, 0x00U, 0x00U, 0x00U, 0x00U, 0x00U, 0x00U,
0x00U, 0x00U, 0x00U, 0x00U, 0x00U, 0x00U, 0x00U, 0x00U,
0x00U, 0x00U, 0x00U, 0x00U, 0x00U, 0x00U, 0x00U, 0x00U,
0x00U, 0x00U, 0x00U, 0x00U, 0x00U, 0x00U, 0x00U, 0x00U,
/* STEP 13: ultralight READ_CNT 0 */
/* ultralight READ_CNT 0 */
0x00U, 0x00U, 0x00U,
/* STEP 14: ultralight READ_CNT 1 */
/* ultralight READ_CNT 1 */
0x00U, 0x00U, 0x00U,
/* STEP 15: ultralight READ_CNT 2 */
/* ultralight READ_CNT 2 */
0x00U, 0x00U, 0x00U,
/* STEP 16: ultralight CHECK_TEARING 0 */
/* ultralight CHECK_TEARING 0 */
0x00U,
/* STEP 17: ultralight CHECK_TEARING 1 */
/* ultralight CHECK_TEARING 1 */
0x00U,
/* STEP 18: ultralight CHECK_TEARING 2 */
/* ultralight CHECK_TEARING 2 */
0x00U,

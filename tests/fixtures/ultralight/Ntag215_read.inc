/* Tier B nfc_session_mock RX script — one STEP per transceive */
/* STEP 0: ultralight GET_VERSION */
/* ultralight GET_VERSION */
0x00U, 0x04U, 0x04U, 0x02U, 0x01U, 0x00U, 0x11U, 0x03U,
/* STEP 1: ultralight READ page 0 */
/* ultralight READ page 0 */
0x04U, 0x51U, 0x5CU, 0x81U, 0xFAU, 0x6FU, 0x73U, 0x81U,
0x67U, 0x48U, 0x0FU, 0xE0U, 0xF1U, 0x10U, 0xFFU, 0xEEU,
/* STEP 2: ultralight READ page 4 */
/* ultralight READ page 4 */
0xA5U, 0x00U, 0x00U, 0x00U, 0x90U, 0x42U, 0x74U, 0x71U,
0xFDU, 0x8FU, 0x50U, 0x61U, 0xC5U, 0x65U, 0x1BU, 0x54U,
/* STEP 3: ultralight READ page 8 */
/* ultralight READ page 8 */
0xEFU, 0x68U, 0xD0U, 0x8EU, 0x3DU, 0x35U, 0xDBU, 0x83U,
0xD3U, 0x00U, 0x29U, 0xF6U, 0x42U, 0x2AU, 0xA5U, 0x5CU,
/* STEP 4: ultralight READ page 12 */
/* ultralight READ page 12 */
0xF1U, 0x69U, 0x0AU, 0xFCU, 0xB6U, 0x44U, 0xE9U, 0x6BU,
0x77U, 0x41U, 0x88U, 0x81U, 0x86U, 0x31U, 0xCBU, 0xADU,
/* STEP 5: ultralight READ page 16 */
/* ultralight READ page 16 */
0xB1U, 0xDEU, 0xF1U, 0xABU, 0xDFU, 0x96U, 0xC2U, 0xC5U,
0xC1U, 0x26U, 0x99U, 0x96U, 0x85U, 0xAFU, 0x9FU, 0x0EU,
/* STEP 6: ultralight READ page 20 */
/* ultralight READ page 20 */
0x58U, 0xFEU, 0xEDU, 0xDCU, 0x0AU, 0x0AU, 0x00U, 0x01U,
0x03U, 0xC1U, 0x05U, 0x02U, 0x38U, 0x39U, 0x34U, 0x33U,
/* STEP 7: ultralight READ page 24 */
/* ultralight READ page 24 */
0x49U, 0x2DU, 0x4EU, 0x5CU, 0x5BU, 0x21U, 0x0FU, 0x44U,
0x3FU, 0x3FU, 0x76U, 0x69U, 0xB4U, 0x72U, 0xD8U, 0x38U,
/* STEP 8: ultralight READ page 28 */
/* ultralight READ page 28 */
0xA0U, 0x35U, 0x53U, 0x51U, 0x53U, 0xEBU, 0xA6U, 0x7CU,
0x3EU, 0x8BU, 0x97U, 0xC0U, 0x00U, 0x7AU, 0x45U, 0x13U,
/* STEP 9: ultralight READ page 32 */
/* ultralight READ page 32 */
0x3AU, 0x8BU, 0xD4U, 0x0FU, 0x31U, 0xC2U, 0x32U, 0xCCU,
0xB4U, 0x24U, 0xA6U, 0x1BU, 0xD3U, 0xF5U, 0x4AU, 0x1FU,
/* STEP 10: ultralight READ page 36 */
/* ultralight READ page 36 */
0xCDU, 0x8FU, 0x1DU, 0x64U, 0x01U, 0xF4U, 0xDFU, 0xC2U,
0x11U, 0x16U, 0xC2U, 0xC5U, 0x30U, 0x6DU, 0x49U, 0xAFU,
/* STEP 11: ultralight READ page 40 */
/* ultralight READ page 40 */
0x10U, 0xD4U, 0x7CU, 0x3CU, 0x6EU, 0x36U, 0x4EU, 0x08U,
0x95U, 0x76U, 0xBCU, 0x84U, 0x35U, 0x50U, 0xDDU, 0xF0U,
/* STEP 12: ultralight READ page 44 */
/* ultralight READ page 44 */
0x21U, 0x0FU, 0xEEU, 0xD9U, 0x85U, 0x19U, 0x54U, 0x5FU,
0x3EU, 0xA9U, 0x04U, 0x20U, 0x1BU, 0x97U, 0xE4U, 0x39U,
/* STEP 13: ultralight READ page 48 */
/* ultralight READ page 48 */
0xFFU, 0x0AU, 0x45U, 0xF6U, 0x13U, 0xD4U, 0x3EU, 0xDDU,
0x97U, 0x42U, 0xFCU, 0x67U, 0x6AU, 0xACU, 0x78U, 0x96U,
/* STEP 14: ultralight READ page 52 */
/* ultralight READ page 52 */
0xD1U, 0xDAU, 0x25U, 0x23U, 0xBFU, 0x4DU, 0xB3U, 0x76U,
0xF1U, 0x21U, 0xEDU, 0x15U, 0xBDU, 0x55U, 0x11U, 0xC4U,
/* STEP 15: ultralight READ page 56 */
/* ultralight READ page 56 */
0x4EU, 0x8CU, 0xE9U, 0x23U, 0xC0U, 0xC4U, 0x6DU, 0x5AU,
0x58U, 0x25U, 0xFFU, 0x95U, 0x3CU, 0x2BU, 0x7AU, 0x57U,
/* STEP 16: ultralight READ page 60 */
/* ultralight READ page 60 */
0x66U, 0xBEU, 0xA0U, 0x61U, 0xBCU, 0xFCU, 0x4AU, 0x31U,
0x4DU, 0xACU, 0xEEU, 0x81U, 0xBEU, 0x1AU, 0x86U, 0x04U,
/* STEP 17: ultralight READ page 64 */
/* ultralight READ page 64 */
0xF6U, 0xD7U, 0x5EU, 0xB3U, 0xE7U, 0xA8U, 0xA2U, 0x86U,
0xE9U, 0x40U, 0xABU, 0x47U, 0xC8U, 0x36U, 0xE4U, 0x3EU,
/* STEP 18: ultralight READ page 68 */
/* ultralight READ page 68 */
0xA7U, 0x4DU, 0xD3U, 0xEAU, 0x83U, 0x9AU, 0x64U, 0xF7U,
0x96U, 0x6BU, 0x5DU, 0xBFU, 0x4EU, 0xA2U, 0xA6U, 0x0FU,
/* STEP 19: ultralight READ page 72 */
/* ultralight READ page 72 */
0xBDU, 0x3DU, 0xBEU, 0x7CU, 0x22U, 0x0CU, 0x68U, 0x51U,
0x0FU, 0x9AU, 0xB8U, 0xAEU, 0x38U, 0x2CU, 0xC4U, 0xCDU,
/* STEP 20: ultralight READ page 76 */
/* ultralight READ page 76 */
0x53U, 0xD8U, 0xDDU, 0x18U, 0xA6U, 0x5DU, 0x35U, 0x87U,
0xC9U, 0x6DU, 0x99U, 0x59U, 0x61U, 0x9FU, 0xB6U, 0xDCU,
/* STEP 21: ultralight READ page 80 */
/* ultralight READ page 80 */
0xE6U, 0x22U, 0x0FU, 0x99U, 0x39U, 0x82U, 0x79U, 0x60U,
0x58U, 0x2EU, 0xBEU, 0xF7U, 0xEFU, 0xF7U, 0x95U, 0x62U,
/* STEP 22: ultralight READ page 84 */
/* ultralight READ page 84 */
0xD5U, 0x06U, 0x1BU, 0x58U, 0x65U, 0x05U, 0xA9U, 0x08U,
0x75U, 0xEDU, 0x5DU, 0x90U, 0x5AU, 0xE1U, 0x7EU, 0xC9U,
/* STEP 23: ultralight READ page 88 */
/* ultralight READ page 88 */
0x35U, 0xD6U, 0x29U, 0xBBU, 0xD0U, 0x67U, 0x6CU, 0xF9U,
0xA0U, 0xFFU, 0x0BU, 0x93U, 0x22U, 0xEAU, 0xA3U, 0x3FU,
/* STEP 24: ultralight READ page 92 */
/* ultralight READ page 92 */
0xE2U, 0xBDU, 0xBDU, 0x58U, 0xBEU, 0x93U, 0xD9U, 0x94U,
0x41U, 0xCCU, 0x7EU, 0x40U, 0xE6U, 0x8CU, 0x5AU, 0x43U,
/* STEP 25: ultralight READ page 96 */
/* ultralight READ page 96 */
0x65U, 0xC1U, 0x24U, 0x94U, 0xB9U, 0x97U, 0x61U, 0x13U,
0xADU, 0x74U, 0xFFU, 0x21U, 0x0FU, 0xECU, 0xF6U, 0x03U,
/* STEP 26: ultralight READ page 100 */
/* ultralight READ page 100 */
0x89U, 0x5DU, 0x89U, 0xE5U, 0x8DU, 0x11U, 0xF8U, 0xD7U,
0x33U, 0x43U, 0x79U, 0x2EU, 0x23U, 0xE5U, 0x29U, 0xB5U,
/* STEP 27: ultralight READ page 104 */
/* ultralight READ page 104 */
0x53U, 0x98U, 0x13U, 0xFFU, 0xE8U, 0x79U, 0x8BU, 0x33U,
0x45U, 0x6CU, 0x34U, 0x38U, 0x3BU, 0x69U, 0x28U, 0xD7U,
/* STEP 28: ultralight READ page 108 */
/* ultralight READ page 108 */
0xD2U, 0x80U, 0xB0U, 0x2FU, 0xD0U, 0x18U, 0xD5U, 0xDDU,
0x6CU, 0x2DU, 0xD9U, 0x97U, 0xCAU, 0x78U, 0xB4U, 0xA2U,
/* STEP 29: ultralight READ page 112 */
/* ultralight READ page 112 */
0xB7U, 0x3EU, 0xB8U, 0x79U, 0xA2U, 0xBEU, 0x54U, 0xE4U,
0xC8U, 0x28U, 0x0CU, 0x4AU, 0x81U, 0xE7U, 0xECU, 0x1CU,
/* STEP 30: ultralight READ page 116 */
/* ultralight READ page 116 */
0x39U, 0x93U, 0x6FU, 0x70U, 0x75U, 0x77U, 0x5CU, 0xFCU,
0x66U, 0x58U, 0x0CU, 0x1CU, 0x9FU, 0x70U, 0x2EU, 0xC8U,
/* STEP 31: ultralight READ page 120 */
/* ultralight READ page 120 */
0x52U, 0x4AU, 0x52U, 0xBDU, 0x56U, 0xD5U, 0x6AU, 0x15U,
0x54U, 0x1BU, 0x33U, 0x90U, 0x44U, 0x11U, 0xC1U, 0x07U,
/* STEP 32: ultralight READ page 124 */
/* ultralight READ page 124 */
0x11U, 0x5CU, 0xBAU, 0x80U, 0x10U, 0x14U, 0x20U, 0x9AU,
0x4AU, 0xD8U, 0xE6U, 0x36U, 0xDAU, 0xB8U, 0x59U, 0xE5U,
/* STEP 33: ultralight READ page 128 */
/* ultralight READ page 128 */
0x5EU, 0x48U, 0x95U, 0xDAU, 0x96U, 0x6AU, 0x26U, 0x85U,
0x01U, 0x00U, 0x0FU, 0xBDU, 0x00U, 0x00U, 0x00U, 0x04U,
/* STEP 34: ultralight READ page 132 */
/* ultralight READ page 132 */
0x5FU, 0x00U, 0x00U, 0x00U, 0x00U, 0x00U, 0x00U, 0x00U,
0x00U, 0x00U, 0x00U, 0x00U, 0x00U, 0x00U, 0x00U, 0x00U,
/* STEP 35: ultralight READ_SIG */
/* ultralight READ_SIG */
0x42U, 0x21U, 0xE4U, 0x6CU, 0x79U, 0x6AU, 0x81U, 0x5EU,
0xEAU, 0x0DU, 0x93U, 0x6DU, 0x85U, 0xEEU, 0x4BU, 0x0CU,
0x2AU, 0x00U, 0xD5U, 0x77U, 0xF1U, 0xC5U, 0x67U, 0xF3U,
0x63U, 0x75U, 0xF8U, 0xEBU, 0x86U, 0x48U, 0x5EU, 0x6BU,
/* STEP 36: ultralight READ_CNT 0 */
/* ultralight READ_CNT 0 */
0x00U, 0x00U, 0x00U,
/* STEP 37: ultralight READ_CNT 1 */
/* ultralight READ_CNT 1 */
0x00U, 0x00U, 0x00U,
/* STEP 38: ultralight READ_CNT 2 */
/* ultralight READ_CNT 2 */
0x00U, 0x00U, 0x00U,
/* STEP 39: ultralight CHECK_TEARING 0 */
/* ultralight CHECK_TEARING 0 */
0x00U,
/* STEP 40: ultralight CHECK_TEARING 1 */
/* ultralight CHECK_TEARING 1 */
0x00U,
/* STEP 41: ultralight CHECK_TEARING 2 */
/* ultralight CHECK_TEARING 2 */
0x00U,

/* Tier B nfc_session_mock RX script — one STEP per transceive */
/* STEP 0: ultralight GET_VERSION */
/* ultralight GET_VERSION */
0x00U, 0x04U, 0x03U, 0x01U, 0x01U, 0x00U, 0x0BU, 0x03U,
/* STEP 1: ultralight READ page 0 */
/* ultralight READ page 0 */
0x04U, 0x15U, 0x74U, 0xEDU, 0xF2U, 0xB0U, 0x5EU, 0x81U,
0x9DU, 0x48U, 0xF8U, 0xFFU, 0xC1U, 0x31U, 0x3EU, 0x3FU,
/* STEP 2: ultralight READ page 4 */
/* ultralight READ page 4 */
0xB0U, 0x00U, 0xF0U, 0x02U, 0x2FU, 0xB3U, 0x45U, 0xA0U,
0xD4U, 0x9CU, 0x02U, 0xF2U, 0x4AU, 0xB1U, 0xEDU, 0xFFU,
/* STEP 3: ultralight READ page 8 */
/* ultralight READ page 8 */
0xC8U, 0x01U, 0x00U, 0x02U, 0x4FU, 0xB3U, 0x46U, 0x70U,
0xEEU, 0xF6U, 0x60U, 0xB0U, 0xB6U, 0xC6U, 0x12U, 0x1BU,
/* STEP 4: ultralight READ page 12 */
/* ultralight READ page 12 */
0xB9U, 0x1EU, 0x49U, 0xC3U, 0x49U, 0xDFU, 0x7AU, 0x57U,
0x08U, 0x52U, 0x2AU, 0x11U, 0x28U, 0x0AU, 0x28U, 0x59U,
/* STEP 5: ultralight READ page 16 */
/* ultralight READ page 16 */
0x00U, 0x00U, 0x00U, 0xFFU, 0x00U, 0x05U, 0x00U, 0x00U,
0xFFU, 0xFFU, 0xFFU, 0xFFU, 0x00U, 0x00U, 0x00U, 0x00U,
/* STEP 6: ultralight READ_SIG */
/* ultralight READ_SIG */
0xA4U, 0x37U, 0x7DU, 0xE5U, 0x8CU, 0x2FU, 0x88U, 0xD8U,
0x04U, 0x60U, 0x41U, 0x6EU, 0x3AU, 0xC8U, 0xCDU, 0xDBU,
0x19U, 0x94U, 0x26U, 0x12U, 0xC5U, 0xD0U, 0x12U, 0xB0U,
0xEBU, 0x88U, 0x05U, 0x72U, 0x89U, 0xF2U, 0xA5U, 0x61U,
/* STEP 7: ultralight READ_CNT 0 */
/* ultralight READ_CNT 0 */
0x00U, 0x00U, 0x00U,
/* STEP 8: ultralight READ_CNT 1 */
/* ultralight READ_CNT 1 */
0x00U, 0x00U, 0x00U,
/* STEP 9: ultralight READ_CNT 2 */
/* ultralight READ_CNT 2 */
0x00U, 0x00U, 0x00U,
/* STEP 10: ultralight CHECK_TEARING 0 */
/* ultralight CHECK_TEARING 0 */
0xBDU,
/* STEP 11: ultralight CHECK_TEARING 1 */
/* ultralight CHECK_TEARING 1 */
0xBDU,
/* STEP 12: ultralight CHECK_TEARING 2 */
/* ultralight CHECK_TEARING 2 */
0xBDU,

/* Tier B nfc_session_mock RX script — one STEP per transceive */
/* STEP 0: ultralight READ page 0 */
/* ultralight READ page 0 */
0x04U, 0xD9U, 0x65U, 0x30U, 0x0AU, 0x32U, 0x5EU, 0x80U,
0xE6U, 0x48U, 0x00U, 0x00U, 0xE1U, 0x10U, 0x6DU, 0x00U,
/* STEP 1: ultralight READ page 4 */
/* ultralight READ page 4 */
0x03U, 0x37U, 0xD1U, 0x01U, 0x33U, 0x55U, 0x04U, 0x6DU,
0x2EU, 0x79U, 0x6FU, 0x75U, 0x74U, 0x75U, 0x62U, 0x65U,
/* STEP 2: ultralight READ page 8 */
/* ultralight READ page 8 */
0x2EU, 0x63U, 0x6FU, 0x6DU, 0x2FU, 0x77U, 0x61U, 0x74U,
0x63U, 0x68U, 0x3FU, 0x76U, 0x3DU, 0x62U, 0x78U, 0x71U,
/* STEP 3: ultralight READ page 12 */
/* ultralight READ page 12 */
0x4CU, 0x73U, 0x72U, 0x6CU, 0x61U, 0x6BU, 0x4BU, 0x38U,
0x26U, 0x66U, 0x65U, 0x61U, 0x74U, 0x75U, 0x72U, 0x65U,
/* STEP 4: ultralight READ page 16 */
/* ultralight READ page 16 */
0x3DU, 0x79U, 0x6FU, 0x75U, 0x74U, 0x75U, 0x2EU, 0x62U,
0x65U, 0xFEU, 0x00U, 0x00U, 0x00U, 0x00U, 0x00U, 0x00U,
/* STEP 5: ultralight READ page 20 */
/* ultralight READ page 20 */
0x00U, 0x00U, 0x00U, 0x00U, 0x00U, 0x00U, 0x00U, 0x00U,
0x00U, 0x00U, 0x00U, 0x00U, 0x00U, 0x00U, 0x00U, 0x00U,
/* STEP 6: ultralight READ page 24 */
/* ultralight READ page 24 */
0x00U, 0x00U, 0x00U, 0x00U, 0x00U, 0x00U, 0x00U, 0x00U,
0x00U, 0x00U, 0x00U, 0x00U, 0x00U, 0x00U, 0x00U, 0x00U,
/* STEP 7: ultralight READ page 28 */
/* ultralight READ page 28 */
0x00U, 0x00U, 0x00U, 0x00U, 0x00U, 0x00U, 0x00U, 0x00U,
0x00U, 0x00U, 0x00U, 0x00U, 0x00U, 0x00U, 0x00U, 0x00U,
/* STEP 8: ultralight READ page 32 */
/* ultralight READ page 32 */
0x00U, 0x00U, 0x00U, 0x00U, 0x00U, 0x00U, 0x00U, 0x00U,
0x00U, 0x00U, 0x00U, 0x00U, 0x00U, 0x00U, 0x00U, 0x00U,
/* STEP 9: ultralight READ page 36 */
/* ultralight READ page 36 */
0x00U, 0x00U, 0x00U, 0x00U, 0x00U, 0x00U, 0x00U, 0x00U,
0x00U, 0x00U, 0x00U, 0x00U, 0x00U, 0x00U, 0x00U, 0x00U,
/* STEP 10: ultralight READ page 40 */
/* ultralight READ page 40 */
0x00U, 0x00U, 0x00U, 0x00U, 0x00U, 0x00U, 0x00U, 0x00U,
0x00U, 0x00U, 0x00U, 0x00U, 0x00U, 0x00U, 0x00U, 0x00U,
/* STEP 11: ultralight READ page 44 */
/* ultralight READ page 44 */
0x00U, 0x00U, 0x00U, 0x00U, 0x00U, 0x00U, 0x00U, 0x00U,
0x00U, 0x00U, 0x00U, 0x00U, 0x00U, 0x00U, 0x00U, 0x00U,
/* STEP 12: ultralight READ page 48 */
/* ultralight READ page 48 */
0x00U, 0x00U, 0x00U, 0x00U, 0x00U, 0x00U, 0x00U, 0x00U,
0x00U, 0x00U, 0x00U, 0x00U, 0x00U, 0x00U, 0x00U, 0x00U,
/* STEP 13: ultralight READ page 52 */
/* ultralight READ page 52 */
0x00U, 0x00U, 0x00U, 0x00U, 0x00U, 0x00U, 0x00U, 0x00U,
0x00U, 0x00U, 0x00U, 0x00U, 0x00U, 0x00U, 0x00U, 0x00U,
/* STEP 14: ultralight READ page 56 */
/* ultralight READ page 56 */
0x00U, 0x00U, 0x00U, 0x00U, 0x00U, 0x00U, 0x00U, 0x00U,
0x00U, 0x00U, 0x00U, 0x00U, 0x00U, 0x00U, 0x00U, 0x00U,
/* STEP 15: ultralight READ page 60 */
/* ultralight READ page 60 */
0x00U, 0x00U, 0x00U, 0x00U, 0x00U, 0x00U, 0x00U, 0x00U,
0x00U, 0x00U, 0x00U, 0x00U, 0x00U, 0x00U, 0x00U, 0x00U,
/* STEP 16: ultralight READ page 64 */
/* ultralight READ page 64 */
0x00U, 0x00U, 0x00U, 0x00U, 0x00U, 0x00U, 0x00U, 0x00U,
0x00U, 0x00U, 0x00U, 0x00U, 0x00U, 0x00U, 0x00U, 0x00U,
/* STEP 17: ultralight READ page 68 */
/* ultralight READ page 68 */
0x00U, 0x00U, 0x00U, 0x00U, 0x00U, 0x00U, 0x00U, 0x00U,
0x00U, 0x00U, 0x00U, 0x00U, 0x00U, 0x00U, 0x00U, 0x00U,
/* STEP 18: ultralight READ page 72 */
/* ultralight READ page 72 */
0x00U, 0x00U, 0x00U, 0x00U, 0x00U, 0x00U, 0x00U, 0x00U,
0x00U, 0x00U, 0x00U, 0x00U, 0x00U, 0x00U, 0x00U, 0x00U,
/* STEP 19: ultralight READ page 76 */
/* ultralight READ page 76 */
0x00U, 0x00U, 0x00U, 0x00U, 0x00U, 0x00U, 0x00U, 0x00U,
0x00U, 0x00U, 0x00U, 0x00U, 0x00U, 0x00U, 0x00U, 0x00U,
/* STEP 20: ultralight READ page 80 */
/* ultralight READ page 80 */
0x00U, 0x00U, 0x00U, 0x00U, 0x00U, 0x00U, 0x00U, 0x00U,
0x00U, 0x00U, 0x00U, 0x00U, 0x00U, 0x00U, 0x00U, 0x00U,
/* STEP 21: ultralight READ page 84 */
/* ultralight READ page 84 */
0x00U, 0x00U, 0x00U, 0x00U, 0x00U, 0x00U, 0x00U, 0x00U,
0x00U, 0x00U, 0x00U, 0x00U, 0x00U, 0x00U, 0x00U, 0x00U,
/* STEP 22: ultralight READ page 88 */
/* ultralight READ page 88 */
0x00U, 0x00U, 0x00U, 0x00U, 0x00U, 0x00U, 0x00U, 0x00U,
0x00U, 0x00U, 0x00U, 0x00U, 0x00U, 0x00U, 0x00U, 0x00U,
/* STEP 23: ultralight READ page 92 */
/* ultralight READ page 92 */
0x00U, 0x00U, 0x00U, 0x00U, 0x00U, 0x00U, 0x00U, 0x00U,
0x00U, 0x00U, 0x00U, 0x00U, 0x00U, 0x00U, 0x00U, 0x00U,
/* STEP 24: ultralight READ page 96 */
/* ultralight READ page 96 */
0x00U, 0x00U, 0x00U, 0x00U, 0x00U, 0x00U, 0x00U, 0x00U,
0x00U, 0x00U, 0x00U, 0x00U, 0x00U, 0x00U, 0x00U, 0x00U,
/* STEP 25: ultralight READ page 100 */
/* ultralight READ page 100 */
0x00U, 0x00U, 0x00U, 0x00U, 0x00U, 0x00U, 0x00U, 0x00U,
0x00U, 0x00U, 0x00U, 0x00U, 0x00U, 0x00U, 0x00U, 0x00U,
/* STEP 26: ultralight READ page 104 */
/* ultralight READ page 104 */
0x00U, 0x00U, 0x00U, 0x00U, 0x00U, 0x00U, 0x00U, 0x00U,
0x00U, 0x00U, 0x00U, 0x00U, 0x00U, 0x00U, 0x00U, 0x00U,
/* STEP 27: ultralight READ page 108 */
/* ultralight READ page 108 */
0x00U, 0x00U, 0x00U, 0x00U, 0x00U, 0x00U, 0x00U, 0x00U,
0x00U, 0x00U, 0x00U, 0x00U, 0x00U, 0x00U, 0x00U, 0x00U,
/* STEP 28: ultralight READ page 112 */
/* ultralight READ page 112 */
0x00U, 0x00U, 0x00U, 0x00U, 0x00U, 0x00U, 0x00U, 0x00U,
0x00U, 0x00U, 0x00U, 0x00U, 0x00U, 0x00U, 0x00U, 0x00U,
/* STEP 29: ultralight READ page 116 */
/* ultralight READ page 116 */
0x00U, 0x00U, 0x00U, 0x00U, 0x00U, 0x00U, 0x00U, 0x00U,
0x00U, 0x00U, 0x00U, 0x00U, 0x00U, 0x00U, 0x00U, 0x00U,
/* STEP 30: ultralight READ page 120 */
/* ultralight READ page 120 */
0x00U, 0x00U, 0x00U, 0x00U, 0x00U, 0x00U, 0x00U, 0x00U,
0x00U, 0x00U, 0x00U, 0x00U, 0x00U, 0x00U, 0x00U, 0x00U,
/* STEP 31: ultralight READ page 124 */
/* ultralight READ page 124 */
0x00U, 0x00U, 0x00U, 0x00U, 0x00U, 0x00U, 0x00U, 0x00U,
0x00U, 0x00U, 0x00U, 0x00U, 0x00U, 0x00U, 0x00U, 0x00U,
/* STEP 32: ultralight READ page 128 */
/* ultralight READ page 128 */
0x00U, 0x00U, 0x00U, 0x00U, 0x00U, 0x00U, 0x00U, 0x00U,
0x00U, 0x00U, 0x00U, 0x00U, 0x00U, 0x00U, 0x00U, 0x00U,
/* STEP 33: ultralight READ page 132 */
/* ultralight READ page 132 */
0x00U, 0x00U, 0x00U, 0x00U, 0x00U, 0x00U, 0x00U, 0x00U,
0x00U, 0x00U, 0x00U, 0x00U, 0x00U, 0x00U, 0x00U, 0x00U,
/* STEP 34: ultralight READ page 136 */
/* ultralight READ page 136 */
0x00U, 0x00U, 0x00U, 0x00U, 0x00U, 0x00U, 0x00U, 0x00U,
0x00U, 0x00U, 0x00U, 0x00U, 0x00U, 0x00U, 0x00U, 0x00U,
/* STEP 35: ultralight READ page 140 */
/* ultralight READ page 140 */
0x00U, 0x00U, 0x00U, 0x00U, 0x00U, 0x00U, 0x00U, 0x00U,
0x00U, 0x00U, 0x00U, 0x00U, 0x00U, 0x00U, 0x00U, 0x00U,
/* STEP 36: ultralight READ page 144 */
/* ultralight READ page 144 */
0x00U, 0x00U, 0x00U, 0x00U, 0x00U, 0x00U, 0x00U, 0x00U,
0x00U, 0x00U, 0x00U, 0x00U, 0x00U, 0x00U, 0x00U, 0x00U,
/* STEP 37: ultralight READ page 148 */
/* ultralight READ page 148 */
0x00U, 0x00U, 0x00U, 0x00U, 0x00U, 0x00U, 0x00U, 0x00U,
0x00U, 0x00U, 0x00U, 0x00U, 0x00U, 0x00U, 0x00U, 0x00U,
/* STEP 38: ultralight READ page 152 */
/* ultralight READ page 152 */
0x00U, 0x00U, 0x00U, 0x00U, 0x00U, 0x00U, 0x00U, 0x00U,
0x00U, 0x00U, 0x00U, 0x00U, 0x00U, 0x00U, 0x00U, 0x00U,
/* STEP 39: ultralight READ page 156 */
/* ultralight READ page 156 */
0x00U, 0x00U, 0x00U, 0x00U, 0x00U, 0x00U, 0x00U, 0x00U,
0x00U, 0x00U, 0x00U, 0x00U, 0x00U, 0x00U, 0x00U, 0x00U,
/* STEP 40: ultralight READ page 160 */
/* ultralight READ page 160 */
0x00U, 0x00U, 0x00U, 0x00U, 0x00U, 0x00U, 0x00U, 0x00U,
0x00U, 0x00U, 0x00U, 0x00U, 0x00U, 0x00U, 0x00U, 0x00U,
/* STEP 41: ultralight READ page 164 */
/* ultralight READ page 164 */
0x00U, 0x00U, 0x00U, 0x00U, 0x00U, 0x00U, 0x00U, 0x00U,
0x00U, 0x00U, 0x00U, 0x00U, 0x00U, 0x00U, 0x00U, 0x00U,
/* STEP 42: ultralight READ page 168 */
/* ultralight READ page 168 */
0x00U, 0x00U, 0x00U, 0x00U, 0x00U, 0x00U, 0x00U, 0x00U,
0x00U, 0x00U, 0x00U, 0x00U, 0x00U, 0x00U, 0x00U, 0x00U,
/* STEP 43: ultralight READ page 172 */
/* ultralight READ page 172 */
0x00U, 0x00U, 0x00U, 0x00U, 0x00U, 0x00U, 0x00U, 0x00U,
0x00U, 0x00U, 0x00U, 0x00U, 0x00U, 0x00U, 0x00U, 0x00U,
/* STEP 44: ultralight READ page 176 */
/* ultralight READ page 176 */
0x00U, 0x00U, 0x00U, 0x00U, 0x00U, 0x00U, 0x00U, 0x00U,
0x00U, 0x00U, 0x00U, 0x00U, 0x00U, 0x00U, 0x00U, 0x00U,
/* STEP 45: ultralight READ page 180 */
/* ultralight READ page 180 */
0x00U, 0x00U, 0x00U, 0x00U, 0x00U, 0x00U, 0x00U, 0x00U,
0x00U, 0x00U, 0x00U, 0x00U, 0x00U, 0x00U, 0x00U, 0x00U,
/* STEP 46: ultralight READ page 184 */
/* ultralight READ page 184 */
0x00U, 0x00U, 0x00U, 0x00U, 0x00U, 0x00U, 0x00U, 0x00U,
0x00U, 0x00U, 0x00U, 0x00U, 0x00U, 0x00U, 0x00U, 0x00U,
/* STEP 47: ultralight READ page 188 */
/* ultralight READ page 188 */
0x00U, 0x00U, 0x00U, 0x00U, 0x00U, 0x00U, 0x00U, 0x00U,
0x00U, 0x00U, 0x00U, 0x00U, 0x00U, 0x00U, 0x00U, 0x00U,
/* STEP 48: ultralight READ page 192 */
/* ultralight READ page 192 */
0x00U, 0x00U, 0x00U, 0x00U, 0x00U, 0x00U, 0x00U, 0x00U,
0x00U, 0x00U, 0x00U, 0x00U, 0x00U, 0x00U, 0x00U, 0x00U,
/* STEP 49: ultralight READ page 196 */
/* ultralight READ page 196 */
0x00U, 0x00U, 0x00U, 0x00U, 0x00U, 0x00U, 0x00U, 0x00U,
0x00U, 0x00U, 0x00U, 0x00U, 0x00U, 0x00U, 0x00U, 0x00U,
/* STEP 50: ultralight READ page 200 */
/* ultralight READ page 200 */
0x00U, 0x00U, 0x00U, 0x00U, 0x00U, 0x00U, 0x00U, 0x00U,
0x00U, 0x00U, 0x00U, 0x00U, 0x00U, 0x00U, 0x00U, 0x00U,
/* STEP 51: ultralight READ page 204 */
/* ultralight READ page 204 */
0x00U, 0x00U, 0x00U, 0x00U, 0x00U, 0x00U, 0x00U, 0x00U,
0x00U, 0x00U, 0x00U, 0x00U, 0x00U, 0x00U, 0x00U, 0x00U,
/* STEP 52: ultralight READ page 208 */
/* ultralight READ page 208 */
0x00U, 0x00U, 0x00U, 0x00U, 0x00U, 0x00U, 0x00U, 0x00U,
0x00U, 0x00U, 0x00U, 0x00U, 0x00U, 0x00U, 0x00U, 0x00U,
/* STEP 53: ultralight READ page 212 */
/* ultralight READ page 212 */
0x00U, 0x00U, 0x00U, 0x00U, 0x00U, 0x00U, 0x00U, 0x00U,
0x00U, 0x00U, 0x00U, 0x00U, 0x00U, 0x00U, 0x00U, 0x00U,
/* STEP 54: ultralight READ page 216 */
/* ultralight READ page 216 */
0x00U, 0x00U, 0x00U, 0x00U, 0x00U, 0x00U, 0x00U, 0x00U,
0x00U, 0x00U, 0x00U, 0x00U, 0x00U, 0x00U, 0x00U, 0x00U,
/* STEP 55: ultralight READ page 220 */
/* ultralight READ page 220 */
0x00U, 0x00U, 0x00U, 0x00U, 0x00U, 0x00U, 0x00U, 0x00U,
0x00U, 0x00U, 0x00U, 0x00U, 0x00U, 0x00U, 0x00U, 0x00U,
/* STEP 56: ultralight READ page 224 */
/* ultralight READ page 224 */
0x00U, 0x00U, 0x00U, 0x00U, 0x00U, 0x00U, 0x00U, 0x00U,
0x00U, 0x00U, 0x00U, 0xBDU, 0x04U, 0x00U, 0x00U, 0xFFU,
/* STEP 57: ultralight READ page 228 */
/* ultralight READ page 228 */
0x00U, 0x05U, 0x00U, 0x00U, 0x00U, 0x00U, 0x00U, 0x00U,
0x00U, 0x00U, 0x00U, 0x00U, 0x00U, 0x00U, 0x00U, 0x00U,

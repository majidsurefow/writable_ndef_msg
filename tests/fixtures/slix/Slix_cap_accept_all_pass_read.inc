/* Tier B nfc_session_mock RX script — one STEP per transceive */
/* STEP 0: iso15693 inventory */
/* iso15693 inventory */
0x00U, 0x01U, 0x81U, 0xDCU, 0xD0U, 0x49U, 0x08U, 0x01U,
0x04U, 0xE0U,
/* STEP 1: iso15693 GET_SYSTEM_INFO */
/* iso15693 GET_SYSTEM_INFO */
0x00U, 0x50U, 0x00U, 0x04U,
/* STEP 2: iso15693 READ block 0 */
/* iso15693 READ block 0 */
0x00U, 0x03U, 0x0AU, 0x82U, 0xEDU,
/* STEP 3: iso15693 READ block 1 */
/* iso15693 READ block 1 */
0x00U, 0x86U, 0x39U, 0x61U, 0xD2U,
/* STEP 4: iso15693 READ block 2 */
/* iso15693 READ block 2 */
0x00U, 0x03U, 0x14U, 0x1EU, 0x32U,
/* STEP 5: iso15693 READ block 3 */
/* iso15693 READ block 3 */
0x00U, 0xB6U, 0xCAU, 0x00U, 0x3CU,
/* STEP 6: iso15693 READ block 4 */
/* iso15693 READ block 4 */
0x00U, 0x36U, 0x42U, 0x0CU, 0x33U,
/* STEP 7: iso15693 READ block 5 */
/* iso15693 READ block 5 */
0x00U, 0x53U, 0x30U, 0x37U, 0x32U,
/* STEP 8: iso15693 READ block 6 */
/* iso15693 READ block 6 */
0x00U, 0x32U, 0x34U, 0x30U, 0x30U,
/* STEP 9: iso15693 READ block 7 */
/* iso15693 READ block 7 */
0x00U, 0x00U, 0x00U, 0x00U, 0x00U,
/* STEP 10: iso15693 READ block 8 */
/* iso15693 READ block 8 */
0x00U, 0x00U, 0xFFU, 0x04U, 0x01U,
/* STEP 11: iso15693 READ block 9 */
/* iso15693 READ block 9 */
0x00U, 0x01U, 0x00U, 0x00U, 0x00U,
/* STEP 12: iso15693 READ block 10 */
/* iso15693 READ block 10 */
0x00U, 0xA3U, 0x03U, 0x1EU, 0x00U,
/* STEP 13: iso15693 READ block 11 */
/* iso15693 READ block 11 */
0x00U, 0x26U, 0x00U, 0x00U, 0x00U,
/* STEP 14: iso15693 READ block 12 */
/* iso15693 READ block 12 */
0x00U, 0x00U, 0x00U, 0x0FU, 0x00U,
/* STEP 15: iso15693 READ block 13 */
/* iso15693 READ block 13 */
0x00U, 0x76U, 0x03U, 0x65U, 0x01U,
/* STEP 16: iso15693 READ block 14 */
/* iso15693 READ block 14 */
0x00U, 0x00U, 0x00U, 0x00U, 0x00U,
/* STEP 17: iso15693 READ block 15 */
/* iso15693 READ block 15 */
0x00U, 0x85U, 0x01U, 0x34U, 0x00U,
/* STEP 18: iso15693 READ block 16 */
/* iso15693 READ block 16 */
0x00U, 0x75U, 0x09U, 0x05U, 0x00U,
/* STEP 19: iso15693 READ block 17 */
/* iso15693 READ block 17 */
0x00U, 0x01U, 0x00U, 0x00U, 0x00U,
/* STEP 20: iso15693 READ block 18 */
/* iso15693 READ block 18 */
0x00U, 0x00U, 0x00U, 0x00U, 0x00U,
/* STEP 21: iso15693 READ block 19 */
/* iso15693 READ block 19 */
0x00U, 0x00U, 0x00U, 0x00U, 0x00U,
/* STEP 22: iso15693 READ block 20 */
/* iso15693 READ block 20 */
0x00U, 0xD7U, 0xFAU, 0x00U, 0x1CU,
/* STEP 23: iso15693 READ block 21 */
/* iso15693 READ block 21 */
0x00U, 0x9EU, 0x1CU, 0x67U, 0x27U,
/* STEP 24: iso15693 READ block 22 */
/* iso15693 READ block 22 */
0x00U, 0x00U, 0x30U, 0x30U, 0x30U,
/* STEP 25: iso15693 READ block 23 */
/* iso15693 READ block 23 */
0x00U, 0x30U, 0x30U, 0x30U, 0x30U,
/* STEP 26: iso15693 READ block 24 */
/* iso15693 READ block 24 */
0x00U, 0x30U, 0x30U, 0x30U, 0x00U,
/* STEP 27: iso15693 READ block 25 */
/* iso15693 READ block 25 */
0x00U, 0x00U, 0x00U, 0x97U, 0x25U,
/* STEP 28: iso15693 READ block 26 */
/* iso15693 READ block 26 */
0x00U, 0x55U, 0x08U, 0x00U, 0x00U,
/* STEP 29: iso15693 READ block 27 */
/* iso15693 READ block 27 */
0x00U, 0x00U, 0x00U, 0x00U, 0x00U,
/* STEP 30: iso15693 READ block 28 */
/* iso15693 READ block 28 */
0x00U, 0x00U, 0x00U, 0x00U, 0x00U,
/* STEP 31: iso15693 READ block 29 */
/* iso15693 READ block 29 */
0x00U, 0x00U, 0x00U, 0x00U, 0x00U,
/* STEP 32: iso15693 READ block 30 */
/* iso15693 READ block 30 */
0x00U, 0x32U, 0x8CU, 0x00U, 0x30U,
/* STEP 33: iso15693 READ block 31 */
/* iso15693 READ block 31 */
0x00U, 0x53U, 0x48U, 0x80U, 0xDEU,
/* STEP 34: iso15693 READ block 32 */
/* iso15693 READ block 32 */
0x00U, 0x00U, 0x00U, 0x00U, 0x00U,
/* STEP 35: iso15693 READ block 33 */
/* iso15693 READ block 33 */
0x00U, 0xF4U, 0xC3U, 0x58U, 0x2BU,
/* STEP 36: iso15693 READ block 34 */
/* iso15693 READ block 34 */
0x00U, 0x00U, 0x00U, 0x00U, 0x00U,
/* STEP 37: iso15693 READ block 35 */
/* iso15693 READ block 35 */
0x00U, 0x00U, 0x00U, 0x00U, 0x00U,
/* STEP 38: iso15693 READ block 36 */
/* iso15693 READ block 36 */
0x00U, 0x00U, 0x00U, 0x00U, 0x00U,
/* STEP 39: iso15693 READ block 37 */
/* iso15693 READ block 37 */
0x00U, 0x00U, 0x00U, 0x00U, 0x00U,
/* STEP 40: iso15693 READ block 38 */
/* iso15693 READ block 38 */
0x00U, 0x00U, 0x00U, 0x00U, 0x00U,
/* STEP 41: iso15693 READ block 39 */
/* iso15693 READ block 39 */
0x00U, 0x00U, 0x00U, 0x00U, 0x00U,
/* STEP 42: iso15693 READ block 40 */
/* iso15693 READ block 40 */
0x00U, 0x00U, 0x00U, 0x00U, 0x00U,
/* STEP 43: iso15693 READ block 41 */
/* iso15693 READ block 41 */
0x00U, 0x00U, 0x00U, 0x00U, 0x00U,
/* STEP 44: iso15693 READ block 42 */
/* iso15693 READ block 42 */
0x00U, 0x00U, 0x00U, 0x00U, 0x00U,
/* STEP 45: iso15693 READ block 43 */
/* iso15693 READ block 43 */
0x00U, 0x00U, 0x00U, 0x00U, 0x00U,
/* STEP 46: iso15693 READ block 44 */
/* iso15693 READ block 44 */
0x00U, 0x00U, 0x00U, 0x00U, 0x00U,
/* STEP 47: iso15693 READ block 45 */
/* iso15693 READ block 45 */
0x00U, 0x00U, 0x00U, 0x00U, 0x00U,
/* STEP 48: iso15693 READ block 46 */
/* iso15693 READ block 46 */
0x00U, 0x00U, 0x00U, 0x00U, 0x00U,
/* STEP 49: iso15693 READ block 47 */
/* iso15693 READ block 47 */
0x00U, 0x00U, 0x00U, 0x00U, 0x00U,
/* STEP 50: iso15693 READ block 48 */
/* iso15693 READ block 48 */
0x00U, 0x00U, 0x00U, 0x00U, 0x00U,
/* STEP 51: iso15693 READ block 49 */
/* iso15693 READ block 49 */
0x00U, 0x00U, 0x00U, 0x00U, 0x00U,
/* STEP 52: iso15693 READ block 50 */
/* iso15693 READ block 50 */
0x00U, 0x11U, 0xF3U, 0x00U, 0x2CU,
/* STEP 53: iso15693 READ block 51 */
/* iso15693 READ block 51 */
0x00U, 0xDDU, 0xC3U, 0x3EU, 0x91U,
/* STEP 54: iso15693 READ block 52 */
/* iso15693 READ block 52 */
0x00U, 0x00U, 0x00U, 0x00U, 0x00U,
/* STEP 55: iso15693 READ block 53 */
/* iso15693 READ block 53 */
0x00U, 0x00U, 0x00U, 0x00U, 0x00U,
/* STEP 56: iso15693 READ block 54 */
/* iso15693 READ block 54 */
0x00U, 0x00U, 0x00U, 0x00U, 0x00U,
/* STEP 57: iso15693 READ block 55 */
/* iso15693 READ block 55 */
0x00U, 0x00U, 0x00U, 0x00U, 0x00U,
/* STEP 58: iso15693 READ block 56 */
/* iso15693 READ block 56 */
0x00U, 0x00U, 0x00U, 0x00U, 0x00U,
/* STEP 59: iso15693 READ block 57 */
/* iso15693 READ block 57 */
0x00U, 0x00U, 0x00U, 0x00U, 0x00U,
/* STEP 60: iso15693 READ block 58 */
/* iso15693 READ block 58 */
0x00U, 0x00U, 0x00U, 0x00U, 0x00U,
/* STEP 61: iso15693 READ block 59 */
/* iso15693 READ block 59 */
0x00U, 0x00U, 0x00U, 0x00U, 0x00U,
/* STEP 62: iso15693 READ block 60 */
/* iso15693 READ block 60 */
0x00U, 0x00U, 0x00U, 0x00U, 0x00U,
/* STEP 63: iso15693 READ block 61 */
/* iso15693 READ block 61 */
0x00U, 0x00U, 0x00U, 0x00U, 0x00U,
/* STEP 64: iso15693 READ block 62 */
/* iso15693 READ block 62 */
0x00U, 0x00U, 0x00U, 0x00U, 0x00U,
/* STEP 65: iso15693 READ block 63 */
/* iso15693 READ block 63 */
0x00U, 0x00U, 0x00U, 0x00U, 0x00U,
/* STEP 66: iso15693 READ block 64 */
/* iso15693 READ block 64 */
0x00U, 0x00U, 0x00U, 0x00U, 0x00U,
/* STEP 67: iso15693 READ block 65 */
/* iso15693 READ block 65 */
0x00U, 0x00U, 0x00U, 0x00U, 0x00U,
/* STEP 68: iso15693 READ block 66 */
/* iso15693 READ block 66 */
0x00U, 0x00U, 0x00U, 0x00U, 0x00U,
/* STEP 69: iso15693 READ block 67 */
/* iso15693 READ block 67 */
0x00U, 0x00U, 0x00U, 0x00U, 0x00U,
/* STEP 70: iso15693 READ block 68 */
/* iso15693 READ block 68 */
0x00U, 0x00U, 0x00U, 0x00U, 0x00U,
/* STEP 71: iso15693 READ block 69 */
/* iso15693 READ block 69 */
0x00U, 0x00U, 0x00U, 0x00U, 0x00U,
/* STEP 72: iso15693 READ block 70 */
/* iso15693 READ block 70 */
0x00U, 0x00U, 0x00U, 0x00U, 0x00U,
/* STEP 73: iso15693 READ block 71 */
/* iso15693 READ block 71 */
0x00U, 0x00U, 0x00U, 0x00U, 0x00U,
/* STEP 74: iso15693 READ block 72 */
/* iso15693 READ block 72 */
0x00U, 0x00U, 0x00U, 0x00U, 0x00U,
/* STEP 75: iso15693 READ block 73 */
/* iso15693 READ block 73 */
0x00U, 0x00U, 0x00U, 0x00U, 0x00U,
/* STEP 76: iso15693 READ block 74 */
/* iso15693 READ block 74 */
0x00U, 0x00U, 0x00U, 0x00U, 0x00U,
/* STEP 77: iso15693 READ block 75 */
/* iso15693 READ block 75 */
0x00U, 0x00U, 0x00U, 0x00U, 0x00U,
/* STEP 78: iso15693 READ block 76 */
/* iso15693 READ block 76 */
0x00U, 0x00U, 0x00U, 0x00U, 0x00U,
/* STEP 79: iso15693 READ block 77 */
/* iso15693 READ block 77 */
0x00U, 0x00U, 0x00U, 0x00U, 0x00U,
/* STEP 80: iso15693 READ block 78 */
/* iso15693 READ block 78 */
0x00U, 0x00U, 0x00U, 0x00U, 0x00U,
/* STEP 81: iso15693 READ block 79 */
/* iso15693 READ block 79 */
0x00U, 0xE5U, 0xFFU, 0x00U, 0x01U,
/* STEP 82: slix GET_NXP_SYSTEM_INFO */
/* slix GET_NXP_SYSTEM_INFO */
0x00U, 0x0FU,
/* STEP 83: slix READ_SIGNATURE */
/* slix READ_SIGNATURE */
0xA6U, 0x25U, 0x54U, 0x03U, 0x74U, 0x24U, 0xC4U, 0x38U,
0x36U, 0xF4U, 0x89U, 0x70U, 0x76U, 0x1AU, 0x72U, 0x27U,
0x54U, 0xD9U, 0xE7U, 0x3DU, 0x38U, 0xCBU, 0x4CU, 0x1BU,
0x3EU, 0xFDU, 0x0EU, 0xDFU, 0x8AU, 0xF6U, 0x7EU, 0x3DU,
/* STEP 84: slix CAP accept all pass */
/* slix CAP accept all pass */
0xACU,

/* Tier B nfc_session_mock RX script — one STEP per transceive */
/* STEP 0: felica poll response */
/* felica poll response */
0x29U, 0x9FU, 0xFAU, 0x53U, 0xABU, 0x75U, 0x87U, 0x6EU,
/* STEP 1: felica READ block 0 */
/* felica READ block 0 */
0xDEU, 0xADU, 0xBEU, 0xAFU, 0x00U, 0x00U, 0x00U, 0x00U,
0x00U, 0x00U, 0x00U, 0x00U, 0xDEU, 0xADU, 0xBEU, 0xAFU,
/* STEP 2: felica READ block 1 */
/* felica READ block 1 */
0x00U, 0x11U, 0x22U, 0x33U, 0x44U, 0x55U, 0x66U, 0x77U,
0x88U, 0x99U, 0xAAU, 0xBBU, 0xCCU, 0xDDU, 0xEEU, 0xFFU,
/* STEP 3: felica READ block 2 */
/* felica READ block 2 */
0x00U, 0x00U, 0x00U, 0x00U, 0x00U, 0x00U, 0x00U, 0x00U,
0x00U, 0x00U, 0x00U, 0x00U, 0x00U, 0x00U, 0x00U, 0x00U,
/* STEP 4: felica READ block 3 */
/* felica READ block 3 */
0x00U, 0x00U, 0x00U, 0x00U, 0x00U, 0x00U, 0x00U, 0x00U,
0x00U, 0x00U, 0x00U, 0x00U, 0x00U, 0x00U, 0x00U, 0x00U,
/* STEP 5: felica READ block 4 */
/* felica READ block 4 */
0x00U, 0x00U, 0x00U, 0x00U, 0x00U, 0x00U, 0x00U, 0x00U,
0x00U, 0x00U, 0x00U, 0x00U, 0x00U, 0x00U, 0x00U, 0x00U,
/* STEP 6: felica READ block 5 */
/* felica READ block 5 */
0x00U, 0x00U, 0x00U, 0x00U, 0x00U, 0x00U, 0x00U, 0x00U,
0x00U, 0x00U, 0x00U, 0x00U, 0x00U, 0x00U, 0x00U, 0x00U,
/* STEP 7: felica READ block 6 */
/* felica READ block 6 */
0x00U, 0x00U, 0x00U, 0x00U, 0x00U, 0x00U, 0x00U, 0x00U,
0x00U, 0x00U, 0x00U, 0x00U, 0x00U, 0x00U, 0x00U, 0x00U,
/* STEP 8: felica READ block 7 */
/* felica READ block 7 */
0x00U, 0x00U, 0x00U, 0x00U, 0x00U, 0x00U, 0x00U, 0x00U,
0x00U, 0x00U, 0x00U, 0x00U, 0x00U, 0x00U, 0x00U, 0x00U,
/* STEP 9: felica READ block 8 */
/* felica READ block 8 */
0x00U, 0x00U, 0x00U, 0x00U, 0x00U, 0x00U, 0x00U, 0x00U,
0x00U, 0x00U, 0x00U, 0x00U, 0x00U, 0x00U, 0x00U, 0x00U,
/* STEP 10: felica READ block 9 */
/* felica READ block 9 */
0x00U, 0x00U, 0x00U, 0x00U, 0x00U, 0x00U, 0x00U, 0x00U,
0x00U, 0x00U, 0x00U, 0x00U, 0x00U, 0x00U, 0x00U, 0x00U,
/* STEP 11: felica READ block 10 */
/* felica READ block 10 */
0x00U, 0x00U, 0x00U, 0x00U, 0x00U, 0x00U, 0x00U, 0x00U,
0x00U, 0x00U, 0x00U, 0x00U, 0x00U, 0x00U, 0x00U, 0x00U,
/* STEP 12: felica READ block 11 */
/* felica READ block 11 */
0x00U, 0x00U, 0x00U, 0x00U, 0x00U, 0x00U, 0x00U, 0x00U,
0x00U, 0x00U, 0x00U, 0x00U, 0x00U, 0x00U, 0x00U, 0x00U,
/* STEP 13: felica READ block 12 */
/* felica READ block 12 */
0x00U, 0x00U, 0x00U, 0x00U, 0x00U, 0x00U, 0x00U, 0x00U,
0x00U, 0x00U, 0x00U, 0x00U, 0x00U, 0x00U, 0x00U, 0x00U,
/* STEP 14: felica READ block 13 */
/* felica READ block 13 */
0x00U, 0x00U, 0x00U, 0x00U, 0x00U, 0x00U, 0x00U, 0x00U,
0x00U, 0x00U, 0x00U, 0x00U, 0x00U, 0x00U, 0x00U, 0x00U,
/* STEP 15: felica READ block 14 */
/* felica READ block 14 */
0xFFU, 0xFFU, 0xFFU, 0xFFU, 0xFFU, 0xFFU, 0xFFU, 0xFFU,
0xFFU, 0xFFU, 0xFFU, 0xFFU, 0xFFU, 0xFFU, 0xFFU, 0xFFU,
/* STEP 16: felica READ block 15 */
/* felica READ block 15 */
0x00U, 0x00U, 0x00U, 0x00U, 0x00U, 0x00U, 0x00U, 0x00U,
0x00U, 0x00U, 0x00U, 0x00U, 0x00U, 0x00U, 0x00U, 0x00U,
/* STEP 17: felica READ block 16 */
/* felica READ block 16 */
0x00U, 0x00U, 0x00U, 0x00U, 0x00U, 0x00U, 0x00U, 0x00U,
0x00U, 0x00U, 0x00U, 0x00U, 0x00U, 0x00U, 0x00U, 0x00U,
/* STEP 18: felica READ block 17 */
/* felica READ block 17 */
0x29U, 0x9FU, 0xFAU, 0x53U, 0xABU, 0x75U, 0x87U, 0x6EU,
0x57U, 0x4EU, 0x10U, 0x2AU, 0x94U, 0x16U, 0xBCU, 0x8EU,
/* STEP 19: felica READ block 18 */
/* felica READ block 18 */
0x29U, 0x9FU, 0xFAU, 0x53U, 0xABU, 0x75U, 0x87U, 0x6EU,
0x00U, 0xF1U, 0x00U, 0x00U, 0x00U, 0x01U, 0x43U, 0x00U,
/* STEP 20: felica READ block 19 */
/* felica READ block 19 */
0x00U, 0x00U, 0x00U, 0x00U, 0x00U, 0x00U, 0x00U, 0x00U,
0x00U, 0x00U, 0x00U, 0x00U, 0x00U, 0x00U, 0x00U, 0x00U,
/* STEP 21: felica READ block 20 */
/* felica READ block 20 */
0x88U, 0xB4U, 0x00U, 0x00U, 0x00U, 0x00U, 0x00U, 0x00U,
0x00U, 0x00U, 0x00U, 0x00U, 0x00U, 0x00U, 0x00U, 0x00U,
/* STEP 22: felica READ block 21 */
/* felica READ block 21 */
0x00U, 0x00U, 0x00U, 0x00U, 0x00U, 0x00U, 0x00U, 0x00U,
0x00U, 0x00U, 0x00U, 0x00U, 0x00U, 0x00U, 0x00U, 0x00U,
/* STEP 23: felica READ block 22 */
/* felica READ block 22 */
0xFFU, 0xFFU, 0xFFU, 0xFFU, 0xFFU, 0xFFU, 0xFFU, 0xFFU,
0xFFU, 0xFFU, 0xFFU, 0xFFU, 0xFFU, 0xFFU, 0xFFU, 0xFFU,
/* STEP 24: felica READ block 23 */
/* felica READ block 23 */
0xFFU, 0xFFU, 0xFFU, 0x00U, 0xFFU, 0x00U, 0x10U, 0x00U,
0x00U, 0x00U, 0x00U, 0x00U, 0x00U, 0x00U, 0x00U, 0x00U,
/* STEP 25: felica READ block 24 */
/* felica READ block 24 */
0x24U, 0xFEU, 0xFFU, 0x00U, 0x00U, 0x00U, 0x00U, 0x00U,
0x00U, 0x00U, 0x00U, 0x00U, 0x00U, 0x00U, 0x00U, 0x00U,
/* STEP 26: felica READ block 25 */
/* felica READ block 25 */
0x00U, 0x00U, 0x00U, 0x00U, 0x00U, 0x00U, 0x00U, 0x00U,
0x00U, 0x00U, 0x00U, 0x00U, 0x00U, 0x00U, 0x00U, 0x00U,
/* STEP 27: felica READ block 26 */
/* felica READ block 26 */
0x01U, 0x00U, 0x00U, 0x00U, 0x00U, 0x00U, 0x00U, 0x00U,
0x00U, 0x00U, 0x00U, 0x00U, 0x00U, 0x00U, 0x00U, 0x00U,
/* STEP 28: felica READ block 27 */
/* felica READ block 27 */
0x00U, 0x00U, 0x00U, 0x00U, 0x00U, 0x00U, 0x00U, 0x00U,
0x00U, 0x00U, 0x00U, 0x00U, 0x00U, 0x00U, 0x00U, 0x00U,

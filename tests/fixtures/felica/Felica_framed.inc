/* Tier B framed FeliCa TX/RX — one STEP per transceive */
/* STEP 0: felica poll */
/* TX */
/* felica poll TX */
0x06U, 0x00U, 0xFFU, 0xFFU, 0x00U, 0x00U, 0x09U, 0x21U,
/* RX */
/* felica poll RX */
0x12U, 0x01U, 0x29U, 0x9FU, 0xFAU, 0x53U, 0xABU, 0x75U,
0x87U, 0x6EU, 0x00U, 0xF1U, 0x00U, 0x00U, 0x00U, 0x01U,
0x43U, 0x00U, 0x72U, 0x50U,
/* STEP 1: felica READ block 0 (dump 0) */
/* TX */
/* felica READ block 0 (dump 0) TX */
0x10U, 0x06U, 0x29U, 0x9FU, 0xFAU, 0x53U, 0xABU, 0x75U,
0x87U, 0x6EU, 0x01U, 0x0BU, 0x00U, 0x01U, 0x80U, 0x00U,
0x04U, 0xF5U,
/* RX */
/* felica READ block 0 (dump 0) RX */
0x1DU, 0x07U, 0x29U, 0x9FU, 0xFAU, 0x53U, 0xABU, 0x75U,
0x87U, 0x6EU, 0x00U, 0x00U, 0x01U, 0xDEU, 0xADU, 0xBEU,
0xAFU, 0x00U, 0x00U, 0x00U, 0x00U, 0x00U, 0x00U, 0x00U,
0x00U, 0xDEU, 0xADU, 0xBEU, 0xAFU, 0xA2U, 0xB6U,
/* STEP 2: felica READ block 1 (dump 1) */
/* TX */
/* felica READ block 1 (dump 1) TX */
0x10U, 0x06U, 0x29U, 0x9FU, 0xFAU, 0x53U, 0xABU, 0x75U,
0x87U, 0x6EU, 0x01U, 0x0BU, 0x00U, 0x01U, 0x80U, 0x01U,
0x14U, 0xD4U,
/* RX */
/* felica READ block 1 (dump 1) RX */
0x1DU, 0x07U, 0x29U, 0x9FU, 0xFAU, 0x53U, 0xABU, 0x75U,
0x87U, 0x6EU, 0x00U, 0x00U, 0x01U, 0x00U, 0x11U, 0x22U,
0x33U, 0x44U, 0x55U, 0x66U, 0x77U, 0x88U, 0x99U, 0xAAU,
0xBBU, 0xCCU, 0xDDU, 0xEEU, 0xFFU, 0x24U, 0xDDU,
/* STEP 3: felica READ block 2 (dump 2) */
/* TX */
/* felica READ block 2 (dump 2) TX */
0x10U, 0x06U, 0x29U, 0x9FU, 0xFAU, 0x53U, 0xABU, 0x75U,
0x87U, 0x6EU, 0x01U, 0x0BU, 0x00U, 0x01U, 0x80U, 0x02U,
0x24U, 0xB7U,
/* RX */
/* felica READ block 2 (dump 2) RX */
0x1DU, 0x07U, 0x29U, 0x9FU, 0xFAU, 0x53U, 0xABU, 0x75U,
0x87U, 0x6EU, 0x00U, 0x00U, 0x01U, 0x00U, 0x00U, 0x00U,
0x00U, 0x00U, 0x00U, 0x00U, 0x00U, 0x00U, 0x00U, 0x00U,
0x00U, 0x00U, 0x00U, 0x00U, 0x00U, 0x36U, 0x95U,
/* STEP 4: felica READ block 3 (dump 3) */
/* TX */
/* felica READ block 3 (dump 3) TX */
0x10U, 0x06U, 0x29U, 0x9FU, 0xFAU, 0x53U, 0xABU, 0x75U,
0x87U, 0x6EU, 0x01U, 0x0BU, 0x00U, 0x01U, 0x80U, 0x03U,
0x34U, 0x96U,
/* RX */
/* felica READ block 3 (dump 3) RX */
0x1DU, 0x07U, 0x29U, 0x9FU, 0xFAU, 0x53U, 0xABU, 0x75U,
0x87U, 0x6EU, 0x00U, 0x00U, 0x01U, 0x00U, 0x00U, 0x00U,
0x00U, 0x00U, 0x00U, 0x00U, 0x00U, 0x00U, 0x00U, 0x00U,
0x00U, 0x00U, 0x00U, 0x00U, 0x00U, 0x36U, 0x95U,
/* STEP 5: felica READ block 4 (dump 4) */
/* TX */
/* felica READ block 4 (dump 4) TX */
0x10U, 0x06U, 0x29U, 0x9FU, 0xFAU, 0x53U, 0xABU, 0x75U,
0x87U, 0x6EU, 0x01U, 0x0BU, 0x00U, 0x01U, 0x80U, 0x04U,
0x44U, 0x71U,
/* RX */
/* felica READ block 4 (dump 4) RX */
0x1DU, 0x07U, 0x29U, 0x9FU, 0xFAU, 0x53U, 0xABU, 0x75U,
0x87U, 0x6EU, 0x00U, 0x00U, 0x01U, 0x00U, 0x00U, 0x00U,
0x00U, 0x00U, 0x00U, 0x00U, 0x00U, 0x00U, 0x00U, 0x00U,
0x00U, 0x00U, 0x00U, 0x00U, 0x00U, 0x36U, 0x95U,
/* STEP 6: felica READ block 5 (dump 5) */
/* TX */
/* felica READ block 5 (dump 5) TX */
0x10U, 0x06U, 0x29U, 0x9FU, 0xFAU, 0x53U, 0xABU, 0x75U,
0x87U, 0x6EU, 0x01U, 0x0BU, 0x00U, 0x01U, 0x80U, 0x05U,
0x54U, 0x50U,
/* RX */
/* felica READ block 5 (dump 5) RX */
0x1DU, 0x07U, 0x29U, 0x9FU, 0xFAU, 0x53U, 0xABU, 0x75U,
0x87U, 0x6EU, 0x00U, 0x00U, 0x01U, 0x00U, 0x00U, 0x00U,
0x00U, 0x00U, 0x00U, 0x00U, 0x00U, 0x00U, 0x00U, 0x00U,
0x00U, 0x00U, 0x00U, 0x00U, 0x00U, 0x36U, 0x95U,
/* STEP 7: felica READ block 6 (dump 6) */
/* TX */
/* felica READ block 6 (dump 6) TX */
0x10U, 0x06U, 0x29U, 0x9FU, 0xFAU, 0x53U, 0xABU, 0x75U,
0x87U, 0x6EU, 0x01U, 0x0BU, 0x00U, 0x01U, 0x80U, 0x06U,
0x64U, 0x33U,
/* RX */
/* felica READ block 6 (dump 6) RX */
0x1DU, 0x07U, 0x29U, 0x9FU, 0xFAU, 0x53U, 0xABU, 0x75U,
0x87U, 0x6EU, 0x00U, 0x00U, 0x01U, 0x00U, 0x00U, 0x00U,
0x00U, 0x00U, 0x00U, 0x00U, 0x00U, 0x00U, 0x00U, 0x00U,
0x00U, 0x00U, 0x00U, 0x00U, 0x00U, 0x36U, 0x95U,
/* STEP 8: felica READ block 7 (dump 7) */
/* TX */
/* felica READ block 7 (dump 7) TX */
0x10U, 0x06U, 0x29U, 0x9FU, 0xFAU, 0x53U, 0xABU, 0x75U,
0x87U, 0x6EU, 0x01U, 0x0BU, 0x00U, 0x01U, 0x80U, 0x07U,
0x74U, 0x12U,
/* RX */
/* felica READ block 7 (dump 7) RX */
0x1DU, 0x07U, 0x29U, 0x9FU, 0xFAU, 0x53U, 0xABU, 0x75U,
0x87U, 0x6EU, 0x00U, 0x00U, 0x01U, 0x00U, 0x00U, 0x00U,
0x00U, 0x00U, 0x00U, 0x00U, 0x00U, 0x00U, 0x00U, 0x00U,
0x00U, 0x00U, 0x00U, 0x00U, 0x00U, 0x36U, 0x95U,
/* STEP 9: felica READ block 8 (dump 8) */
/* TX */
/* felica READ block 8 (dump 8) TX */
0x10U, 0x06U, 0x29U, 0x9FU, 0xFAU, 0x53U, 0xABU, 0x75U,
0x87U, 0x6EU, 0x01U, 0x0BU, 0x00U, 0x01U, 0x80U, 0x08U,
0x85U, 0xFDU,
/* RX */
/* felica READ block 8 (dump 8) RX */
0x1DU, 0x07U, 0x29U, 0x9FU, 0xFAU, 0x53U, 0xABU, 0x75U,
0x87U, 0x6EU, 0x00U, 0x00U, 0x01U, 0x00U, 0x00U, 0x00U,
0x00U, 0x00U, 0x00U, 0x00U, 0x00U, 0x00U, 0x00U, 0x00U,
0x00U, 0x00U, 0x00U, 0x00U, 0x00U, 0x36U, 0x95U,
/* STEP 10: felica READ block 9 (dump 9) */
/* TX */
/* felica READ block 9 (dump 9) TX */
0x10U, 0x06U, 0x29U, 0x9FU, 0xFAU, 0x53U, 0xABU, 0x75U,
0x87U, 0x6EU, 0x01U, 0x0BU, 0x00U, 0x01U, 0x80U, 0x09U,
0x95U, 0xDCU,
/* RX */
/* felica READ block 9 (dump 9) RX */
0x1DU, 0x07U, 0x29U, 0x9FU, 0xFAU, 0x53U, 0xABU, 0x75U,
0x87U, 0x6EU, 0x00U, 0x00U, 0x01U, 0x00U, 0x00U, 0x00U,
0x00U, 0x00U, 0x00U, 0x00U, 0x00U, 0x00U, 0x00U, 0x00U,
0x00U, 0x00U, 0x00U, 0x00U, 0x00U, 0x36U, 0x95U,
/* STEP 11: felica READ block 10 (dump 10) */
/* TX */
/* felica READ block 10 (dump 10) TX */
0x10U, 0x06U, 0x29U, 0x9FU, 0xFAU, 0x53U, 0xABU, 0x75U,
0x87U, 0x6EU, 0x01U, 0x0BU, 0x00U, 0x01U, 0x80U, 0x0AU,
0xA5U, 0xBFU,
/* RX */
/* felica READ block 10 (dump 10) RX */
0x1DU, 0x07U, 0x29U, 0x9FU, 0xFAU, 0x53U, 0xABU, 0x75U,
0x87U, 0x6EU, 0x00U, 0x00U, 0x01U, 0x00U, 0x00U, 0x00U,
0x00U, 0x00U, 0x00U, 0x00U, 0x00U, 0x00U, 0x00U, 0x00U,
0x00U, 0x00U, 0x00U, 0x00U, 0x00U, 0x36U, 0x95U,
/* STEP 12: felica READ block 11 (dump 11) */
/* TX */
/* felica READ block 11 (dump 11) TX */
0x10U, 0x06U, 0x29U, 0x9FU, 0xFAU, 0x53U, 0xABU, 0x75U,
0x87U, 0x6EU, 0x01U, 0x0BU, 0x00U, 0x01U, 0x80U, 0x0BU,
0xB5U, 0x9EU,
/* RX */
/* felica READ block 11 (dump 11) RX */
0x1DU, 0x07U, 0x29U, 0x9FU, 0xFAU, 0x53U, 0xABU, 0x75U,
0x87U, 0x6EU, 0x00U, 0x00U, 0x01U, 0x00U, 0x00U, 0x00U,
0x00U, 0x00U, 0x00U, 0x00U, 0x00U, 0x00U, 0x00U, 0x00U,
0x00U, 0x00U, 0x00U, 0x00U, 0x00U, 0x36U, 0x95U,
/* STEP 13: felica READ block 12 (dump 12) */
/* TX */
/* felica READ block 12 (dump 12) TX */
0x10U, 0x06U, 0x29U, 0x9FU, 0xFAU, 0x53U, 0xABU, 0x75U,
0x87U, 0x6EU, 0x01U, 0x0BU, 0x00U, 0x01U, 0x80U, 0x0CU,
0xC5U, 0x79U,
/* RX */
/* felica READ block 12 (dump 12) RX */
0x1DU, 0x07U, 0x29U, 0x9FU, 0xFAU, 0x53U, 0xABU, 0x75U,
0x87U, 0x6EU, 0x00U, 0x00U, 0x01U, 0x00U, 0x00U, 0x00U,
0x00U, 0x00U, 0x00U, 0x00U, 0x00U, 0x00U, 0x00U, 0x00U,
0x00U, 0x00U, 0x00U, 0x00U, 0x00U, 0x36U, 0x95U,
/* STEP 14: felica READ block 13 (dump 13) */
/* TX */
/* felica READ block 13 (dump 13) TX */
0x10U, 0x06U, 0x29U, 0x9FU, 0xFAU, 0x53U, 0xABU, 0x75U,
0x87U, 0x6EU, 0x01U, 0x0BU, 0x00U, 0x01U, 0x80U, 0x0DU,
0xD5U, 0x58U,
/* RX */
/* felica READ block 13 (dump 13) RX */
0x1DU, 0x07U, 0x29U, 0x9FU, 0xFAU, 0x53U, 0xABU, 0x75U,
0x87U, 0x6EU, 0x00U, 0x00U, 0x01U, 0x00U, 0x00U, 0x00U,
0x00U, 0x00U, 0x00U, 0x00U, 0x00U, 0x00U, 0x00U, 0x00U,
0x00U, 0x00U, 0x00U, 0x00U, 0x00U, 0x36U, 0x95U,
/* STEP 15: felica READ block 14 (dump 14) */
/* TX */
/* felica READ block 14 (dump 14) TX */
0x10U, 0x06U, 0x29U, 0x9FU, 0xFAU, 0x53U, 0xABU, 0x75U,
0x87U, 0x6EU, 0x01U, 0x0BU, 0x00U, 0x01U, 0x80U, 0x0EU,
0xE5U, 0x3BU,
/* RX */
/* felica READ block 14 (dump 14) RX */
0x1DU, 0x07U, 0x29U, 0x9FU, 0xFAU, 0x53U, 0xABU, 0x75U,
0x87U, 0x6EU, 0x00U, 0x00U, 0x01U, 0xFFU, 0xFFU, 0xFFU,
0xFFU, 0xFFU, 0xFFU, 0xFFU, 0xFFU, 0xFFU, 0xFFU, 0xFFU,
0xFFU, 0xFFU, 0xFFU, 0xFFU, 0xFFU, 0x36U, 0xD4U,
/* STEP 16: felica READ block 128 (dump 15) */
/* TX */
/* felica READ block 128 (dump 15) TX */
0x10U, 0x06U, 0x29U, 0x9FU, 0xFAU, 0x53U, 0xABU, 0x75U,
0x87U, 0x6EU, 0x01U, 0x0BU, 0x00U, 0x01U, 0x80U, 0x80U,
0x95U, 0x7DU,
/* RX */
/* felica READ block 128 (dump 15) RX */
0x1DU, 0x07U, 0x29U, 0x9FU, 0xFAU, 0x53U, 0xABU, 0x75U,
0x87U, 0x6EU, 0x00U, 0x00U, 0x01U, 0x00U, 0x00U, 0x00U,
0x00U, 0x00U, 0x00U, 0x00U, 0x00U, 0x00U, 0x00U, 0x00U,
0x00U, 0x00U, 0x00U, 0x00U, 0x00U, 0x36U, 0x95U,
/* STEP 17: felica READ block 129 (dump 16) */
/* TX */
/* felica READ block 129 (dump 16) TX */
0x10U, 0x06U, 0x29U, 0x9FU, 0xFAU, 0x53U, 0xABU, 0x75U,
0x87U, 0x6EU, 0x01U, 0x0BU, 0x00U, 0x01U, 0x80U, 0x81U,
0x85U, 0x5CU,
/* RX */
/* felica READ block 129 (dump 16) RX */
0x1DU, 0x07U, 0x29U, 0x9FU, 0xFAU, 0x53U, 0xABU, 0x75U,
0x87U, 0x6EU, 0x00U, 0x00U, 0x01U, 0x00U, 0x00U, 0x00U,
0x00U, 0x00U, 0x00U, 0x00U, 0x00U, 0x00U, 0x00U, 0x00U,
0x00U, 0x00U, 0x00U, 0x00U, 0x00U, 0x36U, 0x95U,
/* STEP 18: felica READ block 130 (dump 17) */
/* TX */
/* felica READ block 130 (dump 17) TX */
0x10U, 0x06U, 0x29U, 0x9FU, 0xFAU, 0x53U, 0xABU, 0x75U,
0x87U, 0x6EU, 0x01U, 0x0BU, 0x00U, 0x01U, 0x80U, 0x82U,
0xB5U, 0x3FU,
/* RX */
/* felica READ block 130 (dump 17) RX */
0x1DU, 0x07U, 0x29U, 0x9FU, 0xFAU, 0x53U, 0xABU, 0x75U,
0x87U, 0x6EU, 0x00U, 0x00U, 0x01U, 0x29U, 0x9FU, 0xFAU,
0x53U, 0xABU, 0x75U, 0x87U, 0x6EU, 0x57U, 0x4EU, 0x10U,
0x2AU, 0x94U, 0x16U, 0xBCU, 0x8EU, 0xCFU, 0xC0U,
/* STEP 19: felica READ block 131 (dump 18) */
/* TX */
/* felica READ block 131 (dump 18) TX */
0x10U, 0x06U, 0x29U, 0x9FU, 0xFAU, 0x53U, 0xABU, 0x75U,
0x87U, 0x6EU, 0x01U, 0x0BU, 0x00U, 0x01U, 0x80U, 0x83U,
0xA5U, 0x1EU,
/* RX */
/* felica READ block 131 (dump 18) RX */
0x1DU, 0x07U, 0x29U, 0x9FU, 0xFAU, 0x53U, 0xABU, 0x75U,
0x87U, 0x6EU, 0x00U, 0x00U, 0x01U, 0x29U, 0x9FU, 0xFAU,
0x53U, 0xABU, 0x75U, 0x87U, 0x6EU, 0x00U, 0xF1U, 0x00U,
0x00U, 0x00U, 0x01U, 0x43U, 0x00U, 0x56U, 0x9BU,
/* STEP 20: felica READ block 132 (dump 19) */
/* TX */
/* felica READ block 132 (dump 19) TX */
0x10U, 0x06U, 0x29U, 0x9FU, 0xFAU, 0x53U, 0xABU, 0x75U,
0x87U, 0x6EU, 0x01U, 0x0BU, 0x00U, 0x01U, 0x80U, 0x84U,
0xD5U, 0xF9U,
/* RX */
/* felica READ block 132 (dump 19) RX */
0x1DU, 0x07U, 0x29U, 0x9FU, 0xFAU, 0x53U, 0xABU, 0x75U,
0x87U, 0x6EU, 0x00U, 0x00U, 0x01U, 0x00U, 0x00U, 0x00U,
0x00U, 0x00U, 0x00U, 0x00U, 0x00U, 0x00U, 0x00U, 0x00U,
0x00U, 0x00U, 0x00U, 0x00U, 0x00U, 0x36U, 0x95U,
/* STEP 21: felica READ block 133 (dump 20) */
/* TX */
/* felica READ block 133 (dump 20) TX */
0x10U, 0x06U, 0x29U, 0x9FU, 0xFAU, 0x53U, 0xABU, 0x75U,
0x87U, 0x6EU, 0x01U, 0x0BU, 0x00U, 0x01U, 0x80U, 0x85U,
0xC5U, 0xD8U,
/* RX */
/* felica READ block 133 (dump 20) RX */
0x1DU, 0x07U, 0x29U, 0x9FU, 0xFAU, 0x53U, 0xABU, 0x75U,
0x87U, 0x6EU, 0x00U, 0x00U, 0x01U, 0x88U, 0xB4U, 0x00U,
0x00U, 0x00U, 0x00U, 0x00U, 0x00U, 0x00U, 0x00U, 0x00U,
0x00U, 0x00U, 0x00U, 0x00U, 0x00U, 0x33U, 0x5FU,
/* STEP 22: felica READ block 134 (dump 21) */
/* TX */
/* felica READ block 134 (dump 21) TX */
0x10U, 0x06U, 0x29U, 0x9FU, 0xFAU, 0x53U, 0xABU, 0x75U,
0x87U, 0x6EU, 0x01U, 0x0BU, 0x00U, 0x01U, 0x80U, 0x86U,
0xF5U, 0xBBU,
/* RX */
/* felica READ block 134 (dump 21) RX */
0x1DU, 0x07U, 0x29U, 0x9FU, 0xFAU, 0x53U, 0xABU, 0x75U,
0x87U, 0x6EU, 0x00U, 0x00U, 0x01U, 0x00U, 0x00U, 0x00U,
0x00U, 0x00U, 0x00U, 0x00U, 0x00U, 0x00U, 0x00U, 0x00U,
0x00U, 0x00U, 0x00U, 0x00U, 0x00U, 0x36U, 0x95U,
/* STEP 23: felica READ block 135 (dump 22) */
/* TX */
/* felica READ block 135 (dump 22) TX */
0x10U, 0x06U, 0x29U, 0x9FU, 0xFAU, 0x53U, 0xABU, 0x75U,
0x87U, 0x6EU, 0x01U, 0x0BU, 0x00U, 0x01U, 0x80U, 0x87U,
0xE5U, 0x9AU,
/* RX */
/* felica READ block 135 (dump 22) RX */
0x1DU, 0x07U, 0x29U, 0x9FU, 0xFAU, 0x53U, 0xABU, 0x75U,
0x87U, 0x6EU, 0x00U, 0x00U, 0x01U, 0xFFU, 0xFFU, 0xFFU,
0xFFU, 0xFFU, 0xFFU, 0xFFU, 0xFFU, 0xFFU, 0xFFU, 0xFFU,
0xFFU, 0xFFU, 0xFFU, 0xFFU, 0xFFU, 0x36U, 0xD4U,
/* STEP 24: felica READ block 136 (dump 23) */
/* TX */
/* felica READ block 136 (dump 23) TX */
0x10U, 0x06U, 0x29U, 0x9FU, 0xFAU, 0x53U, 0xABU, 0x75U,
0x87U, 0x6EU, 0x01U, 0x0BU, 0x00U, 0x01U, 0x80U, 0x88U,
0x14U, 0x75U,
/* RX */
/* felica READ block 136 (dump 23) RX */
0x1DU, 0x07U, 0x29U, 0x9FU, 0xFAU, 0x53U, 0xABU, 0x75U,
0x87U, 0x6EU, 0x00U, 0x00U, 0x01U, 0xFFU, 0xFFU, 0xFFU,
0x00U, 0xFFU, 0x00U, 0x10U, 0x00U, 0x00U, 0x00U, 0x00U,
0x00U, 0x00U, 0x00U, 0x00U, 0x00U, 0x49U, 0x6FU,
/* STEP 25: felica READ block 144 (dump 24) */
/* TX */
/* felica READ block 144 (dump 24) TX */
0x10U, 0x06U, 0x29U, 0x9FU, 0xFAU, 0x53U, 0xABU, 0x75U,
0x87U, 0x6EU, 0x01U, 0x0BU, 0x00U, 0x01U, 0x80U, 0x90U,
0x87U, 0x4CU,
/* RX */
/* felica READ block 144 (dump 24) RX */
0x1DU, 0x07U, 0x29U, 0x9FU, 0xFAU, 0x53U, 0xABU, 0x75U,
0x87U, 0x6EU, 0x00U, 0x00U, 0x01U, 0x24U, 0xFEU, 0xFFU,
0x00U, 0x00U, 0x00U, 0x00U, 0x00U, 0x00U, 0x00U, 0x00U,
0x00U, 0x00U, 0x00U, 0x00U, 0x00U, 0x10U, 0x6CU,
/* STEP 26: felica READ block 145 (dump 25) */
/* TX */
/* felica READ block 145 (dump 25) TX */
0x10U, 0x06U, 0x29U, 0x9FU, 0xFAU, 0x53U, 0xABU, 0x75U,
0x87U, 0x6EU, 0x01U, 0x0BU, 0x00U, 0x01U, 0x80U, 0x91U,
0x97U, 0x6DU,
/* RX */
/* felica READ block 145 (dump 25) RX */
0x1DU, 0x07U, 0x29U, 0x9FU, 0xFAU, 0x53U, 0xABU, 0x75U,
0x87U, 0x6EU, 0x00U, 0x00U, 0x01U, 0x00U, 0x00U, 0x00U,
0x00U, 0x00U, 0x00U, 0x00U, 0x00U, 0x00U, 0x00U, 0x00U,
0x00U, 0x00U, 0x00U, 0x00U, 0x00U, 0x36U, 0x95U,
/* STEP 27: felica READ block 146 (dump 26) */
/* TX */
/* felica READ block 146 (dump 26) TX */
0x10U, 0x06U, 0x29U, 0x9FU, 0xFAU, 0x53U, 0xABU, 0x75U,
0x87U, 0x6EU, 0x01U, 0x0BU, 0x00U, 0x01U, 0x80U, 0x92U,
0xA7U, 0x0EU,
/* RX */
/* felica READ block 146 (dump 26) RX */
0x1DU, 0x07U, 0x29U, 0x9FU, 0xFAU, 0x53U, 0xABU, 0x75U,
0x87U, 0x6EU, 0x00U, 0x00U, 0x01U, 0x01U, 0x00U, 0x00U,
0x00U, 0x00U, 0x00U, 0x00U, 0x00U, 0x00U, 0x00U, 0x00U,
0x00U, 0x00U, 0x00U, 0x00U, 0x00U, 0x9EU, 0xB1U,
/* STEP 28: felica READ block 160 (dump 27) */
/* TX */
/* felica READ block 160 (dump 27) TX */
0x10U, 0x06U, 0x29U, 0x9FU, 0xFAU, 0x53U, 0xABU, 0x75U,
0x87U, 0x6EU, 0x01U, 0x0BU, 0x00U, 0x01U, 0x80U, 0xA0U,
0xB1U, 0x1FU,
/* RX */
/* felica READ block 160 (dump 27) RX */
0x1DU, 0x07U, 0x29U, 0x9FU, 0xFAU, 0x53U, 0xABU, 0x75U,
0x87U, 0x6EU, 0x00U, 0x00U, 0x01U, 0x00U, 0x00U, 0x00U,
0x00U, 0x00U, 0x00U, 0x00U, 0x00U, 0x00U, 0x00U, 0x00U,
0x00U, 0x00U, 0x00U, 0x00U, 0x00U, 0x36U, 0x95U,

## tests/unit/nfc_apdu_asm/testcase.yaml
```yaml
tests:
  sample.nfc.unit.nfc_apdu_asm:
    tags:
      - ci_unit
      - nfc
    platform_allow:
      - qemu_cortex_m3
      - native_sim
      - native_sim/native
    integration_platforms:
      - qemu_cortex_m3
```

## tests/unit/nfc_classic/Kconfig
```kconfig
# SPDX-License-Identifier: Apache-2.0

mainmenu "Classic protocol unit tests"

source "Kconfig.zephyr"

config NFC_CLASSIC_BLOCK_COUNT
	int "Maximum Classic blocks in data model"
	default 256
	range 64 256

config NFC_CLASSIC_TEST_TIER_POLLER
	bool "Build Classic poller tier tests"
	default n

config NFC_CLASSIC_TEST_TIER_LISTENER
	bool "Build Classic listener tier tests"
	default n

config NFC_CLASSIC_TEST_VARIANT_1K_7B
	bool "Build Classic 1K 7b UID poller variant tests"
	default n
	depends on NFC_CLASSIC_TEST_TIER_POLLER

config NFC_CLASSIC_TEST_VARIANT_MINI_4B
	bool "Build Classic Mini poller variant tests"
	default n
	depends on NFC_CLASSIC_TEST_TIER_POLLER

config NFC_CLASSIC_TEST_VARIANT_4K_4B
	bool "Build Classic 4K poller variant tests"
	default n
	depends on NFC_CLASSIC_TEST_TIER_POLLER

config NFC_CLASSIC_TEST_DETERMINISTIC_NR
	bool "Use fixed NR bytes in poller unit tests"
	default n
	depends on NFC_CLASSIC_TEST_TIER_POLLER || NFC_CLASSIC_TEST_TIER_LISTENER
```

## tests/unit/nfc_classic/testcase.yaml
```yaml
tests:
  sample.nfc.unit.nfc_classic.model:
    tags:
      - ci_unit
      - nfc
      - writable_ndef.nfc.classic
    platform_allow:
      - qemu_cortex_m3
      - native_sim
      - native_sim/native
    integration_platforms:
      - qemu_cortex_m3
    extra_args: CONF_FILE=prj_model.conf

  sample.nfc.unit.nfc_classic.poller:
    tags:
      - ci_unit
      - nfc
      - writable_ndef.nfc.classic
    platform_allow:
      - qemu_cortex_m3
      - native_sim
      - native_sim/native
    integration_platforms:
      - qemu_cortex_m3
    extra_args: CONF_FILE=prj_poller.conf

  sample.nfc.unit.nfc_classic.poller_1k_7b:
    tags:
      - ci_unit
      - nfc
      - writable_ndef.nfc.classic
    platform_allow:
      - qemu_cortex_m3
      - native_sim
      - native_sim/native
    integration_platforms:
      - qemu_cortex_m3
    extra_args: CONF_FILE=prj_poller_1k_7b.conf

  sample.nfc.unit.nfc_classic.poller_mini:
    tags:
      - ci_unit
      - nfc
      - writable_ndef.nfc.classic
    platform_allow:
      - qemu_cortex_m3
      - native_sim
      - native_sim/native
    integration_platforms:
      - qemu_cortex_m3
    extra_args: CONF_FILE=prj_poller_mini.conf

  sample.nfc.unit.nfc_classic.poller_4k:
    tags:
      - ci_unit
      - nfc
      - writable_ndef.nfc.classic
    platform_allow:
      - qemu_cortex_m3
      - native_sim
      - native_sim/native
    integration_platforms:
      - qemu_cortex_m3
    extra_args: CONF_FILE=prj_poller_4k.conf

  sample.nfc.unit.nfc_classic.listener:
    tags:
      - ci_unit
      - nfc
      - writable_ndef.nfc.classic
    platform_allow:
      - qemu_cortex_m3
      - native_sim
      - native_sim/native
    integration_platforms:
      - qemu_cortex_m3
    extra_args: CONF_FILE=prj_listener.conf
```

## tests/unit/nfc_desfire/Kconfig
```kconfig
# SPDX-License-Identifier: Apache-2.0

mainmenu "DESFire protocol unit tests"

source "Kconfig.zephyr"

config NFC_DESFIRE_TEST_TIER_POLLER
	bool "Build DESFire poller tier tests"
	default n

config NFC_DESFIRE_TEST_TIER_LISTENER
	bool "Build DESFire listener tier tests"
	default n
```

## tests/unit/nfc_emv/Kconfig
```kconfig
# SPDX-License-Identifier: Apache-2.0
mainmenu "EMV protocol unit tests"
source "Kconfig.zephyr"
config NFC_EMV_TEST_TIER_POLLER
	bool "Build EMV poller tier tests"
	default n
config NFC_EMV_TEST_TIER_LISTENER
	bool "Build EMV listener tier tests"
	default n
```

## tests/unit/nfc_emv/testcase.yaml
```yaml
tests:
  sample.nfc.unit.nfc_emv.model:
    tags: [ci_unit, nfc, writable_ndef.nfc.emv]
    platform_allow: [qemu_cortex_m3, native_sim, native_sim/native]
    integration_platforms: [qemu_cortex_m3]
    extra_args: CONF_FILE=prj_model.conf
  sample.nfc.unit.nfc_emv.poller:
    tags: [ci_unit, nfc, writable_ndef.nfc.emv]
    platform_allow: [qemu_cortex_m3, native_sim, native_sim/native]
    integration_platforms: [qemu_cortex_m3]
    extra_args: CONF_FILE=prj_poller.conf
  sample.nfc.unit.nfc_emv.listener:
    tags: [ci_unit, nfc, writable_ndef.nfc.emv]
    platform_allow: [qemu_cortex_m3, native_sim, native_sim/native]
    integration_platforms: [qemu_cortex_m3]
    extra_args: CONF_FILE=prj_listener.conf
```

## tests/unit/nfc_felica/Kconfig
```kconfig
# SPDX-License-Identifier: Apache-2.0

mainmenu "FeliCa protocol unit tests"

source "Kconfig.zephyr"

config FELICA_BLOCKS_MAX
	int "Maximum FeliCa blocks in data model"
	default 64
	range 16 64

config NFC_FELICA_TEST_TIER_POLLER
	bool "Build FeliCa poller tier tests"
	default n
```

## tests/unit/nfc_felica/testcase.yaml
```yaml
tests:
  sample.nfc.unit.nfc_felica.model:
    tags:
      - ci_unit
      - nfc
      - writable_ndef.nfc.felica
    platform_allow:
      - qemu_cortex_m3
      - native_sim
      - native_sim/native
    integration_platforms:
      - qemu_cortex_m3
    extra_args: CONF_FILE=prj_model.conf

  sample.nfc.unit.nfc_felica.poller:
    tags:
      - ci_unit
      - nfc
      - writable_ndef.nfc.felica
    platform_allow:
      - qemu_cortex_m3
      - native_sim
      - native_sim/native
    integration_platforms:
      - qemu_cortex_m3
    extra_args: CONF_FILE=prj_poller.conf

  sample.nfc.unit.nfc_felica.listener:
    tags:
      - ci_unit
      - nfc
      - writable_ndef.nfc.felica
    platform_allow:
      - qemu_cortex_m3
      - native_sim
      - native_sim/native
    integration_platforms:
      - qemu_cortex_m3
    extra_args: CONF_FILE=prj_listener.conf
```

## tests/unit/nfc_iso15693_3/Kconfig
```kconfig
# SPDX-License-Identifier: Apache-2.0

mainmenu "ISO15693-3 protocol unit tests"

source "Kconfig.zephyr"

config ISO15693_BLOCKS_MAX
	int "Maximum ISO15693 blocks in data model"
	default 128
	range 16 128

config ISO15693_BLOCK_SIZE_MAX
	int "Maximum ISO15693 block size"
	default 4
	range 1 4

config NFC_ISO15693_3_TEST_TIER_POLLER
	bool "Build ISO15693-3 poller tier tests"
	default n

config NFC_ISO15693_3_TEST_TIER_LISTENER
	bool "Build ISO15693-3 listener tier tests"
	default n
```

## tests/unit/nfc_iso15693_3/testcase.yaml
```yaml
tests:
  sample.nfc.unit.nfc_iso15693_3.model:
    tags:
      - ci_unit
      - nfc
      - writable_ndef.nfc.iso15693_3
    platform_allow:
      - qemu_cortex_m3
      - native_sim
      - native_sim/native
    integration_platforms:
      - qemu_cortex_m3
    extra_args: CONF_FILE=prj_model.conf

  sample.nfc.unit.nfc_iso15693_3.poller:
    tags:
      - ci_unit
      - nfc
      - writable_ndef.nfc.iso15693_3
    platform_allow:
      - qemu_cortex_m3
      - native_sim
      - native_sim/native
    integration_platforms:
      - qemu_cortex_m3
    extra_args: CONF_FILE=prj_poller.conf
```

## tests/unit/nfc_ndef/testcase.yaml
```yaml
tests:
  sample.nfc.unit.nfc_ndef.model:
    tags:
      - ci_unit
      - nfc
      - writable_ndef.nfc.ndef
    platform_allow:
      - qemu_cortex_m3
      - native_sim
      - native_sim/native
    integration_platforms:
      - qemu_cortex_m3
    extra_args: CONF_FILE=prj_model.conf

  sample.nfc.unit.nfc_ndef.poller:
    tags:
      - ci_unit
      - nfc
      - writable_ndef.nfc.ndef
    platform_allow:
      - qemu_cortex_m3
      - native_sim
      - native_sim/native
    integration_platforms:
      - qemu_cortex_m3
    extra_args: CONF_FILE=prj_poller.conf

  sample.nfc.unit.nfc_ndef.listener:
    tags:
      - ci_unit
      - nfc
      - writable_ndef.nfc.ndef
    platform_allow:
      - qemu_cortex_m3
      - native_sim
      - native_sim/native
    integration_platforms:
      - qemu_cortex_m3
    extra_args: CONF_FILE=prj_listener.conf
```

## tests/unit/nfc_reader/testcase.yaml
```yaml
# Tier E — applet store/clone/verify (cookbook §14.6a, §14.11).
# P5: Added shell_off scenario (Master Plan Part E.4) to prove L1 links without shell.

tests:
  sample.nfc.unit.nfc_reader.store:
    tags:
      - ci_unit
      - nfc
      - writable_ndef.nfc.reader
      - writable_ndef.nfc.ndef
    platform_allow:
      - qemu_cortex_m3
      - native_sim
      - native_sim/native
    integration_platforms:
      - qemu_cortex_m3
  sample.nfc.unit.nfc_reader.store_ram:
    tags:
      - ci_unit
      - nfc
      - writable_ndef.nfc.reader
      - writable_ndef.nfc.store_ram
    platform_allow:
      - qemu_cortex_m3
      - native_sim
      - native_sim/native
    integration_platforms:
      - qemu_cortex_m3
      - native_sim
    extra_args: OVERLAY_CONFIG=overlay-store-ram.conf
  sample.nfc.unit.nfc_reader.shell_off:
    tags:
      - ci_unit
      - nfc
      - writable_ndef.nfc.reader
      - writable_ndef.nfc.shell_off
    platform_allow:
      - qemu_cortex_m3
    integration_platforms:
      - qemu_cortex_m3
    extra_configs:
      - CONFIG_SHELL=n
      - CONFIG_NFC_APPLETS=y
```

## tests/unit/nfc_slix/Kconfig
```kconfig
# SPDX-License-Identifier: Apache-2.0

mainmenu "SLIX protocol unit tests"

source "Kconfig.zephyr"

config ISO15693_BLOCKS_MAX
	int "Maximum ISO15693 blocks in data model"
	default 256
	range 16 256

config ISO15693_BLOCK_SIZE_MAX
	int "Maximum ISO15693 block size (bytes)"
	default 32
	range 4 32

config NFC_SLIX_TEST_TIER_POLLER
	bool "Build SLIX poller tier tests"
	default n

config NFC_SLIX_TEST_TIER_LISTENER
	bool "Build SLIX listener tier tests"
	default n
```

## tests/unit/nfc_ultralight/Kconfig
```kconfig
# SPDX-License-Identifier: Apache-2.0

mainmenu "Ultralight protocol unit tests"

source "Kconfig.zephyr"

config NFC_ULTRALIGHT_MAX_PAGES
	int "Maximum Ultralight pages in data model"
	default 256
	range 16 256

config NFC_ULTRALIGHT_TEST_TIER_POLLER
	bool "Build Ultralight poller tier tests"
	default n
```

## tests/unit/nfc_ultralight/testcase.yaml
```yaml
tests:
  sample.nfc.unit.nfc_ultralight.model:
    tags:
      - ci_unit
      - nfc
      - writable_ndef.nfc.ultralight
    platform_allow:
      - qemu_cortex_m3
      - native_sim
      - native_sim/native
    integration_platforms:
      - qemu_cortex_m3
    extra_args: CONF_FILE=prj_model.conf

  sample.nfc.unit.nfc_ultralight.poller:
    tags:
      - ci_unit
      - nfc
      - writable_ndef.nfc.ultralight
    platform_allow:
      - qemu_cortex_m3
      - native_sim
      - native_sim/native
    integration_platforms:
      - qemu_cortex_m3
    extra_args: CONF_FILE=prj_poller.conf
```

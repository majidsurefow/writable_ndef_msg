## CMakeLists.txt
```
# Copyright (c) 2026
# SPDX-License-Identifier: Apache-2.0

cmake_minimum_required(VERSION 3.20.0)

include(${CMAKE_CURRENT_SOURCE_DIR}/../../common/CMakeLists.txt)

find_package(Zephyr REQUIRED HINTS $ENV{ZEPHYR_BASE})
project(nfc_ndef_unit)

set(REPO_NFC ${CMAKE_CURRENT_SOURCE_DIR}/../../../src/nfc)

target_sources(app PRIVATE
  src/test_model.c
  ${REPO_NFC}/protocols/ndef/ndef.c
  ${NFC_TEST_COMMON_SOURCES}
)

if(CONFIG_NFC_NDEF_TEST_TIER_POLLER)
  target_sources(app PRIVATE
    src/test_poller.c
    ${REPO_NFC}/protocols/ndef/ndef_poller.c
  )
endif()

if(CONFIG_NFC_NDEF_TEST_TIER_LISTENER)
  target_sources(app PRIVATE
    src/test_listener_select.c
    src/test_listener_read.c
    src/test_listener_update.c
    src/test_listener_dispatch.c
    ${REPO_NFC}/protocols/ndef/ndef_listener.c
  )
endif()

target_include_directories(app PRIVATE
  ${REPO_NFC}
  ${REPO_NFC}/protocols/ndef
  ${CMAKE_CURRENT_SOURCE_DIR}/../../fixtures/ndef
  ${NFC_TEST_COMMON_INCLUDES}
)
```

## Kconfig
```
# SPDX-License-Identifier: Apache-2.0

mainmenu "NDEF protocol unit tests"

source "Kconfig.zephyr"

config NFC_NDEF_MAX_SIZE
	int "Maximum NDEF message payload (bytes)"
	default 500
	range 1 4096

config NFC_NDEF_TEST_TIER_POLLER
	bool "Build NDEF poller tier tests"
	default n

config NFC_NDEF_TEST_TIER_LISTENER
	bool "Build NDEF listener tier tests"
	default n
```

## prj.conf
```kconfig
CONFIG_ZTEST=y
CONFIG_NFC_NDEF_MAX_SIZE=500
```

## prj_listener.conf
```kconfig
CONFIG_ZTEST=y
CONFIG_NFC_NDEF_MAX_SIZE=500
CONFIG_NFC_NDEF_TEST_TIER_LISTENER=y
```

## prj_poller.conf
```kconfig
CONFIG_ZTEST=y
CONFIG_NFC_NDEF_MAX_SIZE=500
CONFIG_NFC_NDEF_TEST_TIER_POLLER=y
```

## src/listener_test_helpers.h
```c
/*
 * Copyright (c) 2026
 * SPDX-License-Identifier: Apache-2.0
 *
 * Shared helpers for NDEF Tier C listener tests.
 */

#ifndef TESTS_UNIT_NFC_NDEF_LISTENER_TEST_HELPERS_H_
#define TESTS_UNIT_NFC_NDEF_LISTENER_TEST_HELPERS_H_

#include "ndef_listener.h"
#include "nfc_response_spy.h"
#include "nfc_test_apdu.h"

#include <string.h>

#include <zephyr/ztest.h>

static inline void listener_test_reset(bool writable)
{
	ndef_listener_config_t cfg = { .writable = writable };

	nfc_response_spy_reset();
	ndef_listener_shutdown();
	zassert_ok(ndef_listener_init(NULL, &cfg));
}

static inline void listener_assert_sw(uint8_t sw1, uint8_t sw2)
{
	const uint8_t *buf = NULL;
	size_t len = 0U;

	zassert_ok(nfc_response_spy_last(&buf, &len));
	zassert_true(len >= 2U);
	zassert_equal(buf[len - 2U], sw1);
	zassert_equal(buf[len - 1U], sw2);
}

static inline void listener_assert_sw_u16(uint16_t sw)
{
	listener_assert_sw((uint8_t)(sw >> 8U), (uint8_t)(sw & 0xFFU));
}

static inline void listener_send_apdu_bytes(const uint8_t *apdu, size_t apdu_len)
{
	uint8_t storage[64];
	nfc_apdu_t parsed;
	const nfc_service_t *svc = ndef_listener_get();

	zassert_ok(nfc_test_apdu_from_bytes(apdu, apdu_len, storage, sizeof(storage), &parsed));
	svc->on_apdu(&parsed, NULL);
}

static inline void listener_select_cc(void)
{
	static const uint8_t cmd[] = {0x00U, 0xA4U, 0x00U, 0x0CU, 0x02U, 0xE1U, 0x03U};

	listener_send_apdu_bytes(cmd, sizeof(cmd));
}

static inline void listener_select_ndef(void)
{
	static const uint8_t cmd[] = {0x00U, 0xA4U, 0x00U, 0x0CU, 0x02U, 0xE1U, 0x04U};

	listener_send_apdu_bytes(cmd, sizeof(cmd));
}

static inline void listener_read_nofile_check(void)
{
	static const uint8_t cmd[] = {0x00U, 0xB0U, 0x00U, 0x00U, 0x0FU};

	nfc_response_spy_reset();
	listener_send_apdu_bytes(cmd, sizeof(cmd));
	listener_assert_sw_u16(NFC_SW_NO_EF);
}

#endif /* TESTS_UNIT_NFC_NDEF_LISTENER_TEST_HELPERS_H_ */
```

## src/test_listener_dispatch.c
```c
/*
 * Copyright (c) 2026
 * SPDX-License-Identifier: Apache-2.0
 *
 * NDEF Tier C — listener dispatch + cross-tier (wave5-ndef §8 Task 12).
 */

#include "listener_test_helpers.h"

#include "ndef_fixture.h"
#include "ndef.h"

#include <string.h>

#include <zephyr/ztest.h>

static ndef_data_t s_model; /* Static to avoid stack allocation */

static void *listener_dispatch_setup(void)
{
	ndef_fixture_init_read_scripts();
	listener_test_reset(true);
	return NULL;
}

ZTEST(ndef_listener_dispatch, test_unknown_ins)
{
	listener_send_apdu_bytes((const uint8_t[]){0x00U, 0x01U, 0x00U, 0x00U}, 4U);
	listener_assert_sw_u16(NFC_SW_INS_NOT_SUPPORTED);
}

ZTEST(ndef_listener_dispatch, test_bad_cla)
{
	listener_send_apdu_bytes((const uint8_t[]){0x80U, 0xB0U, 0x00U, 0x00U, 0x01U}, 5U);
	listener_assert_sw_u16(NFC_SW_CLA_NOT_SUPPORTED);
}

ZTEST(ndef_listener_dispatch, test_deserialize_then_read)
{
	uint8_t blob[1U + NFC_NDEF_CC_LEN + NFC_NDEF_NLEN_FIELD_LEN + CONFIG_NFC_NDEF_MAX_SIZE];
	size_t blob_len = 0U;
	const nfc_service_t *svc = ndef_listener_get();
	const uint8_t *buf = NULL;
	size_t len = 0U;

	(void)memset(&s_model, 0, sizeof(s_model));
	ndef_data_reset(&s_model);
	(void)memcpy(s_model.cc, ndef_fixture_cc_std, NFC_NDEF_CC_LEN);
	s_model.cc_len = NFC_NDEF_CC_LEN;
	s_model.ndef_file[0] = 0x00U;
	s_model.ndef_file[1] = (uint8_t)sizeof(ndef_fixture_uri_payload);
	(void)memcpy(&s_model.ndef_file[2], ndef_fixture_uri_payload,
		     sizeof(ndef_fixture_uri_payload));
	s_model.ndef_file_len =
		(uint16_t)(NFC_NDEF_NLEN_FIELD_LEN + sizeof(ndef_fixture_uri_payload));

	zassert_ok(ndef_serialize(&s_model, blob, sizeof(blob), &blob_len));

	ndef_listener_shutdown();
	zassert_ok(ndef_listener_init(NULL, &(ndef_listener_config_t){ .writable = true }));
	zassert_ok(svc->deserialize(blob, blob_len, NULL));

	listener_select_ndef();
	listener_assert_sw_u16(NFC_SW_OK);

	nfc_response_spy_reset();
	listener_send_apdu_bytes((const uint8_t[]){0x00U, 0xB0U, 0x00U, 0x00U, 0x07U}, 5U);
	zassert_ok(nfc_response_spy_last(&buf, &len));
	zassert_equal(len, 9U);
	zassert_equal(buf[0], 0x00U);
	zassert_equal(buf[1], (uint8_t)sizeof(ndef_fixture_uri_payload));
	zassert_mem_equal(&buf[2], ndef_fixture_uri_payload, sizeof(ndef_fixture_uri_payload));
	listener_assert_sw_u16(NFC_SW_OK);
}

static void listener_suite_before(void *fixture)
{
	ARG_UNUSED(fixture);

	const nfc_service_t *svc = ndef_listener_get();

	svc->on_field_off(NULL);
	nfc_response_spy_reset();
}

ZTEST_SUITE(ndef_listener_dispatch, NULL, listener_dispatch_setup, listener_suite_before, NULL, NULL);
```

## src/test_listener_read.c
```c
/*
 * Copyright (c) 2026
 * SPDX-License-Identifier: Apache-2.0
 *
 * NDEF Tier C — listener READ BINARY (wave5-ndef §8 Task 6).
 */

#include "listener_test_helpers.h"

#include "ndef_fixture.h"

#include "hal/nfc_transport.h"

#include <string.h>

#include <zephyr/ztest.h>

static ndef_data_t s_read_model;

static void *listener_read_setup(void)
{
	ndef_listener_config_t cfg = { .writable = true };

	ndef_fixture_init_read_scripts();

	ndef_data_reset(&s_read_model);
	(void)memcpy(s_read_model.cc, ndef_fixture_cc_std, NFC_NDEF_CC_LEN);
	s_read_model.cc_len = NFC_NDEF_CC_LEN;
	s_read_model.ndef_file[0] = 0U;
	s_read_model.ndef_file[1] = 0U;
	s_read_model.ndef_file_len = NFC_NDEF_NLEN_FIELD_LEN;

	nfc_response_spy_reset();
	ndef_listener_shutdown();
	zassert_ok(ndef_listener_init(&s_read_model, &cfg));
	return NULL;
}

ZTEST(ndef_listener_read, test_read_cc_full)
{
	const uint8_t *buf = NULL;
	size_t len = 0U;

	listener_select_cc();
	listener_assert_sw_u16(NFC_SW_OK);

	nfc_response_spy_reset();
	listener_send_apdu_bytes((const uint8_t[]){0x00U, 0xB0U, 0x00U, 0x00U, 0x0FU}, 5U);
	zassert_ok(nfc_response_spy_last(&buf, &len));
	zassert_equal(len, NFC_NDEF_CC_LEN + 2U);
	zassert_mem_equal(buf, ndef_fixture_cc_std, NFC_NDEF_CC_LEN);
	listener_assert_sw_u16(NFC_SW_OK);
}

ZTEST(ndef_listener_read, test_read_cc_partial)
{
	const uint8_t *buf = NULL;
	size_t len = 0U;

	listener_select_cc();
	listener_assert_sw_u16(NFC_SW_OK);

	nfc_response_spy_reset();
	listener_send_apdu_bytes((const uint8_t[]){0x00U, 0xB0U, 0x00U, 0x02U, 0x03U}, 5U);
	zassert_ok(nfc_response_spy_last(&buf, &len));
	zassert_equal(len, 5U);
	zassert_equal(buf[0], ndef_fixture_cc_std[2]);
	zassert_equal(buf[1], ndef_fixture_cc_std[3]);
	zassert_equal(buf[2], ndef_fixture_cc_std[4]);
	listener_assert_sw_u16(NFC_SW_OK);
}

ZTEST(ndef_listener_read, test_read_ndef_empty)
{
	const uint8_t *buf = NULL;
	size_t len = 0U;
	size_t expect_data = (size_t)NFC_TRANSPORT_MAX_RESPONSE_LEN - 2U;

	listener_select_ndef();
	listener_assert_sw_u16(NFC_SW_OK);

	nfc_response_spy_reset();
	listener_send_apdu_bytes((const uint8_t[]){0x00U, 0xB0U, 0x00U, 0x00U, 0x00U}, 5U);
	zassert_ok(nfc_response_spy_last(&buf, &len));
	zassert_equal(len, expect_data + 2U);
	for (size_t i = 0U; i < expect_data; i++) {
		zassert_equal(buf[i], 0U);
	}
	listener_assert_sw_u16(NFC_SW_OK);
}

ZTEST(ndef_listener_read, test_read_nofile)
{
	nfc_response_spy_reset();
	listener_send_apdu_bytes((const uint8_t[]){0x00U, 0xB0U, 0x00U, 0x00U, 0x0FU}, 5U);
	listener_assert_sw_u16(NFC_SW_NO_EF);
}

ZTEST(ndef_listener_read, test_read_offset_beyond_eof)
{
	listener_select_cc();
	listener_assert_sw_u16(NFC_SW_OK);

	nfc_response_spy_reset();
	listener_send_apdu_bytes((const uint8_t[]){0x00U, 0xB0U, 0x00U, NFC_NDEF_CC_LEN, 0x01U}, 5U);
	listener_assert_sw_u16(NFC_SW_WRONG_OFFSET);
}

ZTEST(ndef_listener_read, test_read_le_zero_short)
{
	const uint8_t *buf = NULL;
	size_t len = 0U;
	size_t expect_data = 256U;

	if (expect_data > (size_t)(NFC_TRANSPORT_MAX_RESPONSE_LEN - 2U)) {
		expect_data = (size_t)(NFC_TRANSPORT_MAX_RESPONSE_LEN - 2U);
	}

	listener_select_ndef();
	listener_assert_sw_u16(NFC_SW_OK);

	nfc_response_spy_reset();
	listener_send_apdu_bytes((const uint8_t[]){0x00U, 0xB0U, 0x00U, 0x00U, 0x00U}, 5U);
	zassert_ok(nfc_response_spy_last(&buf, &len));
	zassert_equal(len, expect_data + 2U);
	listener_assert_sw_u16(NFC_SW_OK);
}

ZTEST(ndef_listener_read, test_read_le_zero_ext)
{
	nfc_apdu_t apdu = {
		.cla = 0x00U,
		.ins = NFC_INS_READ_BINARY,
		.p1 = 0x00U,
		.p2 = 0x00U,
		.data = NULL,
		.lc = 0U,
		.le = 0U,
		.has_le = true,
		.extended = true,
	};
	const uint8_t *buf = NULL;
	size_t len = 0U;
	size_t expect_data = (size_t)NFC_TRANSPORT_MAX_RESPONSE_LEN - 2U;
	const nfc_service_t *svc = ndef_listener_get();

	listener_select_ndef();
	listener_assert_sw_u16(NFC_SW_OK);

	nfc_response_spy_reset();
	svc->on_apdu(&apdu, NULL);
	zassert_ok(nfc_response_spy_last(&buf, &len));
	zassert_equal(len, expect_data + 2U);
	listener_assert_sw_u16(NFC_SW_OK);
}

ZTEST(ndef_listener_read, test_read_no_le)
{
	const uint8_t *buf = NULL;
	size_t len = 0U;
	size_t expect_data = (size_t)NFC_TRANSPORT_MAX_RESPONSE_LEN - 2U;
	uint8_t storage[8];
	nfc_apdu_t apdu = {
		.cla = 0x00U,
		.ins = NFC_INS_READ_BINARY,
		.p1 = 0x00U,
		.p2 = 0x00U,
		.data = NULL,
		.lc = 0U,
		.le = 0U,
		.has_le = false,
		.extended = false,
	};
	const nfc_service_t *svc = ndef_listener_get();

	listener_select_ndef();
	listener_assert_sw_u16(NFC_SW_OK);

	nfc_response_spy_reset();
	svc->on_apdu(&apdu, NULL);
	zassert_ok(nfc_response_spy_last(&buf, &len));
	zassert_equal(len, expect_data + 2U);
	zassert_true(len <= NFC_TRANSPORT_MAX_RESPONSE_LEN);
	listener_assert_sw_u16(NFC_SW_OK);
	ARG_UNUSED(storage);
}

ZTEST(ndef_listener_read, test_response_capped_255)
{
	const uint8_t *buf = NULL;
	size_t len = 0U;

	listener_select_ndef();
	listener_assert_sw_u16(NFC_SW_OK);

	nfc_response_spy_reset();
	listener_send_apdu_bytes((const uint8_t[]){0x00U, 0xB0U, 0x00U, 0x00U}, 4U);
	zassert_ok(nfc_response_spy_last(&buf, &len));
	zassert_true(len <= NFC_TRANSPORT_MAX_RESPONSE_LEN);
}

static void listener_suite_before(void *fixture)
{
	ARG_UNUSED(fixture);

	const nfc_service_t *svc = ndef_listener_get();

	svc->on_field_off(NULL);
	nfc_response_spy_reset();
}

ZTEST_SUITE(ndef_listener_read, NULL, listener_read_setup, listener_suite_before, NULL, NULL);
```

## src/test_listener_select.c
```c
/*
 * Copyright (c) 2026
 * SPDX-License-Identifier: Apache-2.0
 *
 * NDEF Tier C — listener SELECT (wave5-ndef §8 Task 5 / 8).
 */

#include "listener_test_helpers.h"

#include <string.h>

#include <zephyr/ztest.h>

static const uint8_t NDEF_AID[] = {0xD2U, 0x76U, 0x00U, 0x00U, 0x85U, 0x01U, 0x01U};

static void *listener_select_setup(void)
{
	listener_test_reset(true);
	return NULL;
}

ZTEST(ndef_listener_select, test_on_select_sends_9000)
{
	const nfc_service_t *svc = ndef_listener_get();

	nfc_response_spy_reset();
	svc->on_select(NDEF_AID, sizeof(NDEF_AID), NULL);
	zassert_equal(nfc_response_spy_call_count(), 1U);
	listener_assert_sw_u16(NFC_SW_OK);
}

ZTEST(ndef_listener_select, test_on_select_resets_file_sel)
{
	const nfc_service_t *svc = ndef_listener_get();

	listener_select_ndef();
	listener_assert_sw_u16(NFC_SW_OK);

	nfc_response_spy_reset();
	svc->on_select(NDEF_AID, sizeof(NDEF_AID), NULL);
	listener_assert_sw_u16(NFC_SW_OK);
	listener_read_nofile_check();
}

ZTEST(ndef_listener_select, test_select_file_cc)
{
	listener_select_cc();
	listener_assert_sw_u16(NFC_SW_OK);
}

ZTEST(ndef_listener_select, test_select_file_ndef)
{
	listener_select_ndef();
	listener_assert_sw_u16(NFC_SW_OK);
}

ZTEST(ndef_listener_select, test_select_file_notfound)
{
	static const uint8_t cmd[] = {0x00U, 0xA4U, 0x00U, 0x0CU, 0x02U, 0xE1U, 0x05U};

	listener_send_apdu_bytes(cmd, sizeof(cmd));
	listener_assert_sw_u16(NFC_SW_FILE_NOT_FOUND);
}

ZTEST(ndef_listener_select, test_select_file_badlen)
{
	static const uint8_t cmd[] = {0x00U, 0xA4U, 0x00U, 0x0CU, 0x01U, 0xE1U};

	listener_send_apdu_bytes(cmd, sizeof(cmd));
	listener_assert_sw_u16(NFC_SW_WRONG_LENGTH);
}

ZTEST(ndef_listener_select, test_select_file_badp1)
{
	static const uint8_t cmd[] = {0x00U, 0xA4U, 0x04U, 0x0CU, 0x02U, 0xE1U, 0x03U};

	listener_send_apdu_bytes(cmd, sizeof(cmd));
	listener_assert_sw_u16(NFC_SW_WRONG_P1P2);
}

ZTEST(ndef_listener_select, test_select_file_badp2)
{
	static const uint8_t cmd[] = {0x00U, 0xA4U, 0x00U, 0x04U, 0x02U, 0xE1U, 0x03U};

	listener_send_apdu_bytes(cmd, sizeof(cmd));
	listener_assert_sw_u16(NFC_SW_WRONG_P1P2);
}

ZTEST(ndef_listener_select, test_on_deselect_clears_file_sel)
{
	const nfc_service_t *svc = ndef_listener_get();

	listener_select_cc();
	listener_assert_sw_u16(NFC_SW_OK);
	svc->on_deselect(NULL);
	listener_read_nofile_check();
}

ZTEST(ndef_listener_select, test_on_field_off_clears_file_sel)
{
	const nfc_service_t *svc = ndef_listener_get();

	listener_select_ndef();
	listener_assert_sw_u16(NFC_SW_OK);
	svc->on_field_off(NULL);
	listener_read_nofile_check();
}

static void listener_suite_before(void *fixture)
{
	ARG_UNUSED(fixture);

	const nfc_service_t *svc = ndef_listener_get();

	svc->on_field_off(NULL);
	nfc_response_spy_reset();
}

ZTEST_SUITE(ndef_listener_select, NULL, listener_select_setup, listener_suite_before, NULL, NULL);
```

## src/test_listener_update.c
```c
/*
 * Copyright (c) 2026
 * SPDX-License-Identifier: Apache-2.0
 *
 * NDEF Tier C — listener UPDATE BINARY (wave5-ndef §8 Task 7).
 */

#include "listener_test_helpers.h"

#include <string.h>

#include <zephyr/ztest.h>

#define NDEF_FILE_BUF_SIZE (NFC_NDEF_NLEN_FIELD_LEN + CONFIG_NFC_NDEF_MAX_SIZE)

static void *listener_update_setup(void)
{
	listener_test_reset(true);
	return NULL;
}

ZTEST(ndef_listener_update, test_update_ndef_ok)
{
	static const uint8_t payload[] = {0xAAU, 0xBBU, 0xCCU, 0xDDU};
	static const uint8_t cmd[] = {
		0x00U, 0xD6U, 0x00U, 0x00U, 0x04U, 0xAAU, 0xBBU, 0xCCU, 0xDDU,
	};
	const uint8_t *buf = NULL;
	size_t len = 0U;

	listener_select_ndef();
	listener_assert_sw_u16(NFC_SW_OK);

	nfc_response_spy_reset();
	listener_send_apdu_bytes(cmd, sizeof(cmd));
	listener_assert_sw_u16(NFC_SW_OK);

	nfc_response_spy_reset();
	listener_send_apdu_bytes((const uint8_t[]){0x00U, 0xB0U, 0x00U, 0x00U, 0x04U}, 5U);
	zassert_ok(nfc_response_spy_last(&buf, &len));
	zassert_equal(len, sizeof(payload) + 2U);
	zassert_mem_equal(buf, payload, sizeof(payload));
}

ZTEST(ndef_listener_update, test_update_nlen_then_read)
{
	static const uint8_t nlen[] = {0x00U, 0x05U};
	static const uint8_t msg[] = {0xD1U, 0x01U, 0x03U, 0x55U, 0x01U};
	const uint8_t *buf = NULL;
	size_t len = 0U;

	listener_select_ndef();
	listener_assert_sw_u16(NFC_SW_OK);

	listener_send_apdu_bytes(
		(const uint8_t[]){0x00U, 0xD6U, 0x00U, 0x00U, 0x02U, 0x00U, 0x05U}, 7U);
	listener_assert_sw_u16(NFC_SW_OK);

	listener_send_apdu_bytes(
		(const uint8_t[]){0x00U, 0xD6U, 0x00U, 0x02U, 0x05U, 0xD1U, 0x01U, 0x03U, 0x55U, 0x01U},
		10U);
	listener_assert_sw_u16(NFC_SW_OK);

	nfc_response_spy_reset();
	listener_send_apdu_bytes((const uint8_t[]){0x00U, 0xB0U, 0x00U, 0x00U, 0x07U}, 5U);
	zassert_ok(nfc_response_spy_last(&buf, &len));
	zassert_equal(len, 9U);
	zassert_mem_equal(buf, nlen, sizeof(nlen));
	zassert_mem_equal(&buf[2], msg, sizeof(msg));
}

ZTEST(ndef_listener_update, test_update_nofile)
{
	listener_send_apdu_bytes(
		(const uint8_t[]){0x00U, 0xD6U, 0x00U, 0x00U, 0x01U, 0x00U}, 6U);
	listener_assert_sw_u16(NFC_SW_NO_EF);
}

ZTEST(ndef_listener_update, test_update_cc)
{
	listener_select_cc();
	listener_assert_sw_u16(NFC_SW_OK);

	listener_send_apdu_bytes(
		(const uint8_t[]){0x00U, 0xD6U, 0x00U, 0x00U, 0x01U, 0x00U}, 6U);
	listener_assert_sw_u16(NFC_SW_CONDITIONS_NOT_SAT);
}

ZTEST(ndef_listener_update, test_update_readonly)
{
	ndef_listener_config_t cfg = { .writable = false };

	ndef_listener_shutdown();
	zassert_ok(ndef_listener_init(NULL, &cfg));

	listener_select_ndef();
	listener_assert_sw_u16(NFC_SW_OK);

	listener_send_apdu_bytes(
		(const uint8_t[]){0x00U, 0xD6U, 0x00U, 0x00U, 0x01U, 0x00U}, 6U);
	listener_assert_sw_u16(NFC_SW_CONDITIONS_NOT_SAT);
}

ZTEST(ndef_listener_update, test_update_lc_zero)
{
	listener_select_ndef();
	listener_assert_sw_u16(NFC_SW_OK);

	listener_send_apdu_bytes((const uint8_t[]){0x00U, 0xD6U, 0x00U, 0x00U, 0x00U}, 5U);
	listener_assert_sw_u16(NFC_SW_WRONG_LENGTH);
}

ZTEST(ndef_listener_update, test_update_overflow)
{
	static const uint8_t data = 0U;
	nfc_apdu_t apdu = {
		.cla = 0x00U,
		.ins = NFC_INS_UPDATE_BINARY,
		.p1 = 0x00U,
		.p2 = 0x00U,
		.data = &data,
		.lc = (uint16_t)(NDEF_FILE_BUF_SIZE + 1U),
		.le = 0U,
		.has_le = false,
		.extended = false,
	};
	const nfc_service_t *svc = ndef_listener_get();

	listener_select_ndef();
	listener_assert_sw_u16(NFC_SW_OK);

	nfc_response_spy_reset();
	svc->on_apdu(&apdu, NULL);
	listener_assert_sw_u16(NFC_SW_WRONG_LENGTH);
}

ZTEST(ndef_listener_update, test_update_at_boundary)
{
	uint8_t offset_hi = (uint8_t)((NDEF_FILE_BUF_SIZE - 1U) >> 8U);
	uint8_t offset_lo = (uint8_t)((NDEF_FILE_BUF_SIZE - 1U) & 0xFFU);
	const uint8_t cmd[] = {0x00U, 0xD6U, offset_hi, offset_lo, 0x01U, 0x5AU};
	const uint8_t *buf = NULL;
	size_t len = 0U;

	listener_select_ndef();
	listener_assert_sw_u16(NFC_SW_OK);

	listener_send_apdu_bytes(cmd, sizeof(cmd));
	listener_assert_sw_u16(NFC_SW_OK);

	nfc_response_spy_reset();
	listener_send_apdu_bytes(
		(const uint8_t[]){0x00U, 0xB0U, offset_hi, offset_lo, 0x01U}, 5U);
	zassert_ok(nfc_response_spy_last(&buf, &len));
	zassert_equal(len, 3U);
	zassert_equal(buf[0], 0x5AU);
}

static void listener_suite_before(void *fixture)
{
	ARG_UNUSED(fixture);

	const nfc_service_t *svc = ndef_listener_get();

	svc->on_field_off(NULL);
	nfc_response_spy_reset();
}

ZTEST_SUITE(ndef_listener_update, NULL, listener_update_setup, listener_suite_before, NULL, NULL);
```

## src/test_model.c
```c
/*
 * Copyright (c) 2026
 * SPDX-License-Identifier: Apache-2.0
 *
 * NDEF Tier A — data model serialize/deserialize (cookbook §14.2).
 */

#include "protocols/ndef/ndef.h"

#include <errno.h>
#include <string.h>

#include <zephyr/ztest.h>

static ndef_data_t s_data;
static ndef_data_t s_copy; /* Static to avoid stack allocation */
static uint8_t s_out[1U + NFC_NDEF_CC_LEN + NFC_NDEF_NLEN_FIELD_LEN + CONFIG_NFC_NDEF_MAX_SIZE];
static uint8_t s_round[sizeof(s_out)];

static void fill_cc(ndef_data_t *data)
{
	for (uint16_t i = 0U; i < NFC_NDEF_CC_LEN; i++) {
		data->cc[i] = (uint8_t)(0xE1U + (i % 3U));
	}
	data->cc_len = NFC_NDEF_CC_LEN;
}

static void set_empty_ndef_file(ndef_data_t *data)
{
	data->ndef_file[0] = 0U;
	data->ndef_file[1] = 0U;
	data->ndef_file_len = NFC_NDEF_NLEN_FIELD_LEN;
}

static void set_uri_ndef_file(ndef_data_t *data)
{
	static const uint8_t uri[] = {0xD1U, 0x01U, 0x03U, 0x55U, 0x01U};

	data->ndef_file[0] = 0U;
	data->ndef_file[1] = (uint8_t)sizeof(uri);
	(void)memcpy(&data->ndef_file[2], uri, sizeof(uri));
	data->ndef_file_len = (uint16_t)(NFC_NDEF_NLEN_FIELD_LEN + sizeof(uri));
}

ZTEST(ndef_model, test_model_reset)
{
	fill_cc(&s_data);
	set_uri_ndef_file(&s_data);
	ndef_data_reset(&s_data);
	zassert_equal(s_data.cc_len, 0U);
	zassert_equal(s_data.ndef_file_len, 0U);
	zassert_equal(s_data.cc[0], 0U);
	zassert_equal(s_data.ndef_file[0], 0U);
}

ZTEST(ndef_model, test_serialize_empty)
{
	size_t out_len = 0U;
	int ret;

	ndef_data_reset(&s_data);
	fill_cc(&s_data);
	set_empty_ndef_file(&s_data);

	ret = ndef_serialize(&s_data, s_out, sizeof(s_out), &out_len);
	zassert_ok(ret);
	zassert_equal(out_len, 1U + NFC_NDEF_CC_LEN + NFC_NDEF_NLEN_FIELD_LEN);
	zassert_equal(s_out[0], NFC_NDEF_FORMAT_VERSION);
	zassert_mem_equal(&s_out[1U + NFC_NDEF_CC_LEN], s_data.ndef_file, NFC_NDEF_NLEN_FIELD_LEN);
}

ZTEST(ndef_model, test_serialize_roundtrip)
{
	size_t out_len = 0U;
	int ret;

	(void)memset(&s_copy, 0, sizeof(s_copy));

	ndef_data_reset(&s_data);
	fill_cc(&s_data);
	set_uri_ndef_file(&s_data);

	ret = ndef_serialize(&s_data, s_out, sizeof(s_out), &out_len);
	zassert_ok(ret);

	ret = ndef_deserialize(&s_copy, s_out, out_len);
	zassert_ok(ret);
	zassert_mem_equal(s_copy.cc, s_data.cc, NFC_NDEF_CC_LEN);
	zassert_equal(s_copy.cc_len, s_data.cc_len);
	zassert_equal(s_copy.ndef_file_len, s_data.ndef_file_len);
	zassert_mem_equal(s_copy.ndef_file, s_data.ndef_file, s_data.ndef_file_len);
}

ZTEST(ndef_model, test_serialize_roundtrip_generated)
{
	size_t out_len = 0U;
	int ret;

	(void)memset(&s_copy, 0, sizeof(s_copy));

	ndef_data_reset(&s_data);
	fill_cc(&s_data);
	s_data.ndef_file[0] = (uint8_t)(CONFIG_NFC_NDEF_MAX_SIZE >> 8);
	s_data.ndef_file[1] = (uint8_t)(CONFIG_NFC_NDEF_MAX_SIZE & 0xFFU);
	for (uint16_t i = 0U; i < CONFIG_NFC_NDEF_MAX_SIZE; i++) {
		s_data.ndef_file[2U + i] = (uint8_t)(i & 0xFFU);
	}
	s_data.ndef_file_len = (uint16_t)(NFC_NDEF_NLEN_FIELD_LEN + CONFIG_NFC_NDEF_MAX_SIZE);

	ret = ndef_serialize(&s_data, s_out, sizeof(s_out), &out_len);
	zassert_ok(ret);

	ret = ndef_deserialize(&s_copy, s_out, out_len);
	zassert_ok(ret);
	zassert_mem_equal(&s_copy, &s_data, sizeof(s_copy));
}

ZTEST(ndef_model, test_deserialize_bad_version)
{
	uint8_t bad[1U + NFC_NDEF_CC_LEN + NFC_NDEF_NLEN_FIELD_LEN];

	(void)memset(bad, 0, sizeof(bad));
	bad[0] = 0x02U;

	ndef_data_reset(&s_data);
	zassert_equal(ndef_deserialize(&s_data, bad, sizeof(bad)), -EBADMSG);
}

ZTEST(ndef_model, test_deserialize_truncated)
{
	size_t out_len = 0U;
	int ret;

	ndef_data_reset(&s_data);
	fill_cc(&s_data);
	set_uri_ndef_file(&s_data);
	ret = ndef_serialize(&s_data, s_out, sizeof(s_out), &out_len);
	zassert_ok(ret);
	zassert_true(out_len > 1U);

	ret = ndef_deserialize(&s_data, s_out, out_len - 1U);
	zassert_equal(ret, -EBADMSG);
}

ZTEST(ndef_model, test_deserialize_oversize_field)
{
	uint8_t blob[1U + NFC_NDEF_CC_LEN + NFC_NDEF_NLEN_FIELD_LEN + 1U];

	(void)memset(blob, 0, sizeof(blob));
	blob[0] = NFC_NDEF_FORMAT_VERSION;
	blob[1U + NFC_NDEF_CC_LEN] = 0xFFU;
	blob[2U + NFC_NDEF_CC_LEN] = 0xFFU;

	ndef_data_reset(&s_data);
	zassert_equal(ndef_deserialize(&s_data, blob, sizeof(blob)), -EBADMSG);
}

ZTEST(ndef_model, test_deserialize_bad_nlen)
{
	uint8_t blob[1U + NFC_NDEF_CC_LEN + NFC_NDEF_NLEN_FIELD_LEN];

	(void)memset(blob, 0, sizeof(blob));
	blob[0] = NFC_NDEF_FORMAT_VERSION;
	blob[1U + NFC_NDEF_CC_LEN] = 0x00U;
	blob[2U + NFC_NDEF_CC_LEN] = 0x05U;

	ndef_data_reset(&s_data);
	zassert_equal(ndef_deserialize(&s_data, blob, sizeof(blob)), -EBADMSG);
}

ZTEST(ndef_model, test_serialize_enospc)
{
	size_t out_len = 0U;

	ndef_data_reset(&s_data);
	fill_cc(&s_data);
	set_empty_ndef_file(&s_data);
	zassert_equal(ndef_serialize(&s_data, s_out, 1U, &out_len), -ENOSPC);
}

ZTEST(ndef_model, test_serialize_null_out)
{
	size_t out_len = 0U;

	ndef_data_reset(&s_data);
	fill_cc(&s_data);
	set_empty_ndef_file(&s_data);
	zassert_equal(ndef_serialize(&s_data, NULL, sizeof(s_out), &out_len), -EINVAL);
}

ZTEST(ndef_model, test_deserialize_null_in)
{
	ndef_data_reset(&s_data);
	zassert_equal(ndef_deserialize(&s_data, NULL, 0U), -EINVAL);
}

ZTEST(ndef_model, test_persist_id_stable)
{
	zassert_equal(ndef_persist_id(), NFC_PERSIST_ID_NDEF);
}

ZTEST(ndef_model, test_cc_preserved_on_roundtrip)
{
	size_t out_len = 0U;
	int ret;

	(void)memset(&s_copy, 0, sizeof(s_copy));

	ndef_data_reset(&s_data);
	fill_cc(&s_data);
	set_empty_ndef_file(&s_data);

	ret = ndef_serialize(&s_data, s_out, sizeof(s_out), &out_len);
	zassert_ok(ret);

	ndef_data_reset(&s_copy);
	ret = ndef_deserialize(&s_copy, s_out, out_len);
	zassert_ok(ret);
	zassert_mem_equal(s_copy.cc, s_data.cc, NFC_NDEF_CC_LEN);
}

ZTEST(ndef_model, test_fixture_empty_bin)
{
	static const uint8_t golden[] = {
		0x01U, 0x00U, 0x00U, 0x00U, 0x00U, 0x00U, 0x00U, 0x00U, 0x00U, 0x00U,
		0x00U, 0x00U, 0x00U, 0x00U, 0x00U, 0x00U, 0x00U, 0x00U,
	};
	size_t out_len = 0U;
	int ret;

	ndef_data_reset(&s_data);
	set_empty_ndef_file(&s_data);
	s_data.cc_len = NFC_NDEF_CC_LEN;

	ret = ndef_serialize(&s_data, s_round, sizeof(s_round), &out_len);
	zassert_ok(ret);
	zassert_equal(out_len, sizeof(golden));
	zassert_mem_equal(s_round, golden, sizeof(golden));
}

ZTEST_SUITE(ndef_model, NULL, NULL, NULL, NULL, NULL);
```

## src/test_poller.c
```c
/*
 * Copyright (c) 2026
 * SPDX-License-Identifier: Apache-2.0
 *
 * NDEF Tier B — poller detect/read (cookbook §14.3 / §5.1).
 */

#include "ndef_fixture.h"
#include "ndef_poller.h"
#include "nfc_session_mock.h"

#include <errno.h>
#include <string.h>

#include <zephyr/ztest.h>

static ndef_data_t s_data;
static nfc_reader_session_t s_session;

static const uint8_t TX_SELECT_V2[] = {
	0x00U, 0xA4U, 0x04U, 0x00U, 0x07U, 0xD2U, 0x76U, 0x00U, 0x00U, 0x85U, 0x01U, 0x01U, 0x00U,
};

static const uint8_t TX_SELECT_V1[] = {
	0x00U, 0xA4U, 0x04U, 0x00U, 0x07U, 0xD2U, 0x76U, 0x00U, 0x00U, 0x85U, 0x01U, 0x00U,
};

static const uint8_t TX_SELECT_CC[] = {0x00U, 0xA4U, 0x00U, 0x0CU, 0x02U, 0xE1U, 0x03U};
static const uint8_t TX_READ_CC[] = {0x00U, 0xB0U, 0x00U, 0x00U, 0x0FU};
static const uint8_t TX_SELECT_NDEF[] = {0x00U, 0xA4U, 0x00U, 0x0CU, 0x02U, 0xE1U, 0x04U};
static const uint8_t TX_READ_NLEN[] = {0x00U, 0xB0U, 0x00U, 0x00U, 0x02U};
static const uint8_t TX_READ_URI[] = {0x00U, 0xB0U, 0x00U, 0x02U, 0x05U};
static const uint8_t TX_READ_CHUNK0[] = {0x00U, 0xB0U, 0x00U, 0x02U, 0xFDU};
static const uint8_t TX_READ_CHUNK1[] = {0x00U, 0xB0U, 0x00U, 0xFFU, 0x2FU};

static void *ndef_poller_setup(void)
{
	ndef_fixture_init_read_scripts();
	return NULL;
}

static void poller_before(void *fixture)
{
	ARG_UNUSED(fixture);

	nfc_session_mock_reset();
	s_session.active = true;
	ndef_data_reset(&s_data);
}

static void assert_tx_equals(size_t index, const uint8_t *exp, size_t exp_len)
{
	const uint8_t *tx = NULL;
	size_t tx_len = 0U;

	zassert_ok(nfc_session_mock_get_tx(index, &tx, &tx_len));
	zassert_equal(tx_len, exp_len);
	zassert_mem_equal(tx, exp, exp_len);
}

ZTEST(ndef_poller, test_detect_v2_success)
{
	poller_before(NULL);

	nfc_session_mock_load(ndef_fixture_detect_v2, ARRAY_SIZE(ndef_fixture_detect_v2));
	zassert_ok(ndef_poller_detect(&s_session));
	zassert_equal(nfc_session_mock_tx_count(), 1U);
	assert_tx_equals(0U, TX_SELECT_V2, sizeof(TX_SELECT_V2));
}

ZTEST(ndef_poller, test_detect_v1_fallback)
{
	poller_before(NULL);

	nfc_session_mock_load(ndef_fixture_detect_v1_fallback,
			      ARRAY_SIZE(ndef_fixture_detect_v1_fallback));
	zassert_ok(ndef_poller_detect(&s_session));
	zassert_equal(nfc_session_mock_tx_count(), 2U);
	assert_tx_equals(0U, TX_SELECT_V2, sizeof(TX_SELECT_V2));
	assert_tx_equals(1U, TX_SELECT_V1, sizeof(TX_SELECT_V1));
}

ZTEST(ndef_poller, test_detect_enotsup)
{
	poller_before(NULL);

	nfc_session_mock_load(ndef_fixture_detect_enotsup, ARRAY_SIZE(ndef_fixture_detect_enotsup));
	zassert_equal(ndef_poller_detect(&s_session), -ENOTSUP);
}

ZTEST(ndef_poller, test_detect_eio)
{
	static const nfc_session_mock_step_t script[] = {
		{.rx = NULL, .rx_len = 0U, .err = -EIO},
	};

	poller_before(NULL);
	nfc_session_mock_load(script, ARRAY_SIZE(script));
	zassert_equal(ndef_poller_detect(&s_session), -EIO);
}

ZTEST(ndef_poller, test_detect_timeout)
{
	static const nfc_session_mock_step_t script[] = {
		{.rx = NULL, .rx_len = 0U, .err = -ETIMEDOUT},
	};

	poller_before(NULL);
	nfc_session_mock_load(script, ARRAY_SIZE(script));
	zassert_equal(ndef_poller_detect(&s_session), -ETIMEDOUT);
}

ZTEST(ndef_poller, test_detect_inactive_session)
{
	poller_before(NULL);
	s_session.active = false;
	zassert_equal(ndef_poller_detect(&s_session), -EINVAL);
}

ZTEST(ndef_poller, test_read_empty)
{
	poller_before(NULL);

	nfc_session_mock_load(ndef_fixture_read_empty_steps, ARRAY_SIZE(ndef_fixture_read_empty_steps));
	zassert_ok(ndef_poller_read(&s_session, &s_data));
	zassert_equal(s_data.cc_len, NFC_NDEF_CC_LEN);
	zassert_mem_equal(s_data.cc, ndef_fixture_cc_std, NFC_NDEF_CC_LEN);
	zassert_equal(s_data.ndef_file_len, NFC_NDEF_NLEN_FIELD_LEN);
	zassert_equal(s_data.ndef_file[0], 0U);
	zassert_equal(s_data.ndef_file[1], 0U);
}

ZTEST(ndef_poller, test_read_uri_5byte)
{
	poller_before(NULL);

	nfc_session_mock_load(ndef_fixture_read_uri_steps, ARRAY_SIZE(ndef_fixture_read_uri_steps));
	zassert_ok(ndef_poller_read(&s_session, &s_data));
	zassert_equal(s_data.ndef_file_len,
		      (uint16_t)(NFC_NDEF_NLEN_FIELD_LEN + sizeof(ndef_fixture_uri_payload)));
	zassert_mem_equal(&s_data.ndef_file[2], ndef_fixture_uri_payload,
			  sizeof(ndef_fixture_uri_payload));
}

ZTEST(ndef_poller, test_read_chunk_transport_cap)
{
	poller_before(NULL);

	nfc_session_mock_load(ndef_fixture_read_chunk_steps, ARRAY_SIZE(ndef_fixture_read_chunk_steps));
	zassert_ok(ndef_poller_read(&s_session, &s_data));
	zassert_equal(s_data.ndef_file[0], 0x01U);
	zassert_equal(s_data.ndef_file[1], 0x2CU);
	zassert_equal(s_data.ndef_file_len, (uint16_t)(NFC_NDEF_NLEN_FIELD_LEN + NDEF_FIXTURE_CHUNK_NLEN));
	zassert_equal(s_data.ndef_file[2], 0x00U);
	zassert_equal(s_data.ndef_file[2U + 252U], (uint8_t)252U);
	zassert_equal(s_data.ndef_file[2U + 253U], (uint8_t)253U);
	zassert_equal(s_data.ndef_file[2U + 299U], (uint8_t)((299U) & 0xFFU));
	assert_tx_equals(5U, TX_READ_CHUNK0, sizeof(TX_READ_CHUNK0));
	assert_tx_equals(6U, TX_READ_CHUNK1, sizeof(TX_READ_CHUNK1));
}

ZTEST(ndef_poller, test_read_sw_error)
{
	poller_before(NULL);

	nfc_session_mock_load(ndef_fixture_read_sw_error_steps,
			      ARRAY_SIZE(ndef_fixture_read_sw_error_steps));
	zassert_equal(ndef_poller_read(&s_session, &s_data), -EIO);
}

ZTEST(ndef_poller, test_read_nlen_overflow)
{
	poller_before(NULL);

	nfc_session_mock_load(ndef_fixture_read_nlen_overflow_steps,
			      ARRAY_SIZE(ndef_fixture_read_nlen_overflow_steps));
	zassert_equal(ndef_poller_read(&s_session, &s_data), -ENOSPC);
}

ZTEST(ndef_poller, test_read_truncated)
{
	poller_before(NULL);

	nfc_session_mock_load(ndef_fixture_read_truncated_steps,
			      ARRAY_SIZE(ndef_fixture_read_truncated_steps));
	zassert_equal(ndef_poller_read(&s_session, &s_data), -EIO);
}

ZTEST(ndef_poller, test_read_tx_sequence)
{
	poller_before(NULL);

	nfc_session_mock_load(ndef_fixture_read_uri_steps, ARRAY_SIZE(ndef_fixture_read_uri_steps));
	zassert_ok(ndef_poller_read(&s_session, &s_data));
	zassert_equal(nfc_session_mock_tx_count(), 6U);
	assert_tx_equals(0U, TX_SELECT_V2, sizeof(TX_SELECT_V2));
	assert_tx_equals(1U, TX_SELECT_CC, sizeof(TX_SELECT_CC));
	assert_tx_equals(2U, TX_READ_CC, sizeof(TX_READ_CC));
	assert_tx_equals(3U, TX_SELECT_NDEF, sizeof(TX_SELECT_NDEF));
	assert_tx_equals(4U, TX_READ_NLEN, sizeof(TX_READ_NLEN));
	assert_tx_equals(5U, TX_READ_URI, sizeof(TX_READ_URI));
}

ZTEST(ndef_poller, test_read_no_session_end)
{
	poller_before(NULL);

	nfc_session_mock_load(ndef_fixture_read_empty_steps, ARRAY_SIZE(ndef_fixture_read_empty_steps));
	zassert_ok(ndef_poller_read(&s_session, &s_data));
	zassert_equal(nfc_session_mock_session_end_count(), 0U);
}

ZTEST(ndef_poller, test_read_inactive_session)
{
	poller_before(NULL);
	s_session.active = false;
	zassert_equal(ndef_poller_read(&s_session, &s_data), -EINVAL);
}

ZTEST_SUITE(ndef_poller, NULL, ndef_poller_setup, poller_before, NULL, NULL);
```

## CMakeLists.txt
```
# Copyright (c) 2026
# SPDX-License-Identifier: Apache-2.0
#
# P5: Test gating fix — protocol sources are now wrapped in CONFIG_NFC_PROTOCOL_X
# guards (Master Plan B.5). This ensures tests compile only what the active
# profile would compile in production.

cmake_minimum_required(VERSION 3.20.0)

include(${CMAKE_CURRENT_SOURCE_DIR}/../../common/CMakeLists.txt)

find_package(Zephyr REQUIRED HINTS $ENV{ZEPHYR_BASE})
project(nfc_reader_unit)

set(REPO_NFC ${CMAKE_CURRENT_SOURCE_DIR}/../../../src/nfc)
set(REPO_SRC ${CMAKE_CURRENT_SOURCE_DIR}/../../../src)

# Core test sources (always built unless Classic 4K-only isolation build)
if(NOT CONFIG_NFC_READER_CLASSIC_4K_ONLY)
target_sources(app PRIVATE
  src/test_store_roundtrip.c
  src/test_store_import.c
  src/test_verify_diff.c
  src/test_virtual_loopback.c
  src/test_poller_registry.c
  src/nfc_reader_session_mock.c
  ${REPO_NFC}/reader/nfc_reader_poller_registry.c
  ${REPO_NFC}/store/nfc_store.c
  ${REPO_NFC}/store/nfc_persist_name.c
  ${REPO_NFC}/applets/nfc_applet_policy.c
  ${REPO_NFC}/applets/nfc_applet_verify_compare.c
  ${NFC_TEST_COMMON_SOURCES}
  ${NFC_TEST_LOOPBACK_SOURCES}
)
else()
target_sources(app PRIVATE
  src/test_classic_4k_reader.c
  src/nfc_reader_session_mock.c
  ${REPO_NFC}/store/nfc_store.c
  ${REPO_NFC}/store/nfc_persist_name.c
  ${REPO_NFC}/applets/nfc_applet_policy.c
  ${NFC_TEST_COMMON_SOURCES}
)
endif()

# Headless applet tests (L1 API) — requires applet service sources
# Only enabled when NFC_APPLETS=y (not in store_ram which is at memory limit)
if(CONFIG_NFC_APPLETS)
  target_sources(app PRIVATE
    src/test_applet_headless.c
    ${REPO_NFC}/applets/nfc_applet_service.c
    ${REPO_NFC}/applets/nfc_applet_scan.c
  )
endif()

# Protocol sources — gated by CONFIG_NFC_PROTOCOL_X (B.5 fix)
if(CONFIG_NFC_PROTOCOL_NDEF)
  target_sources(app PRIVATE
    ${REPO_NFC}/protocols/ndef/ndef.c
    ${REPO_NFC}/protocols/ndef/ndef_listener.c
    ${REPO_NFC}/protocols/ndef/ndef_poller.c
  )
endif()

if(CONFIG_NFC_PROTOCOL_ULTRALIGHT)
  target_sources(app PRIVATE
    src/test_store_ultralight_roundtrip.c
    ${REPO_NFC}/protocols/ultralight/ultralight.c
    ${REPO_NFC}/protocols/ultralight/ultralight_listener.c
    ${REPO_NFC}/protocols/ultralight/ultralight_listener_t2.c
    ${REPO_NFC}/protocols/ultralight/ultralight_poller.c
    ${REPO_NFC}/protocols/ultralight/ultralight_poller_i.c
    ${REPO_NFC}/protocols/ultralight/ultralight_des.c
    ${REPO_NFC}/protocols/ultralight/ultralight_3des.c
  )
endif()

if(CONFIG_NFC_PROTOCOL_CLASSIC AND NOT CONFIG_NFC_READER_CLASSIC_4K_ONLY)
  target_sources(app PRIVATE
    src/test_store_classic_roundtrip.c
    ${REPO_NFC}/protocols/classic/classic.c
    ${REPO_NFC}/protocols/classic/classic_i.c
    ${REPO_NFC}/protocols/classic/classic_poller.c
    ${REPO_NFC}/protocols/classic/classic_listener.c
    ${REPO_NFC}/protocols/classic/crypto1.c
    ${REPO_NFC}/protocols/classic/iso14443_crc.c
  )
endif()

if(CONFIG_NFC_READER_CLASSIC_4K_ONLY)
  target_sources(app PRIVATE
    ${REPO_NFC}/protocols/classic/classic.c
    ${REPO_NFC}/protocols/classic/classic_i.c
    ${REPO_NFC}/protocols/classic/classic_poller.c
    ${REPO_NFC}/protocols/classic/classic_listener.c
    ${REPO_NFC}/protocols/classic/crypto1.c
    ${REPO_NFC}/protocols/classic/iso14443_crc.c
  )
endif()

if(CONFIG_NFC_PROTOCOL_FELICA)
  target_sources(app PRIVATE
    src/test_store_felica_roundtrip.c
    ${REPO_NFC}/helpers/felica_crc.c
    ${REPO_NFC}/protocols/felica/felica.c
    ${REPO_NFC}/protocols/felica/felica_poller.c
    ${REPO_NFC}/protocols/felica/felica_poller_i.c
    ${REPO_NFC}/protocols/felica/felica_listener.c
  )
endif()

if(CONFIG_NFC_PROTOCOL_ISO15693_3)
  target_sources(app PRIVATE
    ${REPO_NFC}/protocols/iso15693_3/iso15693_3.c
    ${REPO_NFC}/protocols/iso15693_3/iso15693_3_poller.c
    ${REPO_NFC}/protocols/iso15693_3/iso15693_3_poller_i.c
    ${REPO_NFC}/protocols/iso15693_3/iso15693_3_listener.c
  )
endif()

if(CONFIG_NFC_PROTOCOL_SLIX)
  target_sources(app PRIVATE
    src/test_store_slix_roundtrip.c
    ${REPO_NFC}/protocols/slix/slix.c
    ${REPO_NFC}/protocols/slix/slix_poller.c
    ${REPO_NFC}/protocols/slix/slix_poller_i.c
    ${REPO_NFC}/protocols/slix/slix_listener.c
  )
endif()

if(CONFIG_NFC_PROTOCOL_DESFIRE)
  target_sources(app PRIVATE
    src/test_store_desfire_roundtrip.c
    ${REPO_NFC}/protocols/desfire/desfire.c
    ${REPO_NFC}/protocols/desfire/desfire_listener.c
    ${REPO_NFC}/protocols/desfire/desfire_poller.c
    ${REPO_NFC}/protocols/desfire/desfire_poller_i.c
  )
endif()

if(CONFIG_NFC_PROTOCOL_EMV)
  target_sources(app PRIVATE
    src/test_store_emv_roundtrip.c
    ${REPO_NFC}/protocols/emv/emv.c
    ${REPO_NFC}/protocols/emv/emv_listener.c
    ${REPO_NFC}/protocols/emv/emv_poller.c
  )
endif()

if(CONFIG_NFC_PROTOCOL_ALIRO)
  target_sources(app PRIVATE
    src/test_store_aliro_roundtrip.c
    ${REPO_NFC}/protocols/aliro/aliro.c
    ${REPO_NFC}/protocols/aliro/aliro_listener.c
    ${REPO_NFC}/protocols/aliro/aliro_poller.c
  )
endif()

if(CONFIG_NFC_STORE_RAM)
  target_sources(app PRIVATE ${REPO_NFC}/store/nfc_store_ram.c)
endif()

if(CONFIG_NFC_STORE_GOLDENS)
  target_sources(app PRIVATE ${REPO_NFC}/store/nfc_store_golden.c)
endif()

target_include_directories(app PRIVATE
  ${CMAKE_CURRENT_SOURCE_DIR}/src
  ${REPO_NFC}
  ${REPO_NFC}/protocols/ndef
  ${REPO_NFC}/protocols/ultralight
  ${REPO_NFC}/protocols/classic
  ${REPO_NFC}/protocols/felica
  ${REPO_NFC}/protocols/iso15693_3
  ${REPO_NFC}/protocols/slix
  ${REPO_NFC}/protocols/desfire
  ${REPO_NFC}/protocols/emv
  ${REPO_NFC}/protocols/aliro
  ${REPO_NFC}/applets
  ${REPO_SRC}
  ${CMAKE_CURRENT_SOURCE_DIR}/../../fixtures/store
  ${CMAKE_CURRENT_SOURCE_DIR}/../../fixtures/ultralight
  ${CMAKE_CURRENT_SOURCE_DIR}/../../fixtures/classic
  ${CMAKE_CURRENT_SOURCE_DIR}/../../fixtures/felica
  ${CMAKE_CURRENT_SOURCE_DIR}/../../fixtures/slix
  ${CMAKE_CURRENT_SOURCE_DIR}/../../fixtures/desfire
  ${CMAKE_CURRENT_SOURCE_DIR}/../../fixtures/emv
  ${CMAKE_CURRENT_SOURCE_DIR}/../../fixtures/aliro
  ${NFC_TEST_COMMON_INCLUDES}
)
```

## Kconfig
```
# SPDX-License-Identifier: Apache-2.0

mainmenu "NFC reader applet unit tests"

source "Kconfig.zephyr"

config NFC_PROTOCOL_NDEF
	bool "NDEF Type-4 protocol model"
	default n

config NFC_PROTOCOL_ULTRALIGHT
	bool "MIFARE Ultralight / NTAG protocol model"
	default n
	select NFC_PROTOCOL_NDEF

config NFC_PROTOCOL_CLASSIC
	bool "MIFARE Classic protocol model (clone-only)"
	default n

config NFC_PROTOCOL_FELICA
	bool "FeliCa protocol model (clone-only)"
	default n

config NFC_PROTOCOL_ISO15693_3
	bool "ISO15693-3 protocol model (clone-only parent)"
	default n

config NFC_PROTOCOL_SLIX
	bool "NXP SLIX protocol model (clone-only)"
	default n
	select NFC_PROTOCOL_ISO15693_3

config NFC_PROTOCOL_DESFIRE
	bool "MIFARE DESFire protocol model (partial emulatable)"
	default n

config NFC_PROTOCOL_EMV
	bool "EMV contactless protocol model (partial emulatable)"
	default n

config NFC_PROTOCOL_ALIRO
	bool "Aliro credential protocol model (partial emulatable)"
	default n

config NFC_EMV_MAX_RECORDS
	int "Maximum EMV READ RECORD blobs"
	default 2
	range 1 4
	depends on NFC_PROTOCOL_EMV

config NFC_EMV_RECORD_SIZE
	int "Maximum EMV tag-70 record size"
	default 64
	range 32 128
	depends on NFC_PROTOCOL_EMV

config NFC_ALIRO_MAX_TRANSCRIPT
	int "Maximum Aliro AUTH transcript bytes"
	default 512
	range 128 1024
	depends on NFC_PROTOCOL_ALIRO

config NFC_DESFIRE_MAX_APPS
	int "Maximum DESFire applications"
	default 1
	range 1 4
	depends on NFC_PROTOCOL_DESFIRE

config NFC_DESFIRE_MAX_FILES_PER_APP
	int "Maximum DESFire files per application"
	default 2
	range 1 8
	depends on NFC_PROTOCOL_DESFIRE

config NFC_DESFIRE_MAX_FILE_SIZE
	int "Maximum DESFire file payload"
	default 64
	range 16 256
	depends on NFC_PROTOCOL_DESFIRE

config FELICA_BLOCKS_MAX
	int "Maximum FeliCa blocks in data model"
	default 64
	range 16 64
	depends on NFC_PROTOCOL_FELICA

config ISO15693_BLOCKS_MAX
	int "Maximum ISO15693 blocks in data model"
	default 256
	range 16 256
	depends on NFC_PROTOCOL_ISO15693_3

config ISO15693_BLOCK_SIZE_MAX
	int "Maximum ISO15693 block size (bytes)"
	default 32
	range 4 32
	depends on NFC_PROTOCOL_ISO15693_3

config NFC_CLASSIC_BLOCK_COUNT
	int "Maximum Classic blocks in data model"
	default 256
	range 64 256
	depends on NFC_PROTOCOL_CLASSIC

config NFC_CLASSIC_TEST_DETERMINISTIC_NR
	bool "Use fixed NR bytes in Classic poller unit tests"
	default n
	depends on NFC_PROTOCOL_CLASSIC

config NFC_READER_CLASSIC_4K_ONLY
	bool "Build only Classic 4K reader aggregate tests (QEMU RAM isolation)"
	default n
	depends on NFC_PROTOCOL_CLASSIC

config NFC_VIRTUAL_LOOPBACK_MAX_BLOB
	int "Virtual loopback staging blob size (bytes)"
	default 2048
	range 2048 8192

config NFC_ULTRALIGHT_MAX_PAGES
	int "Maximum Ultralight pages in data model"
	default 256
	range 16 256
	depends on NFC_PROTOCOL_ULTRALIGHT

config NFC_NDEF_MAX_SIZE
	int "Maximum NDEF message payload (bytes)"
	default 500
	range 1 4096

config NFC_STORE
	bool "Enable store envelope tests"
	default y

config NFC_STORE_BLOB_SIZE
	int "Staging buffer size for serialized blobs (bytes)"
	default 4096
	depends on NFC_STORE
	range 512 16384

config NFC_STORE_MAX_TAG_LEN
	int "Maximum tag name length including NUL"
	default 16
	depends on NFC_STORE
	range 8 32

# Stub for src/nfc/nfc_config.h + emulate policy (mirrors CONFIG_NFC_ROLE_LISTEN).
config NFC_ROLE_LISTEN
	bool "Listen role (enables emulate policy compile path)"
	default y

# L1 applet headless service (P5: shell_off scenario)
# Default n to save RAM for constrained scenarios like store_ram.
# Enable explicitly in scenarios that need headless applet tests.
config NFC_APPLETS
	bool "NFC applet service (headless L1)"
	default n

config NFC_STORE_RAM
	bool "In-RAM multi-slot store backend"
	default n
	depends on NFC_STORE

if NFC_STORE_RAM

config NFC_STORE_RAM_SLOT_COUNT
	int "Number of RAM store slots"
	default 4
	depends on NFC_STORE_RAM
	range 1 16

config NFC_STORE_GOLDENS
	bool "Compiled-in store goldens for import tests"
	default n
	depends on NFC_STORE_RAM

endif
```

## prj.conf
```kconfig
CONFIG_ZTEST=y
CONFIG_LOG=y
CONFIG_CRC=y
CONFIG_SHELL=n
CONFIG_MAIN_STACK_SIZE=8192
CONFIG_NFC_PROTOCOL_NDEF=y
CONFIG_NFC_PROTOCOL_ULTRALIGHT=y
CONFIG_NFC_PROTOCOL_CLASSIC=y
CONFIG_NFC_PROTOCOL_FELICA=y
CONFIG_NFC_PROTOCOL_ISO15693_3=y
CONFIG_NFC_PROTOCOL_SLIX=y
CONFIG_NFC_PROTOCOL_DESFIRE=y
CONFIG_NFC_PROTOCOL_EMV=y
CONFIG_NFC_PROTOCOL_ALIRO=y
CONFIG_NFC_DESFIRE_MAX_APPS=1
CONFIG_NFC_DESFIRE_MAX_FILES_PER_APP=2
CONFIG_NFC_DESFIRE_MAX_FILE_SIZE=64
CONFIG_FELICA_BLOCKS_MAX=64
CONFIG_ISO15693_BLOCKS_MAX=128
CONFIG_ISO15693_BLOCK_SIZE_MAX=4
CONFIG_NFC_CLASSIC_BLOCK_COUNT=64
CONFIG_NFC_CLASSIC_TEST_DETERMINISTIC_NR=y
CONFIG_NFC_ULTRALIGHT_MAX_PAGES=256
CONFIG_NFC_NDEF_MAX_SIZE=500
CONFIG_NFC_ALIRO_MAX_TRANSCRIPT=256
CONFIG_NFC_STORE_BLOB_SIZE=2048
CONFIG_NFC_STORE=y
CONFIG_NFC_STORE_MAX_TAG_LEN=32
CONFIG_NFC_APPLETS=y
```

## overlay-store-qemu.conf
```kconfig
# Trim RAM on qemu_cortex_m3 full store scenario (64 KiB).
CONFIG_NFC_PROTOCOL_SLIX=n
CONFIG_NFC_PROTOCOL_ISO15693_3=n
CONFIG_NFC_APPLETS=n
CONFIG_NFC_STORE_BLOB_SIZE=1200
CONFIG_MAIN_STACK_SIZE=4352
CONFIG_NFC_CLASSIC_BLOCK_COUNT=64
CONFIG_FELICA_BLOCKS_MAX=28
CONFIG_NFC_DESFIRE_MAX_FILE_SIZE=32
```

## overlay-store-ram.conf
```kconfig
# In-RAM store backend unit coverage (QEMU + native_sim).
# Lighter than the full store scenario: RAM slots + NDEF envelope only.
# 2 slots at 512 B each fit qemu_cortex_m3 (64 KiB RAM).
CONFIG_NFC_STORE_RAM=y
CONFIG_NFC_STORE_RAM_SLOT_COUNT=2
CONFIG_NFC_STORE_GOLDENS=y
CONFIG_NFC_APPLETS=n
CONFIG_NFC_STORE_BLOB_SIZE=1024
CONFIG_SHELL=n
# Clone-only heavy poller protocols — covered by the store scenario.
CONFIG_NFC_PROTOCOL_CLASSIC=n
CONFIG_NFC_PROTOCOL_FELICA=n
CONFIG_NFC_PROTOCOL_ISO15693_3=n
CONFIG_NFC_PROTOCOL_SLIX=n
```

## prj_classic_4k.conf
```kconfig
CONFIG_ZTEST=y
CONFIG_LOG=y
CONFIG_CRC=y
CONFIG_SHELL=n
CONFIG_MAIN_STACK_SIZE=8192
CONFIG_NFC_PROTOCOL_CLASSIC=y
CONFIG_NFC_CLASSIC_BLOCK_COUNT=256
CONFIG_NFC_CLASSIC_TEST_DETERMINISTIC_NR=y
CONFIG_NFC_STORE=y
CONFIG_NFC_STORE_BLOB_SIZE=4352
CONFIG_NFC_READER_CLASSIC_4K_ONLY=y
```

## src/nfc_reader_session_mock.c
```c
/*
 * Copyright (c) 2026
 * SPDX-License-Identifier: Apache-2.0
 *
 * Shared nfc_reader_session mock for nfc_reader unit tests.
 * Configurable via set/clear functions so multiple test suites can coexist.
 * Also provides stubs for reader engine functions needed by nfc_applet_scan.c.
 */

#include "reader/nfc_reader_engine.h"
#include "run/nfc_stack_workq.h"

#include <errno.h>
#include <string.h>

#include <zephyr/kernel.h>

static nfc_reader_session_t s_mock_session;
static bool s_session_active;

void nfc_reader_session_mock_set(const nfc_reader_session_t *session)
{
	if (session != NULL) {
		s_mock_session = *session;
		s_session_active = true;
	}
}

void nfc_reader_session_mock_clear(void)
{
	memset(&s_mock_session, 0, sizeof(s_mock_session));
	s_session_active = false;
}

const nfc_reader_session_t *nfc_reader_session_get(void)
{
	return s_session_active ? &s_mock_session : NULL;
}

/* Stubs for nfc_applet_scan.c dependencies */

bool nfc_reader_scan_busy(void)
{
	return false;
}

int nfc_reader_discover_once(k_timeout_t timeout, nfc_transport_tag_info_t *info)
{
	ARG_UNUSED(timeout);
	ARG_UNUSED(info);
	return -ENOTSUP;
}

/* Work queue stub - returns NULL (tests don't submit work) */
struct k_work_q *nfc_stack_wq_get(void)
{
	return NULL;
}
```

## src/nfc_reader_session_mock.h
```c
/*
 * Copyright (c) 2026
 * SPDX-License-Identifier: Apache-2.0
 *
 * Shared nfc_reader_session mock for nfc_reader unit tests.
 */

#ifndef NFC_READER_SESSION_MOCK_H_
#define NFC_READER_SESSION_MOCK_H_

#include "reader/nfc_reader_engine.h"

/**
 * @brief Set the mock session to return from nfc_reader_session_get().
 * @param session Session data to copy. NULL clears the mock.
 */
void nfc_reader_session_mock_set(const nfc_reader_session_t *session);

/**
 * @brief Clear the mock session (nfc_reader_session_get() will return NULL).
 */
void nfc_reader_session_mock_clear(void);

#endif /* NFC_READER_SESSION_MOCK_H_ */
```

## src/test_applet_headless.c
```c
/*
 * Copyright (c) 2026
 * SPDX-License-Identifier: Apache-2.0
 *
 * Tier E — Headless L1 applet tests (P5 — Master Plan Part E.5).
 *
 * Proves the L1 applet API works without shell (log==NULL for callbacks,
 * nfc_applet_service.h functions with result structs). These tests call L1
 * directly, never touch struct shell *.
 */

#include "applets/nfc_applet_service.h"
#include "nfc_reader_session_mock.h"
#include "store/nfc_store.h"
#include "protocols/ndef/ndef.h"
#include "store_fixture.h"

#include <errno.h>
#include <string.h>

#include <zephyr/ztest.h>

/* ------------------------------------------------------------------ */
/* Helper to set up mock session for scan_get_result tests            */
/* ------------------------------------------------------------------ */

static void set_mock_session(const uint8_t *uid, size_t uid_len,
			     uint8_t protocol, uint8_t interface, uint8_t mode_tech)
{
	nfc_reader_session_t session = {0};

	memcpy(session.tag.uid.bytes, uid, uid_len);
	session.tag.uid.len = uid_len;
	session.tag.protocol = protocol;
	session.tag.interface = interface;
	session.tag.mode_tech = mode_tech;
	session.tag.valid = true;
	nfc_reader_session_mock_set(&session);
}

/* ------------------------------------------------------------------ */
/* Mock store for get_card_meta                                       */
/* ------------------------------------------------------------------ */

static uint8_t s_saved_blob[512];
static size_t s_saved_len;

static int mock_save_cb(const char *tag, const uint8_t *blob, size_t len, void *user_ctx)
{
	ARG_UNUSED(tag);
	ARG_UNUSED(user_ctx);

	if (len > sizeof(s_saved_blob)) {
		return -ENOSPC;
	}
	memcpy(s_saved_blob, blob, len);
	s_saved_len = len;
	return 0;
}

static int mock_load_cb(const char *tag, uint8_t *out, size_t max, size_t *out_len,
			void *user_ctx)
{
	ARG_UNUSED(tag);
	ARG_UNUSED(user_ctx);

	if (s_saved_len == 0U) {
		return -ENOENT;
	}
	if (s_saved_len > max) {
		return -ENOSPC;
	}
	memcpy(out, s_saved_blob, s_saved_len);
	*out_len = s_saved_len;
	return 0;
}

/* ------------------------------------------------------------------ */
/* Test suite setup                                                   */
/* ------------------------------------------------------------------ */

static void *suite_setup(void)
{
	s_saved_len = 0U;
	nfc_reader_session_mock_clear();
	nfc_store_init(NULL);
	nfc_store_register_save_cb(mock_save_cb, NULL);
	nfc_store_register_load_cb(mock_load_cb, NULL);
	return NULL;
}

static void before_each(void *fixture)
{
	ARG_UNUSED(fixture);
	s_saved_len = 0U;
	nfc_reader_session_mock_clear();
}

ZTEST_SUITE(nfc_applet_headless, NULL, suite_setup, before_each, NULL, NULL);

/* ------------------------------------------------------------------ */
/* scan_get_result tests (L1 API, no shell)                           */
/* ------------------------------------------------------------------ */

ZTEST(nfc_applet_headless, test_scan_get_result_no_session)
{
	nfc_applet_scan_result_t result;
	int ret;

	nfc_reader_session_mock_clear();
	ret = nfc_applet_scan_get_result(&result);
	zassert_equal(ret, -ENOENT, "Expected -ENOENT when no session active");
}

ZTEST(nfc_applet_headless, test_scan_get_result_null_out)
{
	int ret;

	ret = nfc_applet_scan_get_result(NULL);
	zassert_equal(ret, -EINVAL, "Expected -EINVAL for NULL output");
}

ZTEST(nfc_applet_headless, test_scan_get_result_populated)
{
	static const uint8_t uid[] = {0x04, 0xA2, 0x24, 0x33, 0x44, 0x55, 0x66};
	nfc_applet_scan_result_t result;
	int ret;

	set_mock_session(uid, sizeof(uid), 0x02, 0x01, 0xAB);

	ret = nfc_applet_scan_get_result(&result);
	zassert_ok(ret, "scan_get_result should succeed with active session");
	zassert_true(result.valid, "Result should be valid");
	zassert_equal(result.uid.len, sizeof(uid), "UID length mismatch");
	zassert_mem_equal(result.uid.bytes, uid, sizeof(uid), "UID bytes mismatch");
	zassert_equal(result.protocol, 0x02, "Protocol mismatch");
	zassert_equal(result.interface, 0x01, "Interface mismatch");
	zassert_equal(result.mode_tech, 0xAB, "Mode/tech mismatch");
}

/* ------------------------------------------------------------------ */
/* get_card_meta tests (L1 API, no shell)                             */
/* ------------------------------------------------------------------ */

ZTEST(nfc_applet_headless, test_get_card_meta_missing_slot)
{
	nfc_applet_card_meta_t meta;
	int ret;

	ret = nfc_applet_get_card_meta("missing", &meta);
	zassert_equal(ret, -ENOENT, "Expected -ENOENT for missing slot");
	zassert_false(meta.present, "meta.present should be false for missing slot");
}

ZTEST(nfc_applet_headless, test_get_card_meta_from_golden)
{
	nfc_applet_card_meta_t meta;
	int ret;

	/* Load a golden NDEF blob into the mock store */
	zassert_true(STORE_FIXTURE_NDEF_EMPTY_CARD_LEN <= sizeof(s_saved_blob));
	memcpy(s_saved_blob, store_fixture_ndef_empty_card, STORE_FIXTURE_NDEF_EMPTY_CARD_LEN);
	s_saved_len = STORE_FIXTURE_NDEF_EMPTY_CARD_LEN;

	ret = nfc_applet_get_card_meta("golden", &meta);
	zassert_ok(ret, "get_card_meta should succeed for valid slot");
	zassert_true(meta.present, "meta.present should be true");
	zassert_equal(meta.persist_id, NFC_PERSIST_ID_NDEF, "persist_id should be NDEF");
	zassert_not_null(meta.protocol_name, "protocol_name should be set");
}

/* ------------------------------------------------------------------ */
/* verify_compare (already tested in test_verify_diff.c, but add      */
/* one headless L1 sanity check)                                       */
/* ------------------------------------------------------------------ */

ZTEST(nfc_applet_headless, test_verify_compare_headless)
{
	ndef_data_t expected = {0};
	ndef_data_t actual = {0};
	int ret;

	/* Empty NDEF models should match */
	ndef_data_reset(&expected);
	expected.cc_len = NFC_NDEF_CC_LEN;
	expected.ndef_file_len = NFC_NDEF_NLEN_FIELD_LEN;

	actual = expected;

	ret = nfc_applet_verify_compare(&expected, &actual, NULL, NULL);
	zassert_ok(ret, "Identical models should compare equal");
}

ZTEST(nfc_applet_headless, test_verify_compare_headless_mismatch)
{
	ndef_data_t expected = {0};
	ndef_data_t actual = {0};
	int ret;

	ndef_data_reset(&expected);
	expected.cc_len = NFC_NDEF_CC_LEN;
	expected.ndef_file_len = NFC_NDEF_NLEN_FIELD_LEN + 3;
	expected.ndef_file[0] = 0x00;
	expected.ndef_file[1] = 0x03;
	expected.ndef_file[2] = 0xD1;
	expected.ndef_file[3] = 0x01;
	expected.ndef_file[4] = 0x00;

	ndef_data_reset(&actual);
	actual.cc_len = NFC_NDEF_CC_LEN;
	actual.ndef_file_len = NFC_NDEF_NLEN_FIELD_LEN + 3;
	actual.ndef_file[0] = 0x00;
	actual.ndef_file[1] = 0x03;
	actual.ndef_file[2] = 0xFF; /* Different byte */
	actual.ndef_file[3] = 0x01;
	actual.ndef_file[4] = 0x00;

	ret = nfc_applet_verify_compare(&expected, &actual, NULL, NULL);
	zassert_equal(ret, -EBADMSG, "Different models should return -EBADMSG");
}
```

## src/test_classic_4k_reader.c
```c
/*
 * Copyright (c) 2026
 * SPDX-License-Identifier: Apache-2.0
 *
 * Tier E+ — Classic 4K only (256-block model; isolated from aggregate reader RAM budget).
 */

#include "protocols/classic/classic.h"
#include "protocols/classic/classic_listener.h"
#include "protocols/classic/classic_poller.h"
#include "store/nfc_store.h"

#include "classic_store_fixture.h"
#include "nfc_virtual_rf.h"
#include "nfc_stack/nfc_stack.h"

#include <errno.h>
#include <string.h>

#include <zephyr/ztest.h>

#define CLASSIC_4K_CARD_BODY_OFF 10U

static classic_data_t s_read;
static classic_data_t s_golden;
static uint8_t s_saved_blob[4352];
static size_t s_saved_len;

static const uint8_t s_uid_4k_7b[] = {0x04U, 0x4BU, 0x4BU, 0x4BU, 0x4BU, 0xCAU, 0xFEU};

nfc_stack_state_t nfc_stack_get_state(void)
{
	return NFC_STACK_STATE_INITIALIZED;
}

static int classic_body_from_card_4k_4b(const uint8_t **body, size_t *body_len)
{
	if (STORE_FIXTURE_MFCLASSIC_4K_4B_CARD_LEN <= CLASSIC_4K_CARD_BODY_OFF) {
		return -EBADMSG;
	}

	*body = &store_fixture_mfclassic_4k_4b_card[CLASSIC_4K_CARD_BODY_OFF];
	*body_len = STORE_FIXTURE_MFCLASSIC_4K_4B_CARD_LEN - CLASSIC_4K_CARD_BODY_OFF - 2U;
	return 0;
}

static int classic_body_from_card_4k_7b(const uint8_t **body, size_t *body_len)
{
	if (STORE_FIXTURE_MFCLASSIC_4K_7B_CARD_LEN <= CLASSIC_4K_CARD_BODY_OFF) {
		return -EBADMSG;
	}

	*body = &store_fixture_mfclassic_4k_7b_card[CLASSIC_4K_CARD_BODY_OFF];
	*body_len = STORE_FIXTURE_MFCLASSIC_4K_7B_CARD_LEN - CLASSIC_4K_CARD_BODY_OFF - 2U;
	return 0;
}

static int mock_save_cb(const char *tag, const uint8_t *blob, size_t len, void *user_ctx)
{
	ARG_UNUSED(tag);
	ARG_UNUSED(user_ctx);

	if (len > sizeof(s_saved_blob)) {
		return -ENOSPC;
	}

	(void)memcpy(s_saved_blob, blob, len);
	s_saved_len = len;
	return 0;
}

static int mock_load_cb(const char *tag, uint8_t *out, size_t max, size_t *out_len,
			void *user_ctx)
{
	ARG_UNUSED(tag);
	ARG_UNUSED(user_ctx);

	if (s_saved_len == 0U) {
		return -ENOENT;
	}
	if (s_saved_len > max) {
		return -ENOSPC;
	}

	(void)memcpy(out, s_saved_blob, s_saved_len);
	*out_len = s_saved_len;
	return 0;
}

static void *suite_setup(void)
{
	s_saved_len = 0U;
	(void)nfc_store_init(NULL);
	(void)nfc_store_register_save_cb(mock_save_cb, NULL);
	(void)nfc_store_register_load_cb(mock_load_cb, NULL);
	return NULL;
}

ZTEST_SUITE(nfc_reader_classic_4k, NULL, suite_setup, NULL, NULL, NULL);

ZTEST(nfc_reader_classic_4k, test_store_peek_golden_4k_4b)
{
	uint8_t persist_id;
	uint8_t flags;
	int ret;

	zassert_true(STORE_FIXTURE_MFCLASSIC_4K_4B_CARD_LEN <= sizeof(s_saved_blob));
	(void)memcpy(s_saved_blob, store_fixture_mfclassic_4k_4b_card,
		     STORE_FIXTURE_MFCLASSIC_4K_4B_CARD_LEN);
	s_saved_len = STORE_FIXTURE_MFCLASSIC_4K_4B_CARD_LEN;

	ret = nfc_store_peek_entry_meta("golden", &persist_id, &flags);
	zassert_ok(ret);
	zassert_equal(persist_id, NFC_PERSIST_ID_CLASSIC);
	zassert_equal(flags, NFC_STORE_ENTRY_FLAG_HAND_AUTHORED);
}

ZTEST(nfc_reader_classic_4k, test_virtual_rf_poller_read_4k_4b)
{
	const uint8_t *body = NULL;
	size_t body_len = 0U;
	nfc_reader_session_t session = {
		.active = true,
		.tag.valid = true,
	};

	zassert_ok(classic_body_from_card_4k_4b(&body, &body_len));
	classic_data_reset(&s_golden);
	zassert_ok(classic_deserialize(&s_golden, body, body_len));

	session.tag.uid.len = s_golden.uid_len;
	(void)memcpy(session.tag.uid.bytes, s_golden.uid, s_golden.uid_len);

	(void)classic_listener_shutdown();
	zassert_ok(classic_listener_init(&s_golden));
	zassert_ok(nfc_virtual_rf_enable(classic_listener_get()));

	classic_data_reset(&s_read);
	zassert_ok(classic_poller_read(&session, &s_read));

	(void)classic_listener_shutdown();
	zassert_ok(classic_compare(&s_golden, &s_read));
	nfc_virtual_rf_disable();
}

ZTEST(nfc_reader_classic_4k, test_store_peek_golden_4k_7b)
{
	uint8_t persist_id;
	uint8_t flags;
	int ret;

	zassert_true(STORE_FIXTURE_MFCLASSIC_4K_7B_CARD_LEN <= sizeof(s_saved_blob));
	(void)memcpy(s_saved_blob, store_fixture_mfclassic_4k_7b_card,
		     STORE_FIXTURE_MFCLASSIC_4K_7B_CARD_LEN);
	s_saved_len = STORE_FIXTURE_MFCLASSIC_4K_7B_CARD_LEN;

	ret = nfc_store_peek_entry_meta("golden", &persist_id, &flags);
	zassert_ok(ret);
	zassert_equal(persist_id, NFC_PERSIST_ID_CLASSIC);
	zassert_equal(flags, NFC_STORE_ENTRY_FLAG_HAND_AUTHORED);
}

ZTEST(nfc_reader_classic_4k, test_virtual_rf_poller_read_4k_7b)
{
	const uint8_t *body = NULL;
	size_t body_len = 0U;
	nfc_reader_session_t session = {
		.active = true,
		.tag.valid = true,
	};

	zassert_ok(classic_body_from_card_4k_7b(&body, &body_len));
	classic_data_reset(&s_golden);
	zassert_ok(classic_deserialize(&s_golden, body, body_len));

	session.tag.uid.len = sizeof(s_uid_4k_7b);
	(void)memcpy(session.tag.uid.bytes, s_uid_4k_7b, sizeof(s_uid_4k_7b));

	(void)classic_listener_shutdown();
	zassert_ok(classic_listener_init(&s_golden));
	zassert_ok(nfc_virtual_rf_enable(classic_listener_get()));

	classic_data_reset(&s_read);
	zassert_ok(classic_poller_read(&session, &s_read));

	(void)classic_listener_shutdown();
	zassert_ok(classic_compare(&s_golden, &s_read));
	nfc_virtual_rf_disable();
}
```

## src/test_placeholder.c
```c
/*
 * Copyright (c) 2026
 * SPDX-License-Identifier: Apache-2.0
 *
 * Tier E scaffold — replace with store/clone/verify tests at Gate 2.
 * See tests/unit/nfc_reader/README.md and cookbook §14.6a.
 */

#include <zephyr/ztest.h>

ZTEST_SUITE(nfc_reader_placeholder, NULL, NULL, NULL, NULL, NULL);

ZTEST(nfc_reader_placeholder, test_scaffold_compiles)
{
	zassert_true(true, "Tier E scaffold");
}
```

## src/test_poller_registry.c
```c
/*
 * Copyright (c) 2026
 * SPDX-License-Identifier: Apache-2.0
 *
 * Poller registry table — clone_fn wiring (cookbook §14.13 Step 2).
 */

#include "reader/nfc_reader_poller_registry.h"
#include "nfc_reader_session_mock.h"

#include <string.h>

#include <zephyr/ztest.h>

static void before_each(void *fixture)
{
	ARG_UNUSED(fixture);
	nfc_reader_session_mock_clear();
}

ZTEST_SUITE(nfc_reader_registry, NULL, NULL, before_each, NULL, NULL);

ZTEST(nfc_reader_registry, test_pollers_table_clone_hooks)
{
	const nfc_reader_poller_entry_t *pollers = nfc_reader_pollers_get();
#if IS_ENABLED(CONFIG_NFC_PROTOCOL_NDEF)
	bool found_ndef = false;
#endif
#if IS_ENABLED(CONFIG_NFC_PROTOCOL_ULTRALIGHT)
	bool found_ultralight = false;
#endif
#if IS_ENABLED(CONFIG_NFC_PROTOCOL_CLASSIC)
	bool found_classic = false;
#endif
#if IS_ENABLED(CONFIG_NFC_PROTOCOL_FELICA)
	bool found_felica = false;
#endif
#if IS_ENABLED(CONFIG_NFC_PROTOCOL_SLIX)
	bool found_slix = false;
#endif
#if IS_ENABLED(CONFIG_NFC_PROTOCOL_ISO15693_3)
	bool found_iso15693_3 = false;
#endif

	for (const nfc_reader_poller_entry_t *e = pollers; e->detect != NULL; e++) {
#if IS_ENABLED(CONFIG_NFC_PROTOCOL_NDEF)
		if (strcmp(e->name, "ndef") == 0) {
			found_ndef = true;
			zassert_not_null(e->clone_fn, "NDEF poller needs clone_fn");
		}
#endif
#if IS_ENABLED(CONFIG_NFC_PROTOCOL_ULTRALIGHT)
		if (strcmp(e->name, "ultralight") == 0) {
			found_ultralight = true;
			zassert_not_null(e->clone_fn, "Ultralight poller needs clone_fn");
		}
#endif
#if IS_ENABLED(CONFIG_NFC_PROTOCOL_CLASSIC)
		if (strcmp(e->name, "classic") == 0) {
			found_classic = true;
			zassert_not_null(e->clone_fn, "Classic poller needs clone_fn");
		}
#endif
#if IS_ENABLED(CONFIG_NFC_PROTOCOL_FELICA)
		if (strcmp(e->name, "felica") == 0) {
			found_felica = true;
			zassert_not_null(e->clone_fn, "FeliCa poller needs clone_fn");
		}
#endif
#if IS_ENABLED(CONFIG_NFC_PROTOCOL_SLIX)
		if (strcmp(e->name, "slix") == 0) {
			found_slix = true;
			zassert_not_null(e->clone_fn, "SLIX poller needs clone_fn");
		}
#endif
#if IS_ENABLED(CONFIG_NFC_PROTOCOL_ISO15693_3)
		if (strcmp(e->name, "iso15693_3") == 0) {
			found_iso15693_3 = true;
			zassert_not_null(e->clone_fn, "ISO15693-3 poller needs clone_fn");
		}
#endif
	}

#if IS_ENABLED(CONFIG_NFC_PROTOCOL_NDEF)
	zassert_true(found_ndef, "NDEF poller registered");
#endif
#if IS_ENABLED(CONFIG_NFC_PROTOCOL_ULTRALIGHT)
	zassert_true(found_ultralight, "Ultralight poller registered");
#endif
#if IS_ENABLED(CONFIG_NFC_PROTOCOL_CLASSIC)
	zassert_true(found_classic, "Classic poller registered");
#endif
#if IS_ENABLED(CONFIG_NFC_PROTOCOL_FELICA)
	zassert_true(found_felica, "FeliCa poller registered");
#endif
#if IS_ENABLED(CONFIG_NFC_PROTOCOL_SLIX)
	zassert_true(found_slix, "SLIX poller registered");
#endif
#if IS_ENABLED(CONFIG_NFC_PROTOCOL_ISO15693_3)
	zassert_true(found_iso15693_3, "ISO15693-3 poller registered");
#endif
}

ZTEST(nfc_reader_registry, test_pollers_run_no_session)
{
	zassert_equal(nfc_reader_pollers_run("slot"), -ENODEV);
}
```

## src/test_store_aliro_roundtrip.c
```c
/*
 * Copyright (c) 2026
 * SPDX-License-Identifier: Apache-2.0
 *
 * Tier E — Aliro nfc_store envelope save/load.
 */

#include "aliro_listener.h"
#include "applets/nfc_applet_policy.h"
#include "store/nfc_store.h"

#include <errno.h>
#include <string.h>

#include <zephyr/ztest.h>

static uint8_t s_saved_blob[2048];
static size_t s_saved_len;

static int mock_save_cb(const char *tag, const uint8_t *blob, size_t len, void *user_ctx)
{
	ARG_UNUSED(tag);
	ARG_UNUSED(user_ctx);

	if (len > sizeof(s_saved_blob)) {
		return -ENOSPC;
	}

	(void)memcpy(s_saved_blob, blob, len);
	s_saved_len = len;
	return 0;
}

static int mock_load_cb(const char *tag, uint8_t *out, size_t max, size_t *out_len,
			void *user_ctx)
{
	ARG_UNUSED(tag);
	ARG_UNUSED(user_ctx);

	if (s_saved_len == 0U) {
		return -ENOENT;
	}
	if (s_saved_len > max) {
		return -ENOSPC;
	}

	(void)memcpy(out, s_saved_blob, s_saved_len);
	*out_len = s_saved_len;
	return 0;
}

static void *suite_setup(void)
{
	s_saved_len = 0U;
	(void)nfc_store_init(NULL);
	(void)nfc_store_register_save_cb(mock_save_cb, NULL);
	(void)nfc_store_register_load_cb(mock_load_cb, NULL);
	return NULL;
}

ZTEST_SUITE(nfc_reader_aliro_store, NULL, suite_setup, NULL, NULL, NULL);

ZTEST(nfc_reader_aliro_store, test_store_load_roundtrip)
{
	const nfc_service_t *svcs[] = { aliro_listener_get() };
	aliro_data_t expected;
	aliro_data_t loaded;
	uint8_t body[768];
	size_t body_len = 0U;
	int ret;

	aliro_data_reset(&expected);
	expected.protocol_major = 0U;
	expected.protocol_minor = 9U;
	expected.credential_pubkey[0] = 0x04U;
	expected.transcript_len = 2U;
	expected.transcript[0] = 0xAAU;
	expected.transcript[1] = 0xBBU;

	zassert_ok(aliro_listener_init(&expected));

	ret = nfc_store_save("aliro_rt", svcs, ARRAY_SIZE(svcs));
	zassert_ok(ret);

	(void)aliro_listener_shutdown();
	zassert_ok(aliro_listener_init(NULL));

	ret = nfc_store_load("aliro_rt", svcs, ARRAY_SIZE(svcs));
	zassert_ok(ret);

	ret = aliro_listener_get()->serialize(body, sizeof(body), &body_len, NULL);
	zassert_ok(ret);
	ret = aliro_deserialize(&loaded, body, body_len);
	zassert_ok(ret);
	zassert_equal(loaded.transcript_len, expected.transcript_len);
	zassert_mem_equal(loaded.transcript, expected.transcript, expected.transcript_len);
}

ZTEST(nfc_reader_aliro_store, test_store_peek_emulate_allowed)
{
	uint8_t persist_id = NFC_PERSIST_ID_ALIRO;
	uint8_t flags = NFC_STORE_ENTRY_FLAG_HAND_AUTHORED | NFC_STORE_ENTRY_FLAG_EMULATION_COMPLETE;

	zassert_ok(nfc_applet_check_emulate(persist_id, flags));
}
```

## src/test_store_classic_roundtrip.c
```c
/*
 * Copyright (c) 2026
 * SPDX-License-Identifier: Apache-2.0
 *
 * Tier E — classic nfc_store envelope save/load (clone-only, no loopback).
 */

#include "applets/nfc_applet_policy.h"
#include "protocols/classic/classic.h"
#include "store/nfc_store.h"

#include "classic_fixture_reader.h"
#include "classic_store_fixture.h"

#include <errno.h>
#include <string.h>

#include <zephyr/sys/crc.h>
#include <zephyr/ztest.h>

static classic_data_t s_model;
/*
 * NOTE: classic_data_t is ~4KB. These tests work because s_model is shared
 * (via serialize/deserialize callbacks) and local variables are assigned
 * directly from it, avoiding duplicate large structs on stack simultaneously.
 */
static uint8_t s_saved_blob[2048];
static size_t s_saved_len;

static int mock_serialize(uint8_t *out, size_t out_max, size_t *out_len, void *user_ctx)
{
	ARG_UNUSED(user_ctx);

	return classic_serialize(&s_model, out, out_max, out_len);
}

static int mock_deserialize(const uint8_t *in, size_t in_len, void *user_ctx)
{
	ARG_UNUSED(user_ctx);

	return classic_deserialize(&s_model, in, in_len);
}

static nfc_service_t s_svc = {
	.serialize = mock_serialize,
	.deserialize = mock_deserialize,
	.persist_id = NFC_PERSIST_ID_CLASSIC,
};

static int mock_save_cb(const char *tag, const uint8_t *blob, size_t len, void *user_ctx)
{
	ARG_UNUSED(tag);
	ARG_UNUSED(user_ctx);

	if (len > sizeof(s_saved_blob)) {
		return -ENOSPC;
	}

	(void)memcpy(s_saved_blob, blob, len);
	s_saved_len = len;
	return 0;
}

static int mock_load_cb(const char *tag, uint8_t *out, size_t max, size_t *out_len,
			void *user_ctx)
{
	ARG_UNUSED(tag);
	ARG_UNUSED(user_ctx);

	if (s_saved_len == 0U) {
		return -ENOENT;
	}
	if (s_saved_len > max) {
		return -ENOSPC;
	}

	(void)memcpy(out, s_saved_blob, s_saved_len);
	*out_len = s_saved_len;
	return 0;
}

static void load_golden_blob(const uint8_t *blob, size_t len)
{
	zassert_true(len <= sizeof(s_saved_blob));
	(void)memcpy(s_saved_blob, blob, len);
	s_saved_len = len;
}

static void load_golden_model_from(const uint8_t *model, size_t model_len, classic_data_t *data)
{
	int ret;

	classic_data_reset(data);
	ret = classic_deserialize(data, model, model_len);
	zassert_ok(ret);
}

static void load_golden_model(classic_data_t *data)
{
	load_golden_model_from(classic_MfClassic_1K_4b_model, CLASSIC_MFCLASSIC_1K_4B_MODEL_LEN, data);
}

static void store_load_golden_case(const uint8_t *card, size_t card_len, const uint8_t *model,
				   size_t model_len)
{
	const nfc_service_t *svcs[] = { &s_svc };
	classic_data_t expected;
	int ret;

	load_golden_model_from(model, model_len, &expected);
	load_golden_blob(card, card_len);

	classic_data_reset(&s_model);
	ret = nfc_store_load("golden", svcs, ARRAY_SIZE(svcs));
	zassert_ok(ret);
	zassert_equal(s_model.type, expected.type);
	zassert_equal(s_model.uid_len, expected.uid_len);
	zassert_mem_equal(s_model.uid, expected.uid, expected.uid_len);
	zassert_mem_equal(s_model.blocks[0], expected.blocks[0], CLASSIC_BLOCK_SIZE);
}

static void *suite_setup(void)
{
	s_saved_len = 0U;
	(void)nfc_store_init(NULL);
	(void)nfc_store_register_save_cb(mock_save_cb, NULL);
	(void)nfc_store_register_load_cb(mock_load_cb, NULL);
	return NULL;
}

ZTEST_SUITE(nfc_reader_classic_store, NULL, suite_setup, NULL, NULL, NULL);

ZTEST(nfc_reader_classic_store, test_store_load_golden_mfclassic_1k_4b)
{
	store_load_golden_case(store_fixture_mfclassic_1k_4b_card,
			       STORE_FIXTURE_MFCLASSIC_1K_4B_CARD_LEN,
			       classic_MfClassic_1K_4b_model,
			       CLASSIC_MFCLASSIC_1K_4B_MODEL_LEN);
}

ZTEST(nfc_reader_classic_store, test_store_load_golden_mfclassic_1k_7b)
{
	store_load_golden_case(store_fixture_mfclassic_1k_7b_card,
			       STORE_FIXTURE_MFCLASSIC_1K_7B_CARD_LEN,
			       classic_MfClassic_1K_7b_model,
			       CLASSIC_MFCLASSIC_1K_7B_MODEL_LEN);
}

#if CONFIG_NFC_CLASSIC_BLOCK_COUNT >= 256
ZTEST(nfc_reader_classic_store, test_store_load_golden_mfclassic_4k_4b)
{
	store_load_golden_case(store_fixture_mfclassic_4k_4b_card,
			       STORE_FIXTURE_MFCLASSIC_4K_4B_CARD_LEN,
			       classic_MfClassic_4K_4b_model,
			       CLASSIC_MFCLASSIC_4K_4B_MODEL_LEN);
}

ZTEST(nfc_reader_classic_store, test_store_load_golden_mfclassic_4k_7b)
{
	store_load_golden_case(store_fixture_mfclassic_4k_7b_card,
			       STORE_FIXTURE_MFCLASSIC_4K_7B_CARD_LEN,
			       classic_MfClassic_4K_7b_model,
			       CLASSIC_MFCLASSIC_4K_7B_MODEL_LEN);
}
#endif

ZTEST(nfc_reader_classic_store, test_store_load_golden_mfclassic_mini_4b)
{
	store_load_golden_case(store_fixture_mfclassic_mini_4b_card,
			       STORE_FIXTURE_MFCLASSIC_MINI_4B_CARD_LEN,
			       classic_MfClassic_Mini_4b_model,
			       CLASSIC_MFCLASSIC_MINI_4B_MODEL_LEN);
}

ZTEST(nfc_reader_classic_store, test_store_load_golden_mfclassic_mini_7b)
{
	store_load_golden_case(store_fixture_mfclassic_mini_7b_card,
			       STORE_FIXTURE_MFCLASSIC_MINI_7B_CARD_LEN,
			       classic_MfClassic_Mini_7b_model,
			       CLASSIC_MFCLASSIC_MINI_7B_MODEL_LEN);
}

ZTEST(nfc_reader_classic_store, test_store_load_roundtrip_mfclassic_1k_4b)
{
	const nfc_service_t *svcs[] = { &s_svc };
	classic_data_t loaded;
	uint8_t expected_blob[CLASSIC_MFCLASSIC_1K_4B_MODEL_LEN];
	size_t expected_len = 0U;
	int ret;

	load_golden_model(&s_model);
	ret = classic_serialize(&s_model, expected_blob, sizeof(expected_blob), &expected_len);
	zassert_ok(ret);

	ret = nfc_store_save("round", svcs, ARRAY_SIZE(svcs));
	zassert_ok(ret);

	classic_data_reset(&s_model);
	ret = nfc_store_load("round", svcs, ARRAY_SIZE(svcs));
	zassert_ok(ret);

	loaded = s_model;
	load_golden_model(&s_model);
	zassert_equal(loaded.type, s_model.type);
	zassert_equal(loaded.uid_len, s_model.uid_len);
	zassert_mem_equal(loaded.uid, s_model.uid, loaded.uid_len);
	zassert_mem_equal(loaded.blocks[4], s_model.blocks[4], CLASSIC_BLOCK_SIZE);

	ret = classic_serialize(&loaded, s_saved_blob, sizeof(s_saved_blob), &s_saved_len);
	zassert_ok(ret);
	zassert_equal(s_saved_len, expected_len);
	zassert_mem_equal(s_saved_blob, expected_blob, expected_len);
}

ZTEST(nfc_reader_classic_store, test_store_save_reader_captured_envelope)
{
	const nfc_service_t *svcs[] = { &s_svc };
	uint16_t crc_stored;
	uint16_t crc_calc;
	int ret;

	load_golden_model(&s_model);
	ret = nfc_store_save("clone", svcs, ARRAY_SIZE(svcs));
	zassert_ok(ret);
	zassert_true(s_saved_len >= NFC_STORE_ENVELOPE_OVERHEAD);
	zassert_equal(s_saved_blob[0], NFC_STORE_BLOB_MAGIC_0);
	zassert_equal(s_saved_blob[1], NFC_STORE_BLOB_MAGIC_1);
	zassert_equal(s_saved_blob[2], NFC_STORE_BLOB_VERSION);
	zassert_equal(s_saved_blob[6], NFC_PERSIST_ID_CLASSIC);
	zassert_equal(s_saved_blob[7], NFC_STORE_ENTRY_FLAG_READER_CAPTURED);

	crc_stored = (uint16_t)s_saved_blob[s_saved_len - 2U] |
		     ((uint16_t)s_saved_blob[s_saved_len - 1U] << 8U);
	crc_calc = crc16_ccitt(0xFFFFU, s_saved_blob, s_saved_len - NFC_STORE_BLOB_CRC_SIZE);
	zassert_equal(crc_calc, crc_stored);
}

ZTEST(nfc_reader_classic_store, test_store_peek_golden_mfclassic_1k_4b)
{
	uint8_t persist_id;
	uint8_t flags;
	int ret;

	load_golden_blob(store_fixture_mfclassic_1k_4b_card,
			 STORE_FIXTURE_MFCLASSIC_1K_4B_CARD_LEN);
	ret = nfc_store_peek_entry_meta("golden", &persist_id, &flags);
	zassert_ok(ret);
	zassert_equal(persist_id, NFC_PERSIST_ID_CLASSIC);
	zassert_equal(flags, NFC_STORE_ENTRY_FLAG_HAND_AUTHORED);
}

ZTEST(nfc_reader_classic_store, test_store_peek_clone_only_no_emulate)
{
	uint8_t persist_id = NFC_PERSIST_ID_CLASSIC;
	uint8_t flags = NFC_STORE_ENTRY_FLAG_READER_CAPTURED;

	zassert_equal(nfc_applet_check_emulate(persist_id, flags), -ENOTSUP);
}
```

## src/test_store_desfire_roundtrip.c
```c
/*
 * Copyright (c) 2026
 * SPDX-License-Identifier: Apache-2.0
 *
 * Tier E — DESFire nfc_store envelope save/load.
 */

#include "applets/nfc_applet_policy.h"
#include "desfire_listener.h"
#include "store/nfc_store.h"

#include "Desfire_mock.h"

#include <errno.h>
#include <string.h>

#include <zephyr/ztest.h>

static uint8_t s_saved_blob[2048];
static size_t s_saved_len;

static int mock_save_cb(const char *tag, const uint8_t *blob, size_t len, void *user_ctx)
{
	ARG_UNUSED(tag);
	ARG_UNUSED(user_ctx);

	if (len > sizeof(s_saved_blob)) {
		return -ENOSPC;
	}

	(void)memcpy(s_saved_blob, blob, len);
	s_saved_len = len;
	return 0;
}

static int mock_load_cb(const char *tag, uint8_t *out, size_t max, size_t *out_len,
			void *user_ctx)
{
	ARG_UNUSED(tag);
	ARG_UNUSED(user_ctx);

	if (s_saved_len == 0U) {
		return -ENOENT;
	}
	if (s_saved_len > max) {
		return -ENOSPC;
	}

	(void)memcpy(out, s_saved_blob, s_saved_len);
	*out_len = s_saved_len;
	return 0;
}

static void *suite_setup(void)
{
	s_saved_len = 0U;
	(void)nfc_store_init(NULL);
	(void)nfc_store_register_save_cb(mock_save_cb, NULL);
	(void)nfc_store_register_load_cb(mock_load_cb, NULL);
	return NULL;
}

ZTEST_SUITE(nfc_reader_desfire_store, NULL, suite_setup, NULL, NULL, NULL);

ZTEST(nfc_reader_desfire_store, test_store_load_roundtrip)
{
	const nfc_service_t *svcs[] = { desfire_listener_get() };
	desfire_data_t expected;
	desfire_data_t loaded;
	uint8_t body[512];
	size_t body_len = 0U;
	int ret;

	zassert_ok(desfire_deserialize(&expected, desfire_Desfire_model, DESFIRE_DESFIRE_MODEL_LEN));
	zassert_ok(desfire_listener_init(&expected));

	ret = nfc_store_save("round", svcs, ARRAY_SIZE(svcs));
	zassert_ok(ret);

	(void)desfire_listener_shutdown();
	zassert_ok(desfire_listener_init(NULL));

	ret = nfc_store_load("round", svcs, ARRAY_SIZE(svcs));
	zassert_ok(ret);

	ret = desfire_listener_get()->serialize(body, sizeof(body), &body_len, NULL);
	zassert_ok(ret);
	ret = desfire_deserialize(&loaded, body, body_len);
	zassert_ok(ret);
	zassert_mem_equal(loaded.uid, expected.uid, DESFIRE_UID_SIZE);
	zassert_equal(loaded.app_count, expected.app_count);
	zassert_equal(loaded.apps[0].file_count, expected.apps[0].file_count);
	zassert_mem_equal(loaded.apps[0].file_data[0], expected.apps[0].file_data[0],
			  expected.apps[0].file_data_len[0]);
}

ZTEST(nfc_reader_desfire_store, test_store_peek_emulate_allowed)
{
	uint8_t persist_id = NFC_PERSIST_ID_DESFIRE;
	uint8_t flags = NFC_STORE_ENTRY_FLAG_HAND_AUTHORED | NFC_STORE_ENTRY_FLAG_EMULATION_COMPLETE;

	zassert_ok(nfc_applet_check_emulate(persist_id, flags));
}
```

## src/test_store_emv_roundtrip.c
```c
/*
 * Copyright (c) 2026
 * SPDX-License-Identifier: Apache-2.0
 *
 * Tier E — EMV nfc_store envelope save/load.
 */

#include "applets/nfc_applet_policy.h"
#include "emv_listener.h"
#include "emv.h"
#include "store/nfc_store.h"
#include "emv_store_fixture.h"

#include <errno.h>
#include <string.h>

#include <zephyr/ztest.h>

static uint8_t s_saved_blob[2048];
static size_t s_saved_len;

static void load_golden_blob(const uint8_t *blob, size_t len)
{
	zassert_true(len <= sizeof(s_saved_blob));
	(void)memcpy(s_saved_blob, blob, len);
	s_saved_len = len;
}

static int mock_save_cb(const char *tag, const uint8_t *blob, size_t len, void *user_ctx)
{
	ARG_UNUSED(tag);
	ARG_UNUSED(user_ctx);

	if (len > sizeof(s_saved_blob)) {
		return -ENOSPC;
	}

	(void)memcpy(s_saved_blob, blob, len);
	s_saved_len = len;
	return 0;
}

static int mock_load_cb(const char *tag, uint8_t *out, size_t max, size_t *out_len,
			void *user_ctx)
{
	ARG_UNUSED(tag);
	ARG_UNUSED(user_ctx);

	if (s_saved_len == 0U) {
		return -ENOENT;
	}
	if (s_saved_len > max) {
		return -ENOSPC;
	}

	(void)memcpy(out, s_saved_blob, s_saved_len);
	*out_len = s_saved_len;
	return 0;
}

static void *suite_setup(void)
{
	s_saved_len = 0U;
	(void)nfc_store_init(NULL);
	(void)nfc_store_register_save_cb(mock_save_cb, NULL);
	(void)nfc_store_register_load_cb(mock_load_cb, NULL);
	return NULL;
}

ZTEST_SUITE(nfc_reader_emv_store, NULL, suite_setup, NULL, NULL, NULL);

ZTEST(nfc_reader_emv_store, test_store_load_roundtrip)
{
	const nfc_service_t *svcs[] = { emv_listener_get() };
	emv_card_image_t expected;
	emv_card_image_t loaded;
	uint8_t body[512];
	size_t body_len = 0U;
	int ret;

	emv_card_image_load_default(&expected);
	zassert_ok(emv_listener_init(&expected));

	ret = nfc_store_save("emv_rt", svcs, ARRAY_SIZE(svcs));
	zassert_ok(ret);

	(void)emv_listener_shutdown();
	zassert_ok(emv_listener_init(NULL));

	ret = nfc_store_load("emv_rt", svcs, ARRAY_SIZE(svcs));
	zassert_ok(ret);

	ret = emv_listener_get()->serialize(body, sizeof(body), &body_len, NULL);
	zassert_ok(ret);
	ret = emv_deserialize(&loaded, body, body_len);
	zassert_ok(ret);
	zassert_equal(loaded.pan_len, expected.pan_len);
	zassert_equal(loaded.record_count, expected.record_count);
}

ZTEST(nfc_reader_emv_store, test_store_load_golden_emv_card)
{
	const nfc_service_t *svcs[] = { emv_listener_get() };
	emv_card_image_t expected;
	uint8_t body[512];
	uint8_t expected_body[512];
	size_t body_len = 0U;
	size_t expected_len = 0U;
	int ret;

	emv_card_image_load_default(&expected);
	load_golden_blob(store_fixture_emv_card, STORE_FIXTURE_EMV_CARD_LEN);

	(void)emv_listener_shutdown();
	zassert_ok(emv_listener_init(NULL));

	ret = nfc_store_load("golden", svcs, ARRAY_SIZE(svcs));
	zassert_ok(ret);

	ret = emv_listener_get()->serialize(body, sizeof(body), &body_len, NULL);
	zassert_ok(ret);
	ret = emv_serialize(&expected, expected_body, sizeof(expected_body), &expected_len);
	zassert_ok(ret);
	zassert_equal(body_len, expected_len);
	zassert_mem_equal(body, expected_body, expected_len);
}

ZTEST(nfc_reader_emv_store, test_store_peek_emulate_allowed)
{
	uint8_t persist_id = NFC_PERSIST_ID_EMV;
	uint8_t flags = NFC_STORE_ENTRY_FLAG_HAND_AUTHORED | NFC_STORE_ENTRY_FLAG_EMULATION_COMPLETE;

	zassert_ok(nfc_applet_check_emulate(persist_id, flags));
}
```

## src/test_store_felica_roundtrip.c
```c
/*
 * Copyright (c) 2026
 * SPDX-License-Identifier: Apache-2.0
 *
 * Tier E — FeliCa nfc_store envelope save/load + E+ virtual loopback.
 */

#include "applets/nfc_applet_policy.h"
#include "protocols/felica/felica.h"
#include "store/nfc_store.h"

#include "Felica_mock.h"
#include "felica_store_fixture.h"

#include <errno.h>
#include <string.h>

#include <zephyr/sys/crc.h>
#include <zephyr/ztest.h>

static felica_data_t s_model;
static uint8_t s_saved_blob[2048];
static size_t s_saved_len;

static int mock_serialize(uint8_t *out, size_t out_max, size_t *out_len, void *user_ctx)
{
	ARG_UNUSED(user_ctx);

	return felica_serialize(&s_model, out, out_max, out_len);
}

static int mock_deserialize(const uint8_t *in, size_t in_len, void *user_ctx)
{
	ARG_UNUSED(user_ctx);

	return felica_deserialize(&s_model, in, in_len);
}

static nfc_service_t s_svc = {
	.serialize = mock_serialize,
	.deserialize = mock_deserialize,
	.persist_id = NFC_PERSIST_ID_FELICA,
};

static int mock_save_cb(const char *tag, const uint8_t *blob, size_t len, void *user_ctx)
{
	ARG_UNUSED(tag);
	ARG_UNUSED(user_ctx);

	if (len > sizeof(s_saved_blob)) {
		return -ENOSPC;
	}

	(void)memcpy(s_saved_blob, blob, len);
	s_saved_len = len;
	return 0;
}

static int mock_load_cb(const char *tag, uint8_t *out, size_t max, size_t *out_len,
			void *user_ctx)
{
	ARG_UNUSED(tag);
	ARG_UNUSED(user_ctx);

	if (s_saved_len == 0U) {
		return -ENOENT;
	}
	if (s_saved_len > max) {
		return -ENOSPC;
	}

	(void)memcpy(out, s_saved_blob, s_saved_len);
	*out_len = s_saved_len;
	return 0;
}

static void load_golden_blob(const uint8_t *blob, size_t len)
{
	zassert_true(len <= sizeof(s_saved_blob));
	(void)memcpy(s_saved_blob, blob, len);
	s_saved_len = len;
}

static void load_golden_model(felica_data_t *data)
{
	int ret;

	felica_data_reset(data);
	ret = felica_deserialize(data, felica_Felica_model, FELICA_FELICA_MODEL_LEN);
	zassert_ok(ret);
}

static void *suite_setup(void)
{
	s_saved_len = 0U;
	(void)nfc_store_init(NULL);
	(void)nfc_store_register_save_cb(mock_save_cb, NULL);
	(void)nfc_store_register_load_cb(mock_load_cb, NULL);
	return NULL;
}

ZTEST_SUITE(nfc_reader_felica_store, NULL, suite_setup, NULL, NULL, NULL);

ZTEST(nfc_reader_felica_store, test_store_load_golden)
{
	const nfc_service_t *svcs[] = { &s_svc };
	felica_data_t expected;
	int ret;

	load_golden_model(&expected);
	load_golden_blob(store_fixture_felica_card, STORE_FIXTURE_FELICA_CARD_LEN);

	felica_data_reset(&s_model);
	ret = nfc_store_load("golden", svcs, ARRAY_SIZE(svcs));
	zassert_ok(ret);
	zassert_mem_equal(s_model.idm, expected.idm, FELICA_IDM_SIZE);
	zassert_equal(s_model.blocks_total, expected.blocks_total);
}

ZTEST(nfc_reader_felica_store, test_store_load_roundtrip)
{
	const nfc_service_t *svcs[] = { &s_svc };
	felica_data_t loaded;
	int ret;

	load_golden_model(&s_model);
	ret = nfc_store_save("round", svcs, ARRAY_SIZE(svcs));
	zassert_ok(ret);

	felica_data_reset(&s_model);
	ret = nfc_store_load("round", svcs, ARRAY_SIZE(svcs));
	zassert_ok(ret);

	loaded = s_model;
	load_golden_model(&s_model);
	zassert_mem_equal(loaded.idm, s_model.idm, FELICA_IDM_SIZE);
	zassert_equal(loaded.blocks_total, s_model.blocks_total);
}

ZTEST(nfc_reader_felica_store, test_store_peek_clone_only_no_emulate)
{
	uint8_t persist_id = NFC_PERSIST_ID_FELICA;
	uint8_t flags = NFC_STORE_ENTRY_FLAG_READER_CAPTURED;

	zassert_equal(nfc_applet_check_emulate(persist_id, flags), -ENOTSUP);
}

ZTEST(nfc_reader_felica_store, test_store_peek_golden)
{
	uint8_t persist_id;
	uint8_t flags;
	int ret;

	load_golden_blob(store_fixture_felica_card, STORE_FIXTURE_FELICA_CARD_LEN);
	ret = nfc_store_peek_entry_meta("golden", &persist_id, &flags);
	zassert_ok(ret);
	zassert_equal(persist_id, NFC_PERSIST_ID_FELICA);
	zassert_equal(flags, NFC_STORE_ENTRY_FLAG_HAND_AUTHORED);
}
```
